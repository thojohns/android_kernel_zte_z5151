## drivers/input/fingerprint/goodix/Kconfig
```kconfig
config FINGERPRINT_GOODIX_3258
  tristate "GOODIX fingerprint drvier support"
  default n
```

## drivers/input/fingerprint/silead/Kconfig
```kconfig
config FINGERPRINT_SILEAD_6153E
  tristate "SILEAD 6153E fingerprint drvier support"
  default n
config FINGERPRINT_SILEAD_NO_FINGERID
  tristate "SILEAD 6153E fingerprint drvier support"
  default n
config FINGERPRINT_SILEAD_NAVI
  tristate "SILEAD 6153E fingerprint drvier support"
  default n
```

## drivers/input/touchscreen/HiMax83102/Kconfig
```kconfig
#
# Himax Touchscreen driver configuration
#

config TOUCHSCREEN_HIMAX_I2C_HX83102
        tristate "HIMAX chipset HX83102 touchscreen"
		depends on TOUCHSCREEN_HIMAX_CHIPSET_HX83102
		help
		This enables support for HIMAX CHIPSET HX83102 over I2C based touchscreens.

config TOUCHSCREEN_HIMAX_DEBUG_HX83102
        tristate "HIMAX HX83102 debug function"
		depends on TOUCHSCREEN_HIMAX_I2C_HX83102
		help
		This enables support for HIMAX HX83102 debug function.

config TOUCHSCREEN_HIMAX_ITO_TEST_HX83102
	tristate "HIMAX HX83102 test over Dragon Board"
	depends on TOUCHSCREEN_HIMAX_I2C_HX83102
	help
	  This enables support for HIMAX HX83102 test over Dragon Board.

config HMX_DB_HX83102
	tristate "HIMAX driver test over Dragon Board"
	depends on TOUCHSCREEN_HIMAX_I2C_HX83102
	help
	  This enables support for HIMAX driver test over Dragon Board.

config HXTS_FIRMWARE_PATH
	string "HIMAX firmware path"
```

## drivers/input/touchscreen/focaltech_touch/Kconfig
```kconfig
#
# Focaltech Touchscreen driver configuration
#

config TOUCHSCREEN_FTS_FT3427
	bool "Focaltech Touchscreen IC FT3427"
		depends on I2C
		default n
		help
		  Say Y here if you have Focaltech touch FT3427 panel.
		  If unsure, say N.

config TOUCHSCREEN_FTS_FT3327
	bool "Focaltech Touchscreen IC FT3327"
		depends on I2C
		default n
		help
		  Say Y here if you have Focaltech touch FT3327 panel.
		  If unsure, say N.

config TOUCHSCREEN_FTS_FT8006
	bool "Focaltech Touchscreen IC FT8006"
		depends on I2C
		default n
		help
		  Say Y here if you have Focaltech touch FT8006 panel.
		  If unsure, say N.
config TOUCHSCREEN_FTS_FT6336G
	bool "Focaltech Touchscreen IC FT6336G"
		depends on I2C
		default n
		help
		  Say Y here if you have Focaltech touch FT6336G panel.
		  If unsure, say N.

config TOUCHSCREEN_FTS_DIRECTORY
	string "Focaltech ts directory name"
	default "focaltech_touch"
	depends on TOUCHSCREEN_FTS
```

## drivers/input/touchscreen/ipio_touch_driver/Kconfig
```kconfig
#
# ILI9881 Touchscreen driver configuration
#

config TOUCHSCREEN_ILITEK
	bool "ILITEK touchscreen driver"
	depends on I2C
	help
		Say Y here if you have ILI9881 touch panel.
		if unsure, say N.
		To compile this driver as a module, choose M here.

config ILI_FIRMWARE_PATH
	string "ILITEK firmware path"
```

## drivers/input/touchscreen/zte_gt1151/Kconfig
```kconfig
#
# GT1151 touchscreen driver configuration
#
menuconfig TOUCHSCREEN_GT1151
	bool "GT1151 touchscreen"
	default n
	help
	  Say Y here if you have a GT1151 touchscreen connected
	  to your system.

	  If unsure, say N.

if TOUCHSCREEN_GT1151

choice
	default TOUCHSCREEN_SYNAPTICS_DSX_I2C
	prompt "Synaptics DSX touchscreen bus interface"

config TOUCHSCREEN_SYNAPTICS_DSX_I2C
	bool "I2C"
	depends on I2C
	help
	  Say Y here if you have a Synaptics DSX touchscreen interfaced
	  to the host processor over I2C

	  If unsure, say N.

	  This module uses the services of DSX CORE

config TOUCHSCREEN_SYNAPTICS_DSX_SPI
	bool "SPI"
	depends on SPI_MASTER
	help
	  Say Y here if you have a Synaptics DSX touchscreen interfaced
	  to the host processor over SPI

	  If unsure, say N.

	  This module uses the services of DSX CORE
endchoice

config GT1151_TOUCHPANEL_DRIVER
	tristate "Goodix GT1151 touchpanel driver"
	depends on TOUCHSCREEN_GT1151
	help

	  Say Y here if you have a Goodix GT1151 touchscreen connected
	  to your system.

	  If unsure, say N.

	  To compile this driver as a module, choose M here: the
	  module will be called gt1x.

config GT1151_TOUCHPANEL_EXTENTS
	tristate "Goodix GT1151 Tools for debuging"
	depends on GT1151_TOUCHPANEL_DRIVER
	help
	  This is application debug interface support for Goodix GT1151
	  touchscreens.

	  Say Y here if you want to have a Android app debug interface
	  to your system.

	  If unsure, say N.

	  To compile this driver as a module, choose M here: the
	  module will be called gt1x_extents.

config GT1151_TOUCHPANEL_GENERIC
	tristate "Goodix GT1151 Tools for debuging"
	depends on GT1151_TOUCHPANEL_DRIVER
	help
	  This is application debug interface support for Goodix GT1151
	  touchscreens.

	  Say Y here if you want to have a Android app debug interface
	  to your system.

	  If unsure, say N.

	  To compile this driver as a module, choose M here: the
	  module will be called gt1x_generic.

config GT1151_TOUCHPANEL_UPDATE
	tristate "Goodix GT1151 touchpanel auto update support"
	depends on GT1151_TOUCHPANEL_DRIVER
	help
	  This enables support for firmware update for Goodix GT1151
	  touchscreens.

	  Say Y here if you have a Goodix GT1151 touchscreen connected
	  to your system.

	  If unsure, say N.

	  To compile this driver as a module, choose M here: the
	  module will be called gt1x_update.

config GT1151_TOUCHPANEL_DEBUG
	tristate "Gt1x Tools for debuging"
	depends on GT1151_TOUCHPANEL_DRIVER
	help
	  This is application debug interface support for Goodix GT1151
	  touchscreens.

	  Say Y here if you want to have a Android app debug interface
	  to your system.

	  If unsure, say N.

	  To compile this driver as a module, choose M here: the
	  module will be called gt1x_tools.

endif
```

## drivers/media/platform/msm/camera_v2/sensor/zte_eeprom/Kconfig
```kconfig
config IMX351_EEPROM
	bool "ZTE IMX351 Calibration support"
	depends on MSMB_CAMERA
	help
	  Enable support for ROM Interface for Calibration
	  Provides interface for reading the Claibration data.
	  and also provides support for writing data in case of FLASH ROM.
	  Currently supports CCI  protocol

config OV8856_EEPROM
	bool "ZTE OV8856 Calibration support"
	depends on MSMB_CAMERA
	help
	  Enable support for ROM Interface for Calibration
	  Provides interface for reading the Claibration data.
	  and also provides support for writing data in case of FLASH ROM.
	  Currently supports CCI  protocol

config HI846_EEPROM
	bool "ZTE HI846 Calibration support"
	depends on MSMB_CAMERA
	help
	  Enable support for ROM Interface for Calibration
	  Provides interface for reading the Claibration data.
	  and also provides support for writing data in case of FLASH ROM.
	  Currently supports CCI  protocol

config OV16B10_031_EEPROM
	bool "ZTE OV16B10_031 Calibration support"
	depends on MSMB_CAMERA
	help
	  Enable support for ROM Interface for Calibration
	  Provides interface for reading the Claibration data.
	  and also provides support for writing data in case of FLASH ROM.
	  Currently supports CCI  protocol

config S5K4H7_127_EEPROM
	bool "ZTE S5K4H7_127 Calibration support"
	depends on MSMB_CAMERA
	help
	  Enable support for ROM Interface for Calibration
	  Provides interface for reading the Claibration data.
	  and also provides support for writing data in case of FLASH ROM.
	  Currently supports CCI  protocol

config IMX351_033_EEPROM
	bool "ZTE IMX351_033 Calibration support"
	depends on MSMB_CAMERA
	help
	  Enable support for ROM Interface for Calibration
	  Provides interface for reading the Claibration data.
	  and also provides support for writing data in case of FLASH ROM.
	  Currently supports CCI  protocol

config IMX351_034_EEPROM
	bool "ZTE IMX351_034 Calibration support"
	depends on MSMB_CAMERA
	help
	  Enable support for ROM Interface for Calibration
	  Provides interface for reading the Claibration data.
	  and also provides support for writing data in case of FLASH ROM.
	  Currently supports CCI  protocol

config IMX351_032_EEPROM
	bool "ZTE IMX351_032 Calibration support"
	depends on MSMB_CAMERA
	help
	  Enable support for ROM Interface for Calibration
	  Provides interface for reading the Claibration data.
	  and also provides support for writing data in case of FLASH ROM.
	  Currently supports CCI  protocol

config S5K4H7_Z610CA_127_EEPROM
	bool "ZTE S5K4H7_Z610CA_127 Calibration support"
	depends on MSMB_CAMERA
	help
	  Enable support for ROM Interface for Calibration
	  Provides interface for reading the Claibration data.
	  and also provides support for writing data in case of FLASH ROM.
	  Currently supports CCI  protocol

config S5K4H7_Z6450T_127_EEPROM
	bool "ZTE S5K4H7_Z6450T_127 Calibration support"
	depends on MSMB_CAMERA
	help
	  Enable support for ROM Interface for Calibration
	  Provides interface for reading the Claibration data.
	  and also provides support for writing data in case of FLASH ROM.
	  Currently supports CCI  protocol

config S5K3L6_035_EEPROM
	bool "ZTE S5K3L6_035 Calibration support"
	depends on MSMB_CAMERA
	default n
	help
	  Enable support for ROM Interface for Calibration
	  Provides interface for reading the Claibration data.
	  and also provides support for writing data in case of FLASH ROM.
	  Currently supports CCI  protocol

config OV13855_035_EEPROM
	bool "ZTE OV13855_035 Calibration support"
	depends on MSMB_CAMERA
	default n
	help
	  Enable support for ROM Interface for Calibration
	  Provides interface for reading the Claibration data.
	  and also provides support for writing data in case of FLASH ROM.
	  Currently supports CCI  protocol

config OV16885_4C_039_EEPROM
	bool "ZTE OV16885_4C_039 Calibration support"
	depends on MSMB_CAMERA
	help
	  Enable support for ROM Interface for Calibration
	  Provides interface for reading the Claibration data.
	  and also provides support for writing data in case of FLASH ROM.
	  Currently supports CCI  protocol

config OV16885_Z6450T_041_EEPROM
	bool "ZTE OV16885_Z6450T_041 Calibration support"
	depends on MSMB_CAMERA
	help
	  Enable support for ROM Interface for Calibration
	  Provides interface for reading the Claibration data.
	  and also provides support for writing data in case of FLASH ROM.
	  Currently supports CCI  protocol

config SP2509V_Z6450T_090_EEPROM
	bool "ZTE SP2509V_Z6450T_090 Calibration support"
	depends on MSMB_CAMERA
	help
	  Enable support for ROM Interface for Calibration
	  Provides interface for reading the Claibration data.
	  and also provides support for writing data in case of FLASH ROM.
	  Currently supports CCI  protocol

config HI846_131_EEPROM
	bool "ZTE HI846_131 Calibration support"
	depends on MSMB_CAMERA
	default n
	help
	  Enable support for ROM Interface for Calibration
	  Provides interface for reading the Claibration data.
	  and also provides support for writing data in case of FLASH ROM.
	  Currently supports CCI  protocol

config S5K4H7_131_EEPROM
	bool "ZTE S5K4H7_131 Calibration support"
	depends on MSMB_CAMERA
	default n
	help
	  Enable support for ROM Interface for Calibration
	  Provides interface for reading the Claibration data.
	  and also provides support for writing data in case of FLASH ROM.
	  Currently supports CCI  protocol
```

## drivers/video/msm/Kconfig
```kconfig
source "drivers/video/msm/ba/Kconfig"
source "drivers/video/msm/msm_dba/Kconfig"

if FB_MSM
config FB_MSM_MDSS_COMMON
	bool

choice
	prompt "MDP HW version"
	default FB_MSM_MDP

config FB_MSM_MDP
	bool "MDP HW"
	---help---
	  Support for MSM MDP HW revision 2.2
	  Say Y here if this is msm7201 variant platform.

config FB_MSM_MDSS
	bool "MDSS HW"
	select SYNC
	select SW_SYNC
	select FB_MSM_MDSS_COMMON
	---help---
	The Mobile Display Sub System (MDSS) driver supports devices which
	contain MDSS hardware block.

	The MDSS driver implements frame buffer interface to provide access to
	the display hardware and provide a way for users to display graphics
	on connected display panels.

config FB_MSM_MDP_NONE
	bool "MDP HW None"
	---help---
	  Say Y here if this is mdm platform.

endchoice

config FB_MSM_QPIC
	bool
	select FB_MSM_MDSS_COMMON

config FB_MSM_QPIC_ILI_QVGA_PANEL
	bool "Qpic MIPI ILI QVGA Panel"
	select FB_MSM_QPIC
	---help---
	  Support for MIPI ILI QVGA (240x320) panel
	  ILI TECHNOLOGY 9341
	  with on-chip full display RAM
	  use parallel interface

config FB_MSM_QPIC_PANEL_DETECT
	bool "Qpic Panel Detect"
	select FB_MSM_QPIC_ILI_QVGA_PANEL
	---help---
	  Support for Qpic panel auto detect

if FB_MSM_MDSS
	source "drivers/video/msm/mdss/Kconfig"
endif

#/*zte add for lcd common function begin */
config ZTE_LCD_COMMON_FUNCTION
	bool "Support for ZTE lcd common function"
	default y

config ZTE_LCD_BACKLIGHT_LEVEL_CURVE
	depends on ZTE_LCD_COMMON_FUNCTION
	bool "Support for ZTE lcd backlight curve"

config ZTE_LCD_VDDIO_ALWAYS_ON
	depends on ZTE_LCD_COMMON_FUNCTION
	bool "Support for ZTE lcd vddio always on"

config ZTE_LCD_REG_DEBUG
	depends on ZTE_LCD_COMMON_FUNCTION
	bool "Support lcd register debug in root version"

config ZTE_LCD_GPIO_CTRL_POWER
	depends on ZTE_LCD_COMMON_FUNCTION
	bool "Support for ZTE gpio power ctrl"

config ZTE_LCDBL_I2C_CTRL_VSP_VSN
	depends on ZTE_LCD_COMMON_FUNCTION
	bool "Support for ZTE vsp vsn power ctrl"

config ZTE_LCD_DCSBL_CABC_GRADIENT
	depends on ZTE_LCD_COMMON_FUNCTION
	bool "Support for ZTE dcs bl cabc gradient effect"

config ZTE_LCD_CHANGE_IC_PAGE
	depends on ZTE_LCD_COMMON_FUNCTION
	bool "Support for change lcd ic page"

config ZTE_LCD_ESD_ERROR_CTRL
	bool "Support for lcd esd check error ctrl"
	default n

config ZTE_LCD_CABC3_EXTREME_POWER_SAVE
	depends on ZTE_LCD_COMMON_FUNCTION
	bool "Support for ZTE extreme power save modem cabc"

config ZTE_LCD_CLOSE_CABC_GRADIENT_BEFORESLEEP
	depends on ZTE_LCD_COMMON_FUNCTION
	bool "Support for ZTE close cabc gradient before sleep for jd9161b"

config ZTE_LCD_RESET_PIN_CTRL
	depends on ZTE_LCD_COMMON_FUNCTION
	bool "Support for lcd reset pin ctrl"

config ZTE_FB_ASYNC_RESUME
	bool "Support fb async resume"
	default n

config ZTE_MM_PP_DPPS_FB_RELEASE_ERR
	bool "Support fb release error"
	default n

#/*zte add for lcd common function end */
endif
```
