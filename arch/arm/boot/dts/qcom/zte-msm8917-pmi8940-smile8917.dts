/*
 * Copyright (c) 2016, The Linux Foundation. All rights reserved.
 *
 * This program is free software; you can redistribute it and/or modify
 * it under the terms of the GNU General Public License version 2 and
 * only version 2 as published by the Free Software Foundation.
 *
 * This program is distributed in the hope that it will be useful,
 * but WITHOUT ANY WARRANTY; without even the implied warranty of
 * MERCHANTABILITY or FITNESS FOR A PARTICULAR PURPOSE.  See the
 * GNU General Public License for more details.
 */

/dts-v1/;

#include "msm8917.dtsi"
#include "msm8917-pmi8940-mtp.dtsi"
#include "zte-msm8917-pmi8940-smile8917.dtsi"
#include "zte-msm8917-camera-sensor-smile8917.dtsi"

/ {
	model = "Qualcomm Technologies, Inc. MSM8917-PMI8940 SMILE";
	compatible = "qcom,msm8917-mtp", "qcom,msm8917", "qcom,mtp";
	qcom,board-id= <208 0>;
	qcom,pmic-id = <0x10019 0x020011 0x0 0x0>, <0x10000 0x020011 0x0 0x0>;
};
