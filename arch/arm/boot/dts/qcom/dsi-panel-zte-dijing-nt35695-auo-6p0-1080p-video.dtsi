/* Copyright (c) 2015, The Linux Foundation. All rights reserved.
 *
 * This program is free software; you can redistribute it and/or modify
 * it under the terms of the GNU General Public License version 2 and
 * only version 2 as published by the Free Software Foundation.
 *
 * This program is distributed in the hope that it will be useful,
 * but WITHOUT ANY WARRANTY; without even the implied warranty of
 * MERCHANTABILITY or FITNESS FOR A PARTICULAR PURPOSE.  See the
 * GNU General Public License for more details.
 */

&mdss_mdp {
	dsi_dijing_nt35695_auo_6p0_1080P_video_vid: qcom,mdss_dsi_dijing_nt35695_auo_6p0_1080p_video {
		qcom,mdss-dsi-panel-name = "zteDJ(NT35695)AUO_1080*1920_6P0Inch";
		qcom,mdss-dsi-panel-type = "dsi_cmd_mode";
		qcom,cont-splash-enabled;
		qcom,mdss-pan-physical-width-dimension = <75>;
		qcom,mdss-pan-physical-height-dimension = <132>;
		qcom,mdss-dsi-panel-framerate = <60>;
		qcom,mdss-dsi-virtual-channel-id = <0>;
		qcom,mdss-dsi-stream = <0>;
		qcom,mdss-dsi-panel-width = <1080>;
		qcom,mdss-dsi-panel-height = <1920>;
		qcom,mdss-dsi-h-front-porch = <80>;	//mipi clk:862.44M 2016.10.01
		qcom,mdss-dsi-h-back-porch = <60>;
		qcom,mdss-dsi-h-pulse-width = <20>;
		qcom,mdss-dsi-h-sync-skew = <0>;
		qcom,mdss-dsi-v-back-porch = <4>;
		qcom,mdss-dsi-v-front-porch = <6>;
		qcom,mdss-dsi-v-pulse-width = <2>;
		qcom,mdss-dsi-h-left-border = <0>;
		qcom,mdss-dsi-h-right-border = <0>;
		qcom,mdss-dsi-v-top-border = <0>;
		qcom,mdss-dsi-v-bottom-border = <0>;
		qcom,mdss-dsi-bpp = <24>;
		qcom,mdss-dsi-underflow-color = <0xff>;
		qcom,mdss-dsi-border-color = <0>;
		qcom,mdss-dsi-h-sync-pulse = <0>;
		qcom,mdss-dsi-traffic-mode = "burst_mode";

		qcom,mdss-dsi-te-pin-select = <1>;
		qcom,mdss-dsi-te-dcs-command = <1>;
		qcom,mdss-dsi-te-check-enable;
		qcom,mdss-dsi-te-using-te-pin;
		qcom,mdss-dsi-wr-mem-start = <0x2c>;
		qcom,mdss-dsi-wr-mem-continue = <0x3c>;

		qcom,mdss-dsi-bllp-eof-power-mode;
		qcom,mdss-dsi-bllp-power-mode;
		qcom,mdss-dsi-lane-0-state;
		qcom,mdss-dsi-lane-1-state;
		qcom,mdss-dsi-lane-2-state;
		qcom,mdss-dsi-lane-3-state;
		qcom,mdss-dsi-panel-timings = [E2 36 24 00 66 68 2A 38 2A 03 04 00];
		qcom,mdss-dsi-t-clk-post = <0x23>;// 02 ,23-383ns,nt35695 > 350ns
		qcom,mdss-dsi-t-clk-pre = <0x2A>;
		qcom,mdss-dsi-bl-min-level = <1>;
		qcom,mdss-dsi-bl-max-level = <255>;
		qcom,mdss-dsi-dma-trigger = "trigger_sw";
		qcom,mdss-dsi-mdp-trigger = "none";

		qcom,mdss-dsi-lp11-init;
		qcom,mdss-dsi-init-delay-us=<10000>;

		zte,panel-keep-reset-gpio-high;//pan,keep reset gpio high 0620

		qcom,mdss-dsi-on-command = [

		39 01 00 00 00 00 02 ff 20
		39 01 00 00 00 00 02 fb 01
		39 01 00 00 00 00 02 00 01
		39 01 00 00 00 00 02 01 55
		39 01 00 00 00 00 02 02 45
		39 01 00 00 00 00 02 03 55
		39 01 00 00 00 00 02 05 40
		39 01 00 00 00 00 02 06 99
		39 01 00 00 00 00 02 07 9e
		39 01 00 00 00 00 02 08 0c
		39 01 00 00 00 00 02 0b 87
		39 01 00 00 00 00 02 0c 87
		39 01 00 00 00 00 02 0e ab
		39 01 00 00 00 00 02 0f a9
		39 01 00 00 00 00 02 13 03
		39 01 00 00 00 00 02 14 4a
		39 01 00 00 00 00 02 15 12
		39 01 00 00 00 00 02 16 12
		39 01 00 00 00 00 02 30 01
		39 01 00 00 00 00 02 58 00
		39 01 00 00 00 00 02 59 00
		39 01 00 00 00 00 02 5a 02
		39 01 00 00 00 00 02 5b 00
		39 01 00 00 00 00 02 5c 00
		39 01 00 00 00 00 02 5d 00
		39 01 00 00 00 00 02 5e 02
		39 01 00 00 00 00 02 5f 02
		39 01 00 00 00 00 02 72 31
		39 01 00 00 00 00 02 fb 01
		39 01 00 00 00 00 02 ff 24
		39 01 00 00 00 00 02 fb 01
		39 01 00 00 00 00 02 00 01
		39 01 00 00 00 00 02 01 0b
		39 01 00 00 00 00 02 02 0c
		39 01 00 00 00 00 02 03 03
		39 01 00 00 00 00 02 04 05
		39 01 00 00 00 00 02 05 1c
		39 01 00 00 00 00 02 06 10
		39 01 00 00 00 00 02 07 00
		39 01 00 00 00 00 02 08 1c
		39 01 00 00 00 00 02 09 00
		39 01 00 00 00 00 02 0a 00
		39 01 00 00 00 00 02 0b 00
		39 01 00 00 00 00 02 0c 00
		39 01 00 00 00 00 02 0d 13
		39 01 00 00 00 00 02 0e 15
		39 01 00 00 00 00 02 0f 17
		39 01 00 00 00 00 02 10 01
		39 01 00 00 00 00 03 11 0b 00
		39 01 00 00 00 00 02 12 0c
		39 01 00 00 00 00 02 13 04
		39 01 00 00 00 00 02 14 06
		39 01 00 00 00 00 02 15 1c
		39 01 00 00 00 00 02 16 10
		39 01 00 00 00 00 02 17 00
		39 01 00 00 00 00 02 18 1c
		39 01 00 00 00 00 02 19 00
		39 01 00 00 00 00 02 1a 00
		39 01 00 00 00 00 02 1b 00
		39 01 00 00 00 00 02 1c 00
		39 01 00 00 00 00 02 1d 13
		39 01 00 00 00 00 02 1e 15
		39 01 00 00 00 00 02 1f 17
		39 01 00 00 00 00 02 20 00
		39 01 00 00 00 00 02 21 03
		39 01 00 00 00 00 02 22 01
		39 01 00 00 00 00 02 23 4a
		39 01 00 00 00 00 02 24 4a
		39 01 00 00 00 00 02 25 6d
		39 01 00 00 00 00 02 26 40
		39 01 00 00 00 00 02 32 7b
		39 01 00 00 00 00 02 33 00
		39 01 00 00 00 00 02 34 01
		39 01 00 00 00 00 02 35 8e
		39 01 00 00 00 00 02 39 01
		39 01 00 00 00 00 02 3a 8e
		39 01 00 00 00 00 02 bd 20
		39 01 00 00 00 00 02 b6 22
		39 01 00 00 00 00 02 b7 24
		39 01 00 00 00 00 02 b8 07
		39 01 00 00 00 00 02 b9 07
		39 01 00 00 00 00 02 c1 6d
		39 01 00 00 00 00 02 be 07
		39 01 00 00 00 00 02 bf 07
		39 01 00 00 00 00 03 29 d8 00
		39 01 00 00 00 00 02 2a 2a
		39 01 00 00 00 00 02 5b 43
		39 01 00 00 00 00 02 5c 00
		39 01 00 00 00 00 02 5f 73
		39 01 00 00 00 00 02 60 73
		39 01 00 00 00 00 02 63 22
		39 01 00 00 00 00 02 64 00
		39 01 00 00 00 00 02 67 08
		39 01 00 00 00 00 02 68 04
		39 01 00 00 00 00 02 7a 80
		39 01 00 00 00 00 02 7b 91
		39 01 00 00 00 00 02 7c d8
		39 01 00 00 00 00 02 7d 60
		39 01 00 00 00 00 02 74 09
		39 01 00 00 00 00 02 7e 09
		39 01 00 00 00 00 02 75 21
		39 01 00 00 00 00 02 7f 21
		39 01 00 00 00 00 02 76 05
		39 01 00 00 00 00 02 81 05
		39 01 00 00 00 00 02 77 04
		39 01 00 00 00 00 02 82 04
		39 01 00 00 00 00 02 93 06
		39 01 00 00 00 00 02 94 06
		39 01 00 00 00 00 02 b3 00
		39 01 00 00 00 00 02 b4 00
		39 01 00 00 00 00 02 b5 00
		39 01 00 00 00 00 02 78 00
		39 01 00 00 00 00 02 79 00
		39 01 00 00 00 00 02 80 00
		39 01 00 00 00 00 02 83 00
		39 01 00 00 00 00 02 84 04
		39 01 00 00 00 00 02 8a 33
		39 01 00 00 00 00 02 8b f0
		39 01 00 00 00 00 02 9b 0f
		39 01 00 00 00 00 02 c6 09
		39 01 00 00 00 00 02 fb 01
		39 01 00 00 00 00 02 ec 00
		39 01 00 00 00 00 02 ff 20
		39 01 00 00 00 00 02 fb 01
		39 01 00 00 00 00 02 75 00
		39 01 00 00 00 00 02 76 49
		39 01 00 00 00 00 02 77 00
		39 01 00 00 00 00 02 78 78
		39 01 00 00 00 00 02 79 00
		39 01 00 00 00 00 02 7a a4
		39 01 00 00 00 00 02 7b 00
		39 01 00 00 00 00 02 7c c2
		39 01 00 00 00 00 02 7d 00
		39 01 00 00 00 00 02 7e da
		39 01 00 00 00 00 02 7f 00
		39 01 00 00 00 00 02 80 ed
		39 01 00 00 00 00 02 81 00
		39 01 00 00 00 00 02 82 fe
		39 01 00 00 00 00 02 83 01
		39 01 00 00 00 00 02 84 0e
		39 01 00 00 00 00 02 85 01
		39 01 00 00 00 00 02 86 1b
		39 01 00 00 00 00 02 87 01
		39 01 00 00 00 00 02 88 48
		39 01 00 00 00 00 02 89 01
		39 01 00 00 00 00 02 8a 6c
		39 01 00 00 00 00 02 8b 01
		39 01 00 00 00 00 02 8c a2
		39 01 00 00 00 00 02 8d 01
		39 01 00 00 00 00 02 8e cd
		39 01 00 00 00 00 02 8f 02
		39 01 00 00 00 00 02 90 0f
		39 01 00 00 00 00 02 91 02
		39 01 00 00 00 00 02 92 42
		39 01 00 00 00 00 02 93 02
		39 01 00 00 00 00 02 94 43
		39 01 00 00 00 00 02 95 02
		39 01 00 00 00 00 02 96 71
		39 01 00 00 00 00 02 97 02
		39 01 00 00 00 00 02 98 a3
		39 01 00 00 00 00 02 99 02
		39 01 00 00 00 00 02 9a c5
		39 01 00 00 00 00 02 9b 02
		39 01 00 00 00 00 02 9c f3
		39 01 00 00 00 00 02 9d 03
		39 01 00 00 00 00 02 9e 12
		39 01 00 00 00 00 02 9f 03
		39 01 00 00 00 00 02 a0 3a
		39 01 00 00 00 00 02 a2 03
		39 01 00 00 00 00 02 a3 46
		39 01 00 00 00 00 02 a4 03
		39 01 00 00 00 00 02 a5 52
		39 01 00 00 00 00 02 a6 03
		39 01 00 00 00 00 02 a7 60
		39 01 00 00 00 00 02 a9 03
		39 01 00 00 00 00 02 aa 6e
		39 01 00 00 00 00 02 ab 03
		39 01 00 00 00 00 02 ac 7d
		39 01 00 00 00 00 02 ad 03
		39 01 00 00 00 00 02 ae 8b
		39 01 00 00 00 00 02 af 03
		39 01 00 00 00 00 02 b0 91
		39 01 00 00 00 00 02 b1 03
		39 01 00 00 00 00 02 b2 cf
		39 01 00 00 00 00 02 b3 00
		39 01 00 00 00 00 02 b4 49
		39 01 00 00 00 00 02 b5 00
		39 01 00 00 00 00 02 b6 78
		39 01 00 00 00 00 02 b7 00
		39 01 00 00 00 00 02 b8 a4
		39 01 00 00 00 00 02 b9 00
		39 01 00 00 00 00 02 ba c2
		39 01 00 00 00 00 02 bb 00
		39 01 00 00 00 00 02 bc da
		39 01 00 00 00 00 02 bd 00
		39 01 00 00 00 00 02 be ed
		39 01 00 00 00 00 02 bf 00
		39 01 00 00 00 00 02 c0 fe
		39 01 00 00 00 00 02 c1 01
		39 01 00 00 00 00 02 c2 0e
		39 01 00 00 00 00 02 c3 01
		39 01 00 00 00 00 02 c4 1b
		39 01 00 00 00 00 02 c5 01
		39 01 00 00 00 00 02 c6 48
		39 01 00 00 00 00 02 c7 01
		39 01 00 00 00 00 02 c8 6c
		39 01 00 00 00 00 02 c9 01
		39 01 00 00 00 00 02 ca a2
		39 01 00 00 00 00 02 cb 01
		39 01 00 00 00 00 02 cc cd
		39 01 00 00 00 00 02 cd 02
		39 01 00 00 00 00 02 ce 0f
		39 01 00 00 00 00 02 cf 02
		39 01 00 00 00 00 02 d0 42
		39 01 00 00 00 00 02 d1 02
		39 01 00 00 00 00 02 d2 43
		39 01 00 00 00 00 02 d3 02
		39 01 00 00 00 00 02 d4 71
		39 01 00 00 00 00 02 d5 02
		39 01 00 00 00 00 02 d6 a3
		39 01 00 00 00 00 02 d7 02
		39 01 00 00 00 00 02 d8 c5
		39 01 00 00 00 00 02 d9 02
		39 01 00 00 00 00 02 da f3
		39 01 00 00 00 00 02 db 03
		39 01 00 00 00 00 02 dc 12
		39 01 00 00 00 00 02 dd 03
		39 01 00 00 00 00 02 de 3a
		39 01 00 00 00 00 02 df 03
		39 01 00 00 00 00 02 e0 46
		39 01 00 00 00 00 02 e1 03
		39 01 00 00 00 00 02 e2 52
		39 01 00 00 00 00 02 e3 03
		39 01 00 00 00 00 02 e4 60
		39 01 00 00 00 00 02 e5 03
		39 01 00 00 00 00 02 e6 6e
		39 01 00 00 00 00 02 e7 03
		39 01 00 00 00 00 02 e8 7d
		39 01 00 00 00 00 02 e9 03
		39 01 00 00 00 00 02 ea 8b
		39 01 00 00 00 00 02 eb 03
		39 01 00 00 00 00 02 ec 91
		39 01 00 00 00 00 02 ed 03
		39 01 00 00 00 00 02 ee cf
		39 01 00 00 00 00 02 ef 00
		39 01 00 00 00 00 02 f0 49
		39 01 00 00 00 00 02 f1 00
		39 01 00 00 00 00 02 f2 78
		39 01 00 00 00 00 02 f3 00
		39 01 00 00 00 00 02 f4 a4
		39 01 00 00 00 00 02 f5 00
		39 01 00 00 00 00 02 f6 c2
		39 01 00 00 00 00 02 f7 00
		39 01 00 00 00 00 02 f8 da
		39 01 00 00 00 00 02 f9 00
		39 01 00 00 00 00 02 fa ed
		39 01 00 00 00 00 02 ff 21
		39 01 00 00 00 00 02 fb 01
		39 01 00 00 00 00 02 00 00
		39 01 00 00 00 00 02 01 fe
		39 01 00 00 00 00 02 02 01
		39 01 00 00 00 00 02 03 0e
		39 01 00 00 00 00 02 04 01
		39 01 00 00 00 00 02 05 1b
		39 01 00 00 00 00 02 06 01
		39 01 00 00 00 00 02 07 48
		39 01 00 00 00 00 02 08 01
		39 01 00 00 00 00 02 09 6c
		39 01 00 00 00 00 02 0a 01
		39 01 00 00 00 00 02 0b a2
		39 01 00 00 00 00 02 0c 01
		39 01 00 00 00 00 02 0d cd
		39 01 00 00 00 00 02 0e 02
		39 01 00 00 00 00 02 0f 0f
		39 01 00 00 00 00 02 10 02
		39 01 00 00 00 00 03 11 42 00
		39 01 00 00 00 00 02 12 02
		39 01 00 00 00 00 02 13 43
		39 01 00 00 00 00 02 14 02
		39 01 00 00 00 00 02 15 71
		39 01 00 00 00 00 02 16 02
		39 01 00 00 00 00 02 17 a3
		39 01 00 00 00 00 02 18 02
		39 01 00 00 00 00 02 19 c5
		39 01 00 00 00 00 02 1a 02
		39 01 00 00 00 00 02 1b f3
		39 01 00 00 00 00 02 1c 03
		39 01 00 00 00 00 02 1d 12
		39 01 00 00 00 00 02 1e 03
		39 01 00 00 00 00 02 1f 3a
		39 01 00 00 00 00 02 20 03
		39 01 00 00 00 00 02 21 46
		39 01 00 00 00 00 02 22 03
		39 01 00 00 00 00 02 23 52
		39 01 00 00 00 00 02 24 03
		39 01 00 00 00 00 02 25 60
		39 01 00 00 00 00 02 26 03
		39 01 00 00 00 00 02 27 6e
		39 01 00 00 00 00 02 28 03
		39 01 00 00 00 00 03 29 7d 00
		39 01 00 00 00 00 02 2a 03
		39 01 00 00 00 00 02 2b 8b
		39 01 00 00 00 00 02 2d 03
		39 01 00 00 00 00 02 2f 91
		39 01 00 00 00 00 02 30 03
		39 01 00 00 00 00 02 31 cf
		39 01 00 00 00 00 02 32 00
		39 01 00 00 00 00 02 33 49
		39 01 00 00 00 00 02 34 00
		39 01 00 00 00 00 02 35 78
		39 01 00 00 00 00 02 36 00
		39 01 00 00 00 00 02 37 a4
		39 01 00 00 00 00 02 38 00
		39 01 00 00 00 00 02 39 c2
		39 01 00 00 00 00 02 3a 00
		39 01 00 00 00 00 02 3b da
		39 01 00 00 00 00 02 3d 00
		39 01 00 00 00 00 02 3f ed
		39 01 00 00 00 00 02 40 00
		39 01 00 00 00 00 02 41 fe
		39 01 00 00 00 00 02 42 01
		39 01 00 00 00 00 02 43 0e
		39 01 00 00 00 00 02 44 01
		39 01 00 00 00 00 02 45 1b
		39 01 00 00 00 00 02 46 01
		39 01 00 00 00 00 02 47 48
		39 01 00 00 00 00 02 48 01
		39 01 00 00 00 00 02 49 6c
		39 01 00 00 00 00 02 4a 01
		39 01 00 00 00 00 02 4b a2
		39 01 00 00 00 00 02 4c 01
		39 01 00 00 00 00 02 4d cd
		39 01 00 00 00 00 02 4e 02
		39 01 00 00 00 00 02 4f 0f
		39 01 00 00 00 00 02 50 02
		39 01 00 00 00 00 02 51 42
		39 01 00 00 00 00 02 52 02
		39 01 00 00 00 00 02 53 43
		39 01 00 00 00 00 02 54 02
		39 01 00 00 00 00 02 55 71
		39 01 00 00 00 00 02 56 02
		39 01 00 00 00 00 02 58 a3
		39 01 00 00 00 00 02 59 02
		39 01 00 00 00 00 02 5a c5
		39 01 00 00 00 00 02 5b 02
		39 01 00 00 00 00 02 5c f3
		39 01 00 00 00 00 02 5d 03
		39 01 00 00 00 00 02 5e 12
		39 01 00 00 00 00 02 5f 03
		39 01 00 00 00 00 02 60 3a
		39 01 00 00 00 00 02 61 03
		39 01 00 00 00 00 02 62 46
		39 01 00 00 00 00 02 63 03
		39 01 00 00 00 00 02 64 52
		39 01 00 00 00 00 02 65 03
		39 01 00 00 00 00 02 66 60
		39 01 00 00 00 00 02 67 03
		39 01 00 00 00 00 02 68 6e
		39 01 00 00 00 00 02 69 03
		39 01 00 00 00 00 02 6a 7d
		39 01 00 00 00 00 02 6b 03
		39 01 00 00 00 00 02 6c 8b
		39 01 00 00 00 00 02 6d 03
		39 01 00 00 00 00 02 6e 91
		39 01 00 00 00 00 02 6f 03
		39 01 00 00 00 00 02 70 cf
		39 01 00 00 00 00 02 71 00
		39 01 00 00 00 00 02 72 49
		39 01 00 00 00 00 02 73 00
		39 01 00 00 00 00 02 74 78
		39 01 00 00 00 00 02 75 00
		39 01 00 00 00 00 02 76 a4
		39 01 00 00 00 00 02 77 00
		39 01 00 00 00 00 02 78 c2
		39 01 00 00 00 00 02 79 00
		39 01 00 00 00 00 02 7a da
		39 01 00 00 00 00 02 7b 00
		39 01 00 00 00 00 02 7c ed
		39 01 00 00 00 00 02 7d 00
		39 01 00 00 00 00 02 7e fe
		39 01 00 00 00 00 02 7f 01
		39 01 00 00 00 00 02 80 0e
		39 01 00 00 00 00 02 81 01
		39 01 00 00 00 00 02 82 1b
		39 01 00 00 00 00 02 83 01
		39 01 00 00 00 00 02 84 48
		39 01 00 00 00 00 02 85 01
		39 01 00 00 00 00 02 86 6c
		39 01 00 00 00 00 02 87 01
		39 01 00 00 00 00 02 88 a2
		39 01 00 00 00 00 02 89 01
		39 01 00 00 00 00 02 8a cd
		39 01 00 00 00 00 02 8b 02
		39 01 00 00 00 00 02 8c 0f
		39 01 00 00 00 00 02 8d 02
		39 01 00 00 00 00 02 8e 42
		39 01 00 00 00 00 02 8f 02
		39 01 00 00 00 00 02 90 43
		39 01 00 00 00 00 02 91 02
		39 01 00 00 00 00 02 92 71
		39 01 00 00 00 00 02 93 02
		39 01 00 00 00 00 02 94 a3
		39 01 00 00 00 00 02 95 02
		39 01 00 00 00 00 02 96 c5
		39 01 00 00 00 00 02 97 02
		39 01 00 00 00 00 02 98 f3
		39 01 00 00 00 00 02 99 03
		39 01 00 00 00 00 02 9a 12
		39 01 00 00 00 00 02 9b 03
		39 01 00 00 00 00 02 9c 3a
		39 01 00 00 00 00 02 9d 03
		39 01 00 00 00 00 02 9e 46
		39 01 00 00 00 00 02 9f 03
		39 01 00 00 00 00 02 a0 52
		39 01 00 00 00 00 02 a2 03
		39 01 00 00 00 00 02 a3 60
		39 01 00 00 00 00 02 a4 03
		39 01 00 00 00 00 02 a5 6e
		39 01 00 00 00 00 02 a6 03
		39 01 00 00 00 00 02 a7 7d
		39 01 00 00 00 00 02 a9 03
		39 01 00 00 00 00 02 aa 8b
		39 01 00 00 00 00 02 ab 03
		39 01 00 00 00 00 02 ac 91
		39 01 00 00 00 00 02 ad 03
		39 01 00 00 00 00 02 ae cf
		39 01 00 00 00 00 02 af 00
		39 01 00 00 00 00 02 b0 49
		39 01 00 00 00 00 02 b1 00
		39 01 00 00 00 00 02 b2 78
		39 01 00 00 00 00 02 b3 00
		39 01 00 00 00 00 02 b4 a4
		39 01 00 00 00 00 02 b5 00
		39 01 00 00 00 00 02 b6 c2
		39 01 00 00 00 00 02 b7 00
		39 01 00 00 00 00 02 b8 da
		39 01 00 00 00 00 02 b9 00
		39 01 00 00 00 00 02 ba ed
		39 01 00 00 00 00 02 bb 00
		39 01 00 00 00 00 02 bc fe
		39 01 00 00 00 00 02 bd 01
		39 01 00 00 00 00 02 be 0e
		39 01 00 00 00 00 02 bf 01
		39 01 00 00 00 00 02 c0 1b
		39 01 00 00 00 00 02 c1 01
		39 01 00 00 00 00 02 c2 48
		39 01 00 00 00 00 02 c3 01
		39 01 00 00 00 00 02 c4 6c
		39 01 00 00 00 00 02 c5 01
		39 01 00 00 00 00 02 c6 a2
		39 01 00 00 00 00 02 c7 01
		39 01 00 00 00 00 02 c8 cd
		39 01 00 00 00 00 02 c9 02
		39 01 00 00 00 00 02 ca 0f
		39 01 00 00 00 00 02 cb 02
		39 01 00 00 00 00 02 cc 42
		39 01 00 00 00 00 02 cd 02
		39 01 00 00 00 00 02 ce 43
		39 01 00 00 00 00 02 cf 02
		39 01 00 00 00 00 02 d0 71
		39 01 00 00 00 00 02 d1 02
		39 01 00 00 00 00 02 d2 a3
		39 01 00 00 00 00 02 d3 02
		39 01 00 00 00 00 02 d4 c5
		39 01 00 00 00 00 02 d5 02
		39 01 00 00 00 00 02 d6 f3
		39 01 00 00 00 00 02 d7 03
		39 01 00 00 00 00 02 d8 12
		39 01 00 00 00 00 02 d9 03
		39 01 00 00 00 00 02 da 3a
		39 01 00 00 00 00 02 db 03
		39 01 00 00 00 00 02 dc 46
		39 01 00 00 00 00 02 dd 03
		39 01 00 00 00 00 02 de 52
		39 01 00 00 00 00 02 df 03
		39 01 00 00 00 00 02 e0 60
		39 01 00 00 00 00 02 e1 03
		39 01 00 00 00 00 02 e2 6e
		39 01 00 00 00 00 02 e3 03
		39 01 00 00 00 00 02 e4 7d
		39 01 00 00 00 00 02 e5 03
		39 01 00 00 00 00 02 e6 8b
		39 01 00 00 00 00 02 e7 03
		39 01 00 00 00 00 02 e8 91
		39 01 00 00 00 00 02 e9 03
		39 01 00 00 00 00 02 ea cf
		39 01 00 00 00 00 02 ff 23
		39 01 00 00 00 00 02 fb 01
		39 01 00 00 00 00 02 07 20
		39 01 00 00 00 00 02 08 03
		39 01 00 00 00 00 02 46 20
		39 01 00 00 00 00 02 fb 01
		39 01 00 00 00 00 02 ff 10
		39 01 00 00 00 00 02 fb 01
		//39 01 00 00 00 00 02 51 ff
		39 01 00 00 00 00 02 53 24
		39 01 00 00 00 00 02 55 00
		39 01 00 00 00 00 02 ff 10
		39 01 00 00 00 00 02 fb 01
		39 01 00 00 00 00 02 35 00
		39 01 00 00 00 00 03 44 03 e8
		39 01 00 00 00 00 04 3b 03 06 06
		39 01 00 00 00 00 02 ff 10
		39 01 00 00 00 00 02 fb 01
		39 01 00 00 00 00 02 bb 10
		39 01 00 00 00 00 02 fb 01
		39 01 00 00 c8 00 02 11 00
		39 01 00 00 32 00 02 29 00

		];
		qcom,mdss-dsi-off-command = [
		05 01 00 00 96 00 02 28 00
		05 01 00 00 96 00 02 10 00
		39 01 00 00 00 00 02 4f 01 //pan ,send for deep sleep while keep rst high 0620
		];
		qcom,mdss-dsi-on-command-state = "dsi_lp_mode";
		qcom,mdss-dsi-off-command-state = "dsi_hs_mode";
		qcom,mdss-dsi-bl-pmic-control-type ="bl_ctrl_dcs";
		qcom,mdss-dsi-reset-sequence = <1 20>, <0 20>, <1 20>;
		//qcom,mdss-dsi-tx-eot-append;
	};
};
