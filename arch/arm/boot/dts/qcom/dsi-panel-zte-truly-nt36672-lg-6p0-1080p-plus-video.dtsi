/* Copyright (c) 2015, The Linux Foundation. All rights reserved.
 *
 * This program is free software; you can redistribute it and/or modify
 * it under the terms of the GNU General Public License version 2 and
 * only version 2 as published by the Free Software Foundation.
 *
 * This program is distributed in the hope that it will be useful,
 * but WITHOUT ANY WARRANTY; without even the implied warranty of
 * MERCHANTABILITY or FITNESS FOR A PARTICULAR PURPOSE.  See the
 * GNU General Public License for more details.
 */

&mdss_mdp {
	dsi_truly_nt36672_lg_6p0_1080p_plus_video_vid: qcom,mdss_dsi_truly_nt36672_lgd_5p99_1080p_plus_video {
		qcom,mdss-dsi-panel-name = "zteTRULY(NT36672)LG_1080*2160_6P0Inch";
		qcom,mdss-dsi-panel-type = "dsi_video_mode";
		qcom,cont-splash-enabled;
		qcom,mdss-pan-physical-width-dimension = <68>;
		qcom,mdss-pan-physical-height-dimension = <139>;
		qcom,mdss-dsi-panel-framerate = <60>;
		qcom,mdss-dsi-virtual-channel-id = <0>;
		qcom,mdss-dsi-stream = <0>;
		qcom,mdss-dsi-panel-width = <1080>;
		qcom,mdss-dsi-panel-height = <2160>;
		qcom,mdss-dsi-h-front-porch = <47>;	//mipi clk :928M
		qcom,mdss-dsi-h-back-porch = <46>;
		qcom,mdss-dsi-h-pulse-width = <10>;
		qcom,mdss-dsi-h-sync-skew = <0>;
		qcom,mdss-dsi-v-back-porch = <8>;
		qcom,mdss-dsi-v-front-porch = <10>;
		qcom,mdss-dsi-v-pulse-width = <2>;
		qcom,mdss-dsi-h-left-border = <0>;
		qcom,mdss-dsi-h-right-border = <0>;
		qcom,mdss-dsi-v-top-border = <0>;
		qcom,mdss-dsi-v-bottom-border = <0>;
		qcom,mdss-dsi-bpp = <24>;
		qcom,mdss-dsi-underflow-color = <0xff>;
		qcom,mdss-dsi-border-color = <0>;
		qcom,mdss-dsi-h-sync-pulse = <0>;
		qcom,mdss-dsi-traffic-mode = "burst_mode";
		qcom,mdss-dsi-bllp-eof-power-mode;
		qcom,mdss-dsi-bllp-power-mode;
		qcom,mdss-dsi-lp11-init;
		qcom,mdss-dsi-lane-0-state;
		qcom,mdss-dsi-lane-1-state;
		qcom,mdss-dsi-lane-2-state;
		qcom,mdss-dsi-lane-3-state;
		qcom,mdss-dsi-panel-timings = [f2 3a 28 00 6c 6e 2c 3e 2e 03 04 00];
		qcom,mdss-dsi-t-clk-post = <0x2>;
		qcom,mdss-dsi-t-clk-pre = <0x2d>;
		qcom,mdss-dsi-bl-min-level = <1>;
		qcom,mdss-dsi-bl-max-level = <255>;
		qcom,mdss-dsi-dma-trigger = "trigger_sw";
		qcom,mdss-dsi-mdp-trigger = "none";

		qcom,esd-check-enabled;
		qcom,mdss-dsi-panel-status-check-mode = "reg_read_nt35596";

		qcom,mdss-dsi-on-command = [

		29 01 00 00 00 00 02 0a 08
		29 01 00 00 00 00 02 ff 20
		29 01 00 00 00 00 02 fb 01
		29 01 00 00 00 00 02 01 33
		29 01 00 00 00 00 02 06 9f
		29 01 00 00 00 00 02 07 a9
		29 01 00 00 00 00 02 0e 35
		29 01 00 00 00 00 02 0f 38
		29 01 00 00 00 00 02 1d 43
		29 01 00 00 00 00 02 68 03
		29 01 00 00 00 00 02 69 99
		29 01 00 00 00 00 02 6d 44
		29 01 00 00 00 00 02 89 10
		29 01 00 00 00 00 02 95 d7
		29 01 00 00 00 00 02 96 d7
		29 01 00 00 00 00 02 ff 20
		29 01 00 00 00 00 02 fb 01
		29 01 00 00 00 00 11 b0 00 00 00 1d 00 46 00 65 00 80 00 97 00 ab 00 bd
		29 01 00 00 00 00 11 b1 00 cd 01 03 01 28 01 64 01 8d 01 d2 02 01 02 04
		29 01 00 00 00 00 11 b2 02 35 02 70 02 97 02 cd 02 f1 03 11 03 32 03 40
		29 01 00 00 00 00 0d b3 03 53 03 67 03 7f 03 9f 03 cd 03 ff
		29 01 00 00 00 00 11 b4 00 00 00 1d 00 46 00 65 00 80 00 97 00 ab 00 bd
		29 01 00 00 00 00 11 b5 00 cd 01 03 01 28 01 64 01 8d 01 d2 02 01 02 04
		29 01 00 00 00 00 11 b6 02 35 02 70 02 97 02 cd 02 f1 03 11 03 32 03 40
		29 01 00 00 00 00 0d b7 03 53 03 67 03 7f 03 9f 03 cd 03 ff
		29 01 00 00 00 00 11 b8 00 00 00 1d 00 46 00 65 00 80 00 97 00 ab 00 bd
		29 01 00 00 00 00 11 b9 00 cd 01 03 01 28 01 64 01 8d 01 d2 02 01 02 04
		29 01 00 00 00 00 11 ba 02 35 02 70 02 97 02 cd 02 f1 03 11 03 32 03 40
		29 01 00 00 00 00 0d bb 03 53 03 67 03 7f 03 9f 03 cd 03 ff
		29 01 00 00 00 00 02 ff 21
		29 01 00 00 00 00 02 fb 01
		29 01 00 00 00 00 11 b0 00 00 00 1d 00 46 00 65 00 80 00 97 00 ab 00 bd
		29 01 00 00 00 00 11 b1 00 cd 01 03 01 28 01 64 01 8d 01 d2 02 01 02 04
		29 01 00 00 00 00 11 b2 02 35 02 70 02 97 02 cd 02 f1 03 11 03 32 03 40
		29 01 00 00 00 00 0d b3 03 53 03 67 03 7f 03 9f 03 cd 03 ff
		29 01 00 00 00 00 11 b4 00 00 00 1d 00 46 00 65 00 80 00 97 00 ab 00 bd
		29 01 00 00 00 00 11 b5 00 cd 01 03 01 28 01 64 01 8d 01 d2 02 01 02 04
		29 01 00 00 00 00 11 b6 02 35 02 70 02 97 02 cd 02 f1 03 11 03 32 03 40
		29 01 00 00 00 00 0d b7 03 53 03 67 03 7f 03 9f 03 cd 03 ff
		29 01 00 00 00 00 11 b8 00 00 00 1d 00 46 00 65 00 80 00 97 00 ab 00 bd
		29 01 00 00 00 00 11 b9 00 cd 01 03 01 28 01 64 01 8d 01 d2 02 01 02 04
		29 01 00 00 00 00 11 ba 02 35 02 70 02 97 02 cd 02 f1 03 11 03 32 03 40
		29 01 00 00 00 00 0d bb 03 53 03 67 03 7f 03 9f 03 cd 03 ff
		29 01 00 00 00 00 02 ff 24
		29 01 00 00 00 00 02 fb 01
		29 01 00 00 00 00 02 0b 17
		29 01 00 00 00 00 02 0c 15
		29 01 00 00 00 00 02 0d 13
		29 01 00 00 00 00 02 0e 17
		29 01 00 00 00 00 02 0f 15
		29 01 00 00 00 00 02 10 13
		29 01 00 00 00 00 03 11 01 00
		29 01 00 00 00 00 02 1d 17
		29 01 00 00 00 00 02 1e 15
		29 01 00 00 00 00 02 1f 13
		29 01 00 00 00 00 02 20 17
		29 01 00 00 00 00 02 21 15
		29 01 00 00 00 00 02 22 13
		29 01 00 00 00 00 02 23 01
		29 01 00 00 00 00 02 1c 00
		29 01 00 00 00 00 02 35 49
		29 01 00 00 00 00 02 68 c2
		29 01 00 00 00 00 02 78 80
		29 01 00 00 00 00 02 80 44
		29 01 00 00 00 00 02 81 05
		29 01 00 00 00 00 02 82 13
		29 01 00 00 00 00 02 83 22
		29 01 00 00 00 00 02 84 31
		29 01 00 00 00 00 02 88 13
		29 01 00 00 00 00 02 89 22
		29 01 00 00 00 00 02 8a 31
		29 01 00 00 00 00 02 8e f4
		29 01 00 00 00 00 02 8f 01
		29 01 00 00 00 00 02 9d 38
		29 01 00 00 00 00 02 a3 91
		29 01 00 00 00 00 02 b4 05
		29 01 00 00 00 00 02 b5 14
		29 01 00 00 00 00 02 dc 09
		29 01 00 00 00 00 02 df 03
		29 01 00 00 00 00 02 e0 69
		29 01 00 00 00 00 02 ff 25
		29 01 00 00 00 00 02 fb 01
		29 01 00 00 00 00 02 24 77
		29 01 00 00 00 00 02 25 77
		29 01 00 00 00 00 02 0c 01
		29 01 00 00 00 00 02 13 08
		29 01 00 00 00 00 02 14 43
		29 01 00 00 00 00 02 17 82
		29 01 00 00 00 00 02 ff 26
		29 01 00 00 00 00 02 fb 01
		29 01 00 00 00 00 02 06 c8
		29 01 00 00 00 00 02 12 5a
		29 01 00 00 00 00 02 1c af
		29 01 00 00 00 00 02 8c 44
		29 01 00 00 00 00 02 8d 33
		29 01 00 00 00 00 02 8e 22
		29 01 00 00 00 00 02 99 20
		29 01 00 00 00 00 02 ff 24
		29 01 00 00 00 00 02 fb 01
		29 01 00 00 00 00 02 37 04
		29 01 00 00 00 00 02 38 68
		29 01 00 00 00 00 02 39 68
		29 01 00 00 00 00 02 3f 68
		29 01 00 00 00 00 02 7a 0a
		29 01 00 00 00 00 02 7b 99
		29 01 00 00 00 00 02 7d 07
		29 01 00 00 00 00 02 7e 02
		29 01 00 00 00 00 02 92 6f
		29 01 00 00 00 00 02 e9 0a
		29 01 00 00 00 00 02 ff 25
		29 01 00 00 00 00 02 fb 01
		29 01 00 00 00 00 02 0a 81
		29 01 00 00 00 00 02 0b d6
		29 01 00 00 00 00 02 0c 01
		29 01 00 00 00 00 02 21 19
		29 01 00 00 00 00 02 22 19
		29 01 00 00 00 00 02 24 6f
		29 01 00 00 00 00 02 25 6f
		29 01 00 00 00 00 02 30 59
		29 01 00 00 00 00 02 31 59
		29 01 00 00 00 00 02 38 59
		29 01 00 00 00 00 02 3f 11
		29 01 00 00 00 00 02 40 9c
		29 01 00 00 00 00 02 41 9c
		29 01 00 00 00 00 02 4b 11
		29 01 00 00 00 00 02 4c 9c
		29 01 00 00 00 00 02 4d 9c
		29 01 00 00 00 00 02 ff 26
		29 01 00 00 00 00 02 fb 01
		29 01 00 00 00 00 02 06 c8
		29 01 00 00 00 00 02 0c 17
		29 01 00 00 00 00 02 0f 0c
		29 01 00 00 00 00 02 10 0d
		29 01 00 00 00 00 02 12 5a
		29 01 00 00 00 00 02 19 0d
		29 01 00 00 00 00 02 1a 5e
		29 01 00 00 00 00 02 1d 0c
		29 01 00 00 00 00 02 1e e5
		29 01 00 00 00 00 02 ff 24
		29 01 00 00 00 00 02 fb 01
		29 01 00 00 00 00 02 60 10
		29 01 00 00 00 00 02 ff 23
		29 01 00 00 00 00 02 fb 01
		29 01 00 00 00 00 02 07 20
		29 01 00 00 00 00 02 08 06
		29 01 00 00 00 00 02 09 7c
		29 01 00 00 00 00 02 ff 10
		29 01 00 00 00 00 02 fb 01
		29 01 00 00 00 00 02 35 01
		29 01 00 00 00 00 02 53 24
		29 01 00 00 00 00 02 55 00
		05 01 00 00 78 00 02 11 00
		05 01 00 00 28 00 02 29 00
		29 01 00 00 00 00 02 35 00
		];
		qcom,mdss-dsi-off-command = [
		29 01 00 00 00 00 02 ff 10
		05 01 00 00 96 00 02 28 00
		05 01 00 00 96 00 02 10 00
		29 01 00 00 00 00 02 4f 01
		];
		qcom,mdss-dsi-on-command-state = "dsi_lp_mode";
		qcom,mdss-dsi-off-command-state = "dsi_hs_mode";
		qcom,mdss-dsi-bl-pmic-control-type ="bl_ctrl_dcs";
		qcom,mdss-dsi-reset-sequence = <1 5>, <0 10>, <1 5>;
	};
};
