/* Copyright (c) 2015, The Linux Foundation. All rights reserved.
 *
 * This program is free software; you can redistribute it and/or modify
 * it under the terms of the GNU General Public License version 2 and
 * only version 2 as published by the Free Software Foundation.
 *
 * This program is distributed in the hope that it will be useful,
 * but WITHOUT ANY WARRANTY; without even the implied warranty of
 * MERCHANTABILITY or FITNESS FOR A PARTICULAR PURPOSE.  See the
 * GNU General Public License for more details.
 */

&mdss_mdp {
	dsi_lead_td4310_5p99_1080P_video: qcom,mdss_dsi_lead_td4310_5p99_1080P_video {
		qcom,mdss-dsi-panel-name = "zteLEAD_TD4310_1080_2160_5P99Inch";
		qcom,mdss-dsi-panel-type = "dsi_video_mode";
		qcom,cont-splash-enabled;
		qcom,mdss-dsi-panel-status-read-length = <1>;
		qcom,mdss-pan-physical-width-dimension = <68>;
		qcom,mdss-pan-physical-height-dimension = <136>;
		qcom,mdss-dsi-panel-framerate = <60>;
		qcom,mdss-dsi-virtual-channel-id = <0>;
		qcom,mdss-dsi-stream = <0>;
		qcom,mdss-dsi-panel-width = <1080>;
		qcom,mdss-dsi-panel-height = <2160>;/*mipi=959MHz*/
		qcom,mdss-dsi-h-front-porch = <108>;
		qcom,mdss-dsi-h-back-porch = <20>;
		qcom,mdss-dsi-h-pulse-width = <2>;
		qcom,mdss-dsi-h-sync-skew = <0>;
		qcom,mdss-dsi-v-back-porch = <33>;
		qcom,mdss-dsi-v-front-porch = <8>;
		qcom,mdss-dsi-v-pulse-width = <2>;
		qcom,mdss-dsi-h-left-border = <0>;
		qcom,mdss-dsi-h-right-border = <0>;
		qcom,mdss-dsi-v-top-border = <0>;
		qcom,mdss-dsi-v-bottom-border = <0>;
		qcom,mdss-dsi-bpp = <24>;
		qcom,mdss-dsi-underflow-color = <0xff>;
		qcom,mdss-dsi-border-color = <0>;
		qcom,mdss-dsi-h-sync-pulse = <0>;
		qcom,mdss-dsi-traffic-mode = "burst_mode";

		qcom,mdss-dsi-te-pin-select = <1>;
		qcom,mdss-dsi-te-dcs-command = <1>;
		qcom,mdss-dsi-te-check-enable;
		qcom,mdss-dsi-te-using-te-pin;
		qcom,mdss-dsi-wr-mem-start = <0x2c>;
		qcom,mdss-dsi-wr-mem-continue = <0x3c>;

		qcom,mdss-dsi-lp11-init;
		//qcom,mdss-dsi-init-delay-us = <5000>;

		qcom,esd-check-enabled;
		qcom,mdss-dsi-panel-status-command=[06 01 00 01 05 00 01 0A] ;
		qcom,mdss-dsi-panel-status-command-state="dsi_lp_mode";
		qcom,mdss-dsi-panel-status-check-mode="reg_read";
		qcom,mdss-dsi-panel-status-value=<0x1C>;

		qcom,mdss-dsi-bllp-eof-power-mode;
		qcom,mdss-dsi-bllp-power-mode;
		qcom,mdss-dsi-lane-0-state;
		qcom,mdss-dsi-lane-1-state;
		qcom,mdss-dsi-lane-2-state;
		qcom,mdss-dsi-lane-3-state;
		qcom,mdss-dsi-panel-timings = [F7 3C 28 00 6E 72 2E 40 31 03 04 00];
		//qcom,mdss-dsi-panel-timings-phy-v2 = [
		//23 1e 07 08 05 03 04 a0
		//23 1e 07 08 05 03 04 a0
		//23 1e 07 08 05 03 04 a0
		//23 1e 07 08 05 03 04 a0
		//23 19 07 08 05 03 04 a0];
		qcom,mdss-dsi-t-clk-post = <0x02>;
		qcom,mdss-dsi-t-clk-pre = <0x2D>;
		qcom,mdss-dsi-bl-min-level = <1>;
		qcom,mdss-dsi-bl-max-level = <255>;
		qcom,mdss-dsi-dma-trigger = "trigger_sw";
		qcom,mdss-dsi-mdp-trigger = "none";
		qcom,mdss-dsi-on-command = [
			29 01 00 00 00 00 02 B0 00
			29 01 00 00 00 00 02 D6 01
			15 01 00 00 00 00 02 55 01
			29 01 00 00 00 00 08 B8 89 5B 01 00 02 00 00
			29 01 00 00 00 00 27 C7 00 14 21 34 43 50 69 7B 89 95 48 55 64 79 82 8E 9C A7 B4 00 14 20 33 42 4F 68 7A 88 95 48 55 64 79 82 8E 9C A7 B4
			29 01 00 00 00 00 37 C8 01 00 02 01 FF FC 00 00 01 01 FD FC 00 00 01 FB F7 FC 00 00 02 01 FF FC 00 00 01 01 FD FC 00 00 01 FB F7 FC 00 00 02 01 FF FC 00 00 01 01 FD FC 00 00 01 FB F7 FC
			29 01 00 00 00 00 1a CE DD 40 49 53 65 80 9F a6 b1 b9 c5 d0 da e5 ed F9 FF 01 6A 04 04 24 04 69 5A
			29 01 00 00 00 00 16 D3 1B 3B BB 77 77 77 BB B3 33 00 00 6E 60 DF DF 33 BB F2 FD C6 0B
			39 01 00 00 00 00 02 36 00
			39 01 00 00 00 00 02 35 00
			//39 01 00 00 00 00 02 55 00
			39 01 00 00 00 00 02 51 00
			39 01 00 00 00 00 02 53 2c
			05 01 00 00 64 00 01 11
			05 01 00 00 16 00 01 29
		];
		qcom,mdss-dsi-off-command = [
			05 01 00 00 96 00 02 28 00
			05 01 00 00 96 00 02 10 00
			39 01 00 00 00 00 02 4f 01];
		qcom,mdss-dsi-on-command-state = "dsi_lp_mode";
		qcom,mdss-dsi-off-command-state = "dsi_hs_mode";
		qcom,mdss-dsi-bl-pmic-control-type ="bl_ctrl_dcs";
		qcom,mdss-dsi-reset-sequence = <1 5>, <0 5>, <1 30>;
		//qcom,mdss-dsi-tx-eot-append;
	};
};
