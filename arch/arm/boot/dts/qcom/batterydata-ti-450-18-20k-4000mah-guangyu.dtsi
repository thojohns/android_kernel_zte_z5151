/*****************************************************************************
* Copyright 2010 Texas Instruments Corporation, All Rights Reserved.
* TI makes NO WARRANTY as to software products, which are supplied "AS-IS"
*****************************************************************************/

/*****************************************************************************
*     This code is automatically generated from bqfs/dffs file.              *
*          DO NOT MODIFY THIS FILE DIRECTLY                                  *
*****************************************************************************/

/*this file is generated from Learned.gm.fs at Wed Feb 28 10:58:03 2018*/

batterydata-ti-450-18-20k-4000mah-guangyu {
	bq27x00,battery-id-kohm = <20>;    /* kohm Rbatt_id = 10, Rpullup = 100(100k) */
	bq27x00,battery-full-design = <4000000>;    /* uAh */
	bq27x00,fg-profile-data = [
		06 02 AA 00 01 00
		06 03 AA 00 26 04
		06 02 AA 00 02 00
		06 03 AA 00 02 02
		06 02 AA 00 13 00
		04 04 4C 04
		06 02 AA 3E 02 00
		24 02 AA 40 02 26 00 00 32 00 00 00 00 00 00 00 00 00 00 00
		00 00 00 00 00 00 00 00 00 00 00 00 00 00 00 00
		05 02 AA 60 A5
		04 04 0A 00
		06 02 AA 3E 02 00
		05 03 AA 60 A5
		06 02 AA 3E 24 00
		24 02 AA 40 00 19 28 63 5F FF 62 00 32 00 00 00 00 00 00 00
		00 00 00 00 00 00 00 00 00 00 00 00 00 00 00 00
		05 02 AA 60 69
		04 04 0A 00
		06 02 AA 3E 24 00
		05 03 AA 60 69
		06 02 AA 3E 31 00
		24 02 AA 40 0A 0F 02 05 00 00 00 00 00 00 00 00 00 00 00 00
		00 00 00 00 00 00 00 00 00 00 00 00 00 00 00 00
		05 02 AA 60 DF
		04 04 0A 00
		06 02 AA 3E 31 00
		05 03 AA 60 DF
		06 02 AA 3E 40 00
		24 02 AA 40 64 79 0F 86 23 0A 00 14 04 00 09 04 26 00 00 00
		00 00 00 00 00 00 00 00 00 00 00 00 00 00 00 00
		05 02 AA 60 15
		04 04 0A 00
		06 02 AA 3E 40 00
		05 03 AA 60 15
		06 02 AA 3E 44 00
		24 02 AA 40 00 32 01 C2 30 00 03 08 98 01 00 3C 01 00 00 00
		00 00 00 00 00 00 00 00 00 00 00 00 00 00 00 00
		05 02 AA 60 F9
		04 04 0A 00
		06 02 AA 3E 44 00
		05 03 AA 60 F9
		06 02 AA 3E 50 00
		24 02 AA 40 01 F4 00 1E C8 14 08 00 3C 0E 10 00 0A 46 05 14
		05 0F 03 20 7F FF 00 F0 46 50 18 01 90 00 64 19
		05 02 AA 60 E4
		04 04 0A 00
		06 02 AA 3E 50 00
		05 03 AA 60 E4
		06 02 AA 3E 50 01
		24 02 AA 40 DC 5C 60 00 7D 00 04 03 19 25 0F 14 0A 78 60 28
		01 F4 00 00 00 00 43 80 04 01 14 00 08 0B B8 01
		05 02 AA 60 DB
		04 04 0A 00
		06 02 AA 3E 50 01
		05 03 AA 60 DB
		06 02 AA 3E 50 02
		24 02 AA 40 2C 0A 01 0A 00 00 00 C8 00 64 02 00 00 00 00 07
		D0 01 03 5A 14 00 00 00 00 00 00 00 00 00 00 00
		05 02 AA 60 47
		04 04 0A 00
		06 02 AA 3E 50 02
		05 03 AA 60 47
		06 02 AA 3E 51 00
		24 02 AA 40 01 40 01 90 07 D0 00 3C 3C 01 B3 B3 01 90 00 00
		00 00 00 00 00 00 00 00 00 00 00 00 00 00 00 00
		05 02 AA 60 E6
		04 04 0A 00
		06 02 AA 3E 51 00
		05 03 AA 60 E6
		06 02 AA 3E 52 00
		24 02 AA 40 40 4D 00 00 00 81 0C 80 30 0C 0C E4 00 C8 00 32
		00 14 03 E8 01 00 B1 00 0A FF CE FF CB 00 02 00
		05 02 AA 60 EB
		04 04 0A 00
		06 02 AA 3E 52 00
		05 03 AA 60 EB
		06 02 AA 3E 53 00
		24 02 AA 40 18 05 11 0F DF E1 E4 DF E5 E1 E6 E2 E7 E6 E5 E1
		E7 EC ED E9 E3 E7 EE F0 F3 F4 F7 F9 FB FA FC FF
		05 02 AA 60 06
		04 04 0A 00
		06 02 AA 3E 53 00
		05 03 AA 60 06
		06 02 AA 3E 53 01
		24 02 AA 40 F6 F7 F5 F3 EE EB FB F8 FF D6 80 00 00 00 00 00
		00 00 00 00 00 00 00 00 00 00 00 00 00 00 00 00
		05 02 AA 60 09
		04 04 0A 00
		06 02 AA 3E 53 01
		05 03 AA 60 09
		06 02 AA 3E 54 00
		24 02 AA 40 07 1B 04 FF EF ED 15 ED 0D EA 0A EC F4 11 31 0D
		E4 FB 18 F3 E0 00 EE 08 FD FB E9 EC F2 EB D0 E4
		05 02 AA 60 AE
		04 04 0A 00
		06 02 AA 3E 54 00
		05 03 AA 60 AE
		06 02 AA 3E 54 01
		24 02 AA 40 E5 0C 15 0C 04 F5 23 EC 56 81 00 00 00 00 00 00
		00 00 00 00 00 00 00 00 00 00 00 00 00 00 00 00
		05 02 AA 60 0E
		04 04 0A 00
		06 02 AA 3E 54 01
		05 03 AA 60 0E
		06 02 AA 3E 55 00
		24 02 AA 40 FE D2 01 29 F7 0F 01 0A FF FB F9 15 B6 40 E1 17
		F7 00 00 00 00 00 00 00 00 00 00 00 00 00 00 00
		05 02 AA 60 07
		04 04 0A 00
		06 02 AA 3E 55 00
		05 03 AA 60 07
		06 02 AA 3E 6C 00
		24 02 AA 40 FE 49 01 09 00 18 FA EC 07 E5 FA 1E F1 CB 01 2B
		A6 00 00 00 00 00 00 00 00 00 00 00 00 00 00 00
		05 02 AA 60 1E
		04 04 0A 00
		06 02 AA 3E 6C 00
		05 03 AA 60 1E
		06 02 AA 3E 59 00
		24 02 AA 40 00 44 00 44 00 40 00 4C 00 44 00 37 00 40 00 3D
		00 45 00 43 00 6A 00 4E 00 73 00 BE 00 8F 00 00
		05 02 AA 60 F3
		04 04 0A 00
		06 02 AA 3E 59 00
		05 03 AA 60 F3
		06 02 AA 3E 6D 00
		24 02 AA 40 0C 38 0E E6 0E B1 11 22 10 DD 00 00 00 00 00 00
		00 00 00 00 00 00 00 00 00 00 00 00 00 00 00 00
		05 02 AA 60 E8
		04 04 0A 00
		06 02 AA 3E 6D 00
		05 03 AA 60 E8
		06 02 AA 3E 68 00
		24 02 AA 40 00 00 00 00 B7 15 F8 80 CB 4F 7E 8D 02 1B C8 CE
		7E 48 99 B3 28 8C 2D B7 00 00 00 00 CB D4 1A 05
		05 02 AA 60 7B
		04 04 0A 00
		06 02 AA 3E 68 00
		05 03 AA 60 7B
		06 02 AA 3E 68 01
		24 02 AA 40 1C 98 02 D3 FF B9 30 EF 05 11 05 01 00 00 10 01
		00 3C 00 50 3C 00 64 3C 00 20 00 00 00 00 00 00
		05 02 AA 60 EA
		04 04 0A 00
		06 02 AA 3E 68 01
		05 03 AA 60 EA
		06 02 AA 3E 69 00
		24 02 AA 40 00 00 0B D6 7E 73 B6 45 93 0A A5 22 00 00 00 00
		00 00 00 00 00 00 00 00 00 00 00 00 00 00 00 00
		05 02 AA 60 CE
		04 04 0A 00
		06 02 AA 3E 69 00
		05 03 AA 60 CE
		06 02 AA 3E 6B 00
		24 02 AA 40 EF 05 11 05 01 00 00 10 01 00 3C 00 50 3C 00 64
		3C 00 20 00 00 00 00 00 00 00 00 00 00 00 00 00
		05 02 AA 60 5B
		04 04 0A 00
		06 02 AA 3E 6B 00
		05 03 AA 60 5B
		06 02 AA 3E 70 00
		24 02 AA 40 80 00 80 00 00 00 00 00 00 00 00 00 00 00 00 00
		00 00 00 00 00 00 00 00 00 00 00 00 00 00 00 00
		05 02 AA 60 FF
		04 04 0A 00
		06 02 AA 3E 70 00
		05 03 AA 60 FF
		06 02 AA 00 00 00
		06 02 AA 00 42 00
		04 04 D0 07
	];
};
