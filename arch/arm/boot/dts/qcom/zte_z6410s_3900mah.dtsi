
qcom,3361761_zte_z6410s_3900mah_averaged_masterslave_feb26th2018 {
	/* #3361761_ZTE_Z6410S_3900mAh_averaged_MasterSlave_Feb26th2018*/
	qcom,max-voltage-uv = <4400000>;
	qcom,nom-batt-capacity-mah = <3900>;
	qcom,batt-id-kohm = <20>;
	qcom,battery-beta = <4050>;
	qcom,battery-type = "3361761_zte_z6410s_3900mah_averaged_masterslave_feb26th2018";
	qcom,chg-rslow-comp-c1 = <4485245>;
	qcom,chg-rslow-comp-c2 = <9745052>;
	qcom,chg-rs-to-rslow = <940840>;
	qcom,chg-rslow-comp-thr = <0xC4>;
	qcom,fg-cc-cv-threshold-mv = <4390>;
	qcom,checksum = <0x7644>;
	qcom,gui-version = "PMI8950GUI - 2.0.0.16";
	qcom,fg-profile-data = [
		07 88 3A 7E
		FA 81 48 7C
		3C 83 E0 72
		28 7F 28 80
		F2 81 80 9B
		E1 BE 4F D0
		81 11 07 88
		04 7E DD 81
		44 7C 36 83
		9A 79 6A 87
		FC 83 24 82
		F6 9B 89 C4
		23 D3 70 0D
		CA 0F 7F 59
		14 70 71 FD
		26 44 83 47
		15 49 00 00
		04 4D 4E 41
		DE 33 00 00
		00 00 00 00
		00 00 00 00
		47 70 EB 6A
		B5 78 6D 90
		0F 7C 4E 71
		7D 74 42 79
		A2 75 08 6B
		84 7D 13 A9
		1E B2 61 9E
		64 A0 71 0C
		28 00 FF 36
		F0 11 30 03
		00 00 00 0C
	];
};
