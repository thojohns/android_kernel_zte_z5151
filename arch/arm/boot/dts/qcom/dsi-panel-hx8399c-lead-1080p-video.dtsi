/* Copyright (c) 2015, The Linux Foundation. All rights reserved.
 *
 * This program is free software; you can redistribute it and/or modify
 * it under the terms of the GNU General Public License version 2 and
 * only version 2 as published by the Free Software Foundation.
 *
 * This program is distributed in the hope that it will be useful,
 * but WITHOUT ANY WARRANTY; without even the implied warranty of
 * MERCHANTABILITY or FITNESS FOR A PARTICULAR PURPOSE.  See the
 * GNU General Public License for more details.
 */

&mdss_mdp {
	dsi_hx8399c_lead_1080p_video: qcom,mdss_dsi_hx8399c_lead_1080p_video {
		qcom,mdss-dsi-panel-name = "hx8399c lead 1080p video mode dsi panel";
		zte,lcd-proc-panel-name = "zteLEAD(hx8399c+auo)_1080*1920-5.2Inch";
		qcom,cont-splash-enabled;
		qcom,mdss-dsi-panel-controller = <&mdss_dsi0>;
		qcom,mdss-dsi-panel-type = "dsi_video_mode";
		qcom,mdss-dsi-panel-destination = "display_1";
		qcom,mdss-dsi-panel-framerate = <60>;
		/*qcom,mdss-dsi-panel-clockrate = <866400000>;*/
		qcom,mdss-dsi-virtual-channel-id = <0>;
		qcom,mdss-dsi-stream = <0>;
		qcom,mdss-dsi-panel-width = <1080>;
		qcom,mdss-dsi-panel-height = <1920>;
		qcom,mdss-dsi-h-front-porch = <40>;
		qcom,mdss-dsi-h-back-porch = <30>;
		qcom,mdss-dsi-h-pulse-width = <30>;
		qcom,mdss-dsi-h-sync-skew = <0>;
		qcom,mdss-dsi-v-back-porch = <4>;
		qcom,mdss-dsi-v-front-porch = <9>;
		qcom,mdss-dsi-v-pulse-width = <4>;
		qcom,mdss-dsi-h-left-border = <0>;
		qcom,mdss-dsi-h-right-border = <0>;
		qcom,mdss-dsi-v-top-border = <0>;
		qcom,mdss-dsi-v-bottom-border = <0>;
		qcom,mdss-dsi-bpp = <24>;
		qcom,mdss-dsi-color-order = "rgb_swap_rgb";
		qcom,mdss-dsi-underflow-color = <0xff>;
		qcom,mdss-dsi-border-color = <0>;
		qcom,mdss-dsi-on-command = [
			29 01 00 00 00 00 04 B9 FF 83 99
			29 01 00 00 00 00 05 BA 63 03 68 73
			29 01 00 00 00 00 10 B1 02 04 6D 8D 01 32 33 11 11 5E 64 56 73 02 02
			29 01 00 00 00 00 10 B2 07 00 80 AE 05 07 5A 31 10 30 00 1E 70 03 D4
			29 01 00 00 00 00 2D B4 00 FF 10 18 04 9A 00 00 06 00 02 04 00 24 02 04 0A 21 03 00 00 02 9F 88 10 18 04 9A 00 00 08 00 02 04 00 24 02 04 0A 00 00 02 9F 12
			29 01 00 00 00 00 22 D3 00 00 00 00 00 00 30 00 00 00 05 00 05 00 07 88 07 88 00 00 00 00 00 14 00 00 00 01 00 00 00 05 40
			29 01 00 00 00 00 21 D5 20 20 1E 1E 1F 1F 01 01 00 00 25 25 18 18 18 18 24 24 18 18 18 18 18 18 18 18 2F 2F 30 30 31 31
			29 01 00 00 00 00 21 D6 24 24 1E 1E 1F 1F 00 00 01 01 25 25 18 18 18 18 20 20 18 18 18 18 18 18 18 18 2F 2F 30 30 31 31
			29 01 00 00 00 00 02 BD 00
			29 01 00 00 00 00 11 D8 AA 8A AA AA AA 8A AA AA AA 8A AA AA AA 8A AA AA
			29 01 00 00 00 00 02 BD 01
			29 01 00 00 00 00 11 D8 FF CF EA BF FF CF EA BF FF CF EA BF FF CF EA BF
			29 01 00 00 00 00 02 BD 02
			29 01 00 00 00 00 09 D8 FF CF EA BF FF CF EA BF
			29 01 00 00 00 00 02 BD 00
			29 01 00 00 00 00 06 C9 03 00 12 20 31
			29 01 00 00 00 00 37 E0 02 1D 2B 25 54 5F 6C 69 72 7B 82 8A 90 98 9F A4 A5 AC AD B3 A4 AF B1 5B 59 65 7C 02 1D 2B 25 54 5F 6C 6A 73 7A 84 8B 90 96 9C 9F A0 A9 AC B2 A4 AF B1 5A 51 59 7C
			29 01 00 00 00 00 03 B6 8A 8A
			29 01 00 00 00 00 02 CC 08
			29 01 00 00 00 00 06 C7 00 08 00 01 08
			29 01 00 00 00 00 03 C0 25 5A
			29 01 00 00 05 00 03 51 00 00
			29 01 00 00 00 00 08 BF 40 41 50 09 1A C0 CD
			29 01 00 00 0A 00 02 E4 01
			29 01 00 00 78 00 02 11 00
			29 01 00 00 14 00 02 29 00
			29 01 00 00 0A 00 03 E4 01 02
			29 01 00 00 00 00 0A E5 00 04 0B 08 06 00 20 20 00
			29 01 00 00 00 00 0D E6 00 00 00 05 05 10 0A 10 20 20 00 00
			29 01 00 00 05 00 02 55 01
			29 01 00 00 05 00 0A CA 24 24 24 23 23 20 20 20 20
			29 01 00 00 05 00 02 53 24
		];
		qcom,mdss-dsi-off-command = [
		29 01 00 00 05 00 02 53 24
		29 01 00 00 00 00 04 B9 FF 83 99
		29 01 00 00 05 00 02 B1 00
		05 01 00 00 32 00 02 28 00
		05 01 00 00 A0 00 02 10 00
		29 01 00 00 00 00 04 B9 FF 83 99
		29 01 00 00 05 00 02 B1 01
		];
		qcom,mdss-dsi-on-command-state = "dsi_lp_mode";
		qcom,mdss-dsi-off-command-state = "dsi_hs_mode";
		qcom,mdss-dsi-lp11-init;
		qcom,mdss-dsi-h-sync-pulse = <1>;
		qcom,mdss-dsi-traffic-mode = "burst_mode";
		qcom,mdss-dsi-bllp-eof-power-mode;
		qcom,mdss-dsi-bllp-power-mode;
		qcom,mdss-dsi-lane-0-state;
		qcom,mdss-dsi-lane-1-state;
		qcom,mdss-dsi-lane-2-state;
		qcom,mdss-dsi-lane-3-state;
		qcom,mdss-dsi-panel-timings = [D6 34 22 00 62 66 26 36 28 03 04 00];
		qcom,mdss-dsi-t-clk-post = <0x03>;
		qcom,mdss-dsi-t-clk-pre = <0x28>;
		qcom,mdss-dsi-bl-min-level = <1>;
		qcom,mdss-dsi-bl-max-level = <3000>;
		qcom,mdss-dsi-dma-trigger = "trigger_sw";
		qcom,mdss-dsi-mdp-trigger = "none";
		qcom,mdss-dsi-bl-pmic-control-type = "bl_ctrl_dcs";
		qcom,mdss-dsi-reset-sequence = <1 20>, <0 20>, <1 60>;
		qcom,mdss-pan-physical-width-dimension = <64>;
		qcom,mdss-pan-physical-height-dimension = <115>;
/*		qcom,mdss-dsi-panel-status-check-mode = "reg_read";
		qcom,mdss-dsi-panel-status-command = [06 01 00 01 05 00 02 09 00];
		qcom,mdss-dsi-panel-status-command-state = "dsi_lp_mode";
		qcom,mdss-dsi-panel-status-read-length = <3>;
		qcom,mdss-dsi-panel-status-value = <0x80 0x73 0x04>;
		qcom,mdss-dsi-tx-eot-append;
		qcom,esd-check-enabled;
*/
		qcom,ulps-enabled;
		qcom,mdss-dsi-post-init-delay = <1>;
	};
};
