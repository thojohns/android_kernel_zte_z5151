
qcom,2745687_P840V70_3000mAh_20kom {
	/* #2745687_ZTE_P840V70coslight_3000mAh_averaged_MasterSlave_Dec27th2016*/
	qcom,max-voltage-uv = <4400000>;
	qcom,nom-batt-capacity-mah = <3000>;
	qcom,batt-id-kohm = <20>;
	qcom,batt-chip-code = <03>;
	qcom,battery-beta = <4050>;
	qcom,battery-type = "2745687_P840V70_3000mAh_20kom";
	qcom,chg-rslow-comp-c1 = <5035175>;
	qcom,chg-rslow-comp-c2 = <11546670>;
	qcom,chg-rs-to-rslow = <1020521>;
	qcom,chg-rslow-comp-thr = <0xC7>;
	qcom,checksum = <0x3BC4>;
	qcom,fastchg-current-ma = <3000>;
	qcom,gui-version = "PMI8950GUI - 2.0.0.16";
	qcom,fg-profile-data = [
		 E0 83 CB 7C
		 1A 81 4F 77
		 60 83 DB 6E
		 D8 88 01 94
		 4B 82 33 98
		 7F B5 D7 C0
		 52 16 F9 83
		 37 7D 48 81
		 74 77 61 83
		 D9 64 3D 88
		 11 94 3B 82
		 4F 9A AF BD
		 FC CA 52 0D
		 F3 0B 97 59
		 14 70 B2 FD
		 22 37 3A 44
		 97 38 00 00
		 D0 45 6E 13
		 5F 38 00 00
		 00 00 00 00
		 00 00 00 00
		 D8 6B BE 6A
		 B6 60 C9 83
		 40 75 98 69
		 CA 70 BD 81
		 DC 6F AF 63
		 DC 61 F9 AA
		 1A A8 62 67
		 64 A0 71 0C
		 28 00 FF 36
		 F0 11 30 03
		 00 00 00 0C
	];
};
