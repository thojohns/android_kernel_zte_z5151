/* Copyright (c) 2015, The Linux Foundation. All rights reserved.
 *
 * This program is free software; you can redistribute it and/or modify
 * it under the terms of the GNU General Public License version 2 and
 * only version 2 as published by the Free Software Foundation.
 *
 * This program is distributed in the hope that it will be useful,
 * but WITHOUT ANY WARRANTY; without even the implied warranty of
 * MERCHANTABILITY or FITNESS FOR A PARTICULAR PURPOSE.  See the
 * GNU General Public License for more details.
 */

&mdss_mdp {
	dsi_boe_td4310_boe_6p0_1080p_plus_video_vid: qcom,mdss_dsi_boe_td4310_boe_5p99_1080p_plus_video {
		qcom,mdss-dsi-panel-name = "zteBOE(TD4310)BOE_1080*2160_6P0Inch";
		qcom,mdss-dsi-panel-type = "dsi_video_mode";
		qcom,cont-splash-enabled;
		qcom,mdss-pan-physical-width-dimension = <68>;
		qcom,mdss-pan-physical-height-dimension = <139>;
		qcom,mdss-dsi-panel-framerate = <60>;
		qcom,mdss-dsi-virtual-channel-id = <0>;
		qcom,mdss-dsi-stream = <0>;
		qcom,mdss-dsi-panel-width = <1080>;
		qcom,mdss-dsi-panel-height = <2160>;
		qcom,mdss-dsi-h-front-porch = <50>;	/* mipi clk: 928M */
		qcom,mdss-dsi-h-back-porch = <26>;
		qcom,mdss-dsi-h-pulse-width = <2>;
		qcom,mdss-dsi-h-sync-skew = <0>;
		qcom,mdss-dsi-v-back-porch = <53>;
		qcom,mdss-dsi-v-front-porch = <4>;
		qcom,mdss-dsi-v-pulse-width = <10>;
		qcom,mdss-dsi-h-left-border = <0>;
		qcom,mdss-dsi-h-right-border = <0>;
		qcom,mdss-dsi-v-top-border = <0>;
		qcom,mdss-dsi-v-bottom-border = <0>;
		qcom,mdss-dsi-bpp = <24>;
		qcom,mdss-dsi-underflow-color = <0xff>;
		qcom,mdss-dsi-border-color = <0>;
		qcom,mdss-dsi-h-sync-pulse = <0>;
		qcom,mdss-dsi-traffic-mode = "burst_mode";
		qcom,mdss-dsi-bllp-eof-power-mode;
		qcom,mdss-dsi-bllp-power-mode;
		qcom,mdss-dsi-lp11-init;
		qcom,mdss-dsi-lane-0-state;
		qcom,mdss-dsi-lane-1-state;
		qcom,mdss-dsi-lane-2-state;
		qcom,mdss-dsi-lane-3-state;
		qcom,mdss-dsi-panel-timings = [f2 3a 28 00 6c 6e 2c 3e 2e 03 04 00];
		qcom,mdss-dsi-t-clk-post = <0x2>;
		qcom,mdss-dsi-t-clk-pre = <0x2d>;
		qcom,mdss-dsi-bl-min-level = <1>;
		qcom,mdss-dsi-bl-max-level = <255>;
		qcom,mdss-reset-gpio-low = <1>;
		qcom,mdss-dsi-dma-trigger = "trigger_sw";
		qcom,mdss-dsi-mdp-trigger = "none";

		qcom,esd-check-enabled;
		qcom,mdss-dsi-panel-status-command = [06 01 00 01 05 00 01 0a];
		qcom,mdss-dsi-panel-status-command-mode = "dsi_lp_mode";
		qcom,mdss-dsi-panel-status-check-mode = "reg_read";
		qcom,mdss-dsi-panel-status-read-length = <1>;
		qcom,mdss-dsi-panel-status-value = <0x1C>;

		qcom,mdss-dsi-on-command = [

		39 01 00 00 00 00 02 53 2C
		39 01 00 00 00 00 02 55 00
		05 01 00 00 64 00 02 11 00
		29 01 00 00 00 00 02 B0 00
		29 01 00 00 00 00 31 C1 04 40 00 FF 5F 6B 89 B0 6A 85 0F A3 FC FF FF FF 65 84 1F 2C 65 CB B0 F6 FE 0F 00
		00 00 00 00 00 00 00 40 02 22 02 06 0A 00 00 01 00 05 00 00 00
		29 01 00 00 00 00 1C CB FF FF FF FF 0F 00 00 00 00 00 11 F0 00 0D 00 00 00 00 00 00 00 00 00 00 00 00 00
		29 01 00 00 00 00 02 B0 03
		05 01 00 00 0A 00 02 29 00

		];
		qcom,mdss-dsi-off-command = [
		05 01 00 00 14 00 02 28 00
		29 01 00 00 00 00 02 B0 00
		29 01 00 00 00 00 31 C1 04 40 00 FF FF FF FF FF EA FF FF FF FF FF FF FF FF FF FF 7F F5 FF FF FF FF 0F 00
		00 00 00 00 00 00 00 40 02 22 02 06 0A 00 00 01 00 01 00 00 00
		29 01 00 00 00 00 1C CB FF FF FF FF 0F FC 76 E0 F6 03 11 F0 00 0D 00 00 00 00 00 00 00 00 00 00 00 00 00
		29 01 00 00 00 00 02 B0 03
		05 01 00 00 14 00 02 10 00
		];
		qcom,mdss-dsi-init-delay-us = <30000>;
		qcom,mdss-dsi-on-command-state = "dsi_lp_mode";
		qcom,mdss-dsi-off-command-state = "dsi_hs_mode";
		qcom,mdss-dsi-bl-pmic-control-type ="bl_ctrl_dcs";
		qcom,mdss-dsi-reset-sequence = <1 5>, <0 10>, <1 5>;
	};
};
