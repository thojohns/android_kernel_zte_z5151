/* Copyright (c) 2013, The Linux Foundation. All rights reserved.
 *
 * This program is free software; you can redistribute it and/or modify
 * it under the terms of the GNU General Public License version 2 and
 * only version 2 as published by the Free Software Foundation.
 *
 * This program is distributed in the hope that it will be useful,
 * but WITHOUT ANY WARRANTY; without even the implied warranty of
 * MERCHANTABILITY or FITNESS FOR A PARTICULAR PURPOSE.  See the
 * GNU General Public License for more details.
 */

/*---------------------------------------------------------------------------
 * This file is autogenerated file using gcdb parser. Please do not edit it.
 * Update input XML file to add a new entry or update variable in this file
 * VERSION = "1.0"
 *---------------------------------------------------------------------------*/
&mdss_mdp {
	dsi_xinli_otm1290a_720p_video: qcom,mdss_dsi_xinli_otm1290a_720p_video {
		qcom,mdss-dsi-panel-name = "xinli otm1290a 720p video mode dsi panel";
		zte,lcd-init-code-version = "20180419";
		qcom,cont-splash-enabled;
		zte,lcd_bl_vsp_vsn_voltage = <0xa>;
		qcom,panel-supply-entries = <&dsi_panel_pwr_supply>;
		qcom,mdss-dsi-panel-controller = <&mdss_dsi0>;
		qcom,mdss-dsi-panel-type = "dsi_video_mode";
		qcom,mdss-dsi-panel-destination = "display_1";
		qcom,mdss-dsi-panel-framerate = <60>;
		/*qcom,mdss-dsi-panel-clockrate = <866400000>;*/
		qcom,mdss-dsi-virtual-channel-id = <0>;
		qcom,mdss-dsi-stream = <0>;
		qcom,mdss-dsi-panel-width = <720>;
		qcom,mdss-dsi-panel-height = <1440>;
		qcom,mdss-dsi-h-front-porch = <100>;
		qcom,mdss-dsi-h-back-porch = <96>;
		qcom,mdss-dsi-h-pulse-width = <8>;
		qcom,mdss-dsi-h-sync-skew = <0>;
		qcom,mdss-dsi-v-back-porch = <20>;
		qcom,mdss-dsi-v-front-porch = <20>;
		qcom,mdss-dsi-v-pulse-width = <8>;
		qcom,mdss-dsi-h-left-border = <0>;
		qcom,mdss-dsi-h-right-border = <0>;
		qcom,mdss-dsi-v-top-border = <0>;
		qcom,mdss-dsi-v-bottom-border = <0>;
		qcom,mdss-dsi-bpp = <24>;
		qcom,mdss-dsi-color-order = "rgb_swap_rgb";
		qcom,mdss-dsi-underflow-color = <0xff>;
		qcom,mdss-dsi-border-color = <0>;
		qcom,mdss-dsi-on-command = [39 01 00 00 00 00 02 00 00
39 01 00 00 00 00 04 ff 12 90 01
39 01 00 00 00 00 02 00 80
39 01 00 00 00 00 03 ff 12 90
39 01 00 00 00 00 02 00 90
39 01 00 00 00 00 02 ff b0
39 01 00 00 00 00 02 00 80
39 01 00 00 00 00 0a c0 00 84 00 10 00 10 01 04 03
39 01 00 00 00 00 02 00 90
39 01 00 00 00 00 02 c1 03
39 01 00 00 00 00 02 00 ac
39 01 00 00 00 00 02 c1 0c
39 01 00 00 00 00 02 00 c0
39 01 00 00 00 00 02 c0 88
39 01 00 00 00 00 02 00 a6
39 01 00 00 00 00 07 c0 00 60 00 00 00 02
39 01 00 00 00 00 02 00 a1
39 01 00 00 00 00 02 b3 10
39 01 00 00 00 00 02 00 b0
39 01 00 00 00 00 05 b3 02 d0 05 a0
39 01 00 00 00 00 02 00 81
39 01 00 00 00 00 02 b2 21
39 01 00 00 00 00 02 00 b1
39 01 00 00 00 00 02 c0 40
39 01 00 00 00 00 02 00 85
39 01 00 00 00 00 02 b0 01
39 01 00 00 00 00 02 00 95
39 01 00 00 00 00 02 b0 1b
39 01 00 00 00 00 02 00 97
39 01 00 00 00 00 02 b0 00
39 01 00 00 00 00 02 00 80
39 01 00 00 00 00 02 a4 af
39 01 00 00 00 00 02 00 81
39 01 00 00 00 00 02 a4 02
39 01 00 00 00 00 02 00 80
39 01 00 00 00 00 02 a5 b3
39 01 00 00 00 00 02 00 a2
39 01 00 00 00 00 02 c0 00
39 01 00 00 00 00 02 00 84
39 01 00 00 00 00 06 f5 72 82 79 0b 92
39 01 00 00 00 00 02 00 86
39 01 00 00 00 00 02 a5 f0
39 01 00 00 00 00 02 00 87
39 01 00 00 00 00 02 a5 0d
39 01 00 00 00 00 02 00 86
39 01 00 00 00 00 04 c0 15 04 15
39 01 00 00 00 00 02 00 d0
39 01 00 00 00 00 05 c0 00 00 00 00
39 01 00 00 00 00 02 00 81
39 01 00 00 00 00 02 c4 07
39 01 00 00 00 00 02 00 87
39 01 00 00 00 00 03 c5 01 11
39 01 00 00 00 00 02 00 80
39 01 00 00 00 00 03 c5 99 53
39 01 00 00 00 00 02 00 83
39 01 00 00 00 00 02 c5 55
39 01 00 00 00 00 02 00 85
39 01 00 00 00 00 02 c5 12
39 01 00 00 00 00 02 00 00
39 01 00 00 00 00 03 d8 1f 1f
39 01 00 00 00 00 02 00 01
39 01 00 00 00 00 02 d9 33
39 01 00 00 00 00 02 00 80
39 01 00 00 00 00 09 cb 14 14 14 14 14 14 14 14
39 01 00 00 00 00 02 00 a0
39 01 00 00 00 00 02 cb 00
39 01 00 00 00 00 02 00 80
39 01 00 00 00 00 10 cc 11 01 02 09 0c 0a 0d 0b 0f 01 01 00 00 00 05
39 01 00 00 00 00 02 00 90
39 01 00 00 00 00 10 cc 00 00 00 00 00 00 12 01 02 19 1c 1a 0e 1b 10
39 01 00 00 00 00 02 00 a0
39 01 00 00 00 00 0d cc 01 01 00 00 00 06 00 00 00 00 00 00
39 01 00 00 00 00 02 00 b0
39 01 00 00 00 00 10 cc 06 02 01 10 1b 0e 1a 1c 19 01 01 00 00 00 12
39 01 00 00 00 00 02 00 c0
39 01 00 00 00 00 10 cc 00 00 00 00 00 00 05 02 01 0f 0b 0d 0a 0c 09
39 01 00 00 00 00 02 00 d0
39 01 00 00 00 00 0d cc 01 01 00 00 00 11 00 00 00 00 00 00
39 01 00 00 00 00 02 00 e0
39 01 00 00 00 00 06 cc 00 00 00 00 00
39 01 00 00 00 00 02 00 80
39 01 00 00 00 00 07 ce 8e 00 8d 00 00 55
39 01 00 00 00 00 02 00 90
39 01 00 00 00 00 06 ce 05 00 06 00 00
39 01 00 00 00 00 02 00 a0
39 01 00 00 00 00 0c ce 8c 08 00 8a 0a 5b 88 0c 00 86 0d
39 01 00 00 00 00 02 00 b0
39 01 00 00 00 00 0d ce 84 0f 00 83 0f 82 0f 00 81 0f 35 00
39 01 00 00 00 00 02 00 a0
39 01 00 00 00 00 05 f3 02 5b 35 00
39 01 00 00 00 00 02 00 e0
39 01 00 00 00 00 0b ce 00 00 00 00 00 00 00 00 00 00
39 01 00 00 00 00 02 00 f0
39 01 00 00 00 00 0a ce 02 90 90 90 90 90 90 90 90
39 01 00 00 00 00 02 00 80
39 01 00 00 00 00 0c cf 00 00 00 00 00 00 00 00 00 00 00
39 01 00 00 00 00 02 00 00
39 01 00 00 00 00 11 e1 00 31 43 57 67 84 81 97 61 4f 5b 47 35 26 17 00
39 01 00 00 00 00 02 00 00
39 01 00 00 00 00 11 e2 00 31 43 57 66 85 81 96 62 4f 5b 47 35 26 17 00
39 01 00 00 00 00 02 35 01
39 01 00 00 00 00 02 00 b0
39 01 00 00 00 00 05 ca 03 03 50 05
39 01 00 00 00 00 02 51 00
39 01 00 00 00 00 02 53 24
39 01 00 00 00 00 02 55 01
39 01 00 00 00 00 02 5e 03
39 01 00 00 00 00 02 00 80
39 01 00 00 00 00 03 ff ff ff
39 01 00 00 00 00 02 00 00
39 01 00 00 00 00 04 ff ff ff ff
05 01 00 00 78 00 02 11 00
05 01 00 00 14 00 02 29 00 ];
		qcom,mdss-dsi-off-command = [39 01 00 00 00 00 02 53 00
					05 01 00 00 32 00 02 28 00
					05 01 00 00 78 00 02 10 00];
		qcom,mdss-dsi-on-command-state = "dsi_lp_mode";
		qcom,mdss-dsi-off-command-state = "dsi_hs_mode";
		zte,mdss-dsi-cabc-default-value = <0x01>;
		zte,mdss-dsi-cabc-off-command = [39 01 00 00 00 00 02 55 00
		];
		zte,mdss-dsi-cabc-low-command = [39 01 00 00 00 00 02 55 01
		];
		zte,mdss-dsi-cabc-medium-command = [39 01 00 00 00 00 02 55 02
		];
		zte,mdss-dsi-cabc-high-command = [39 01 00 00 00 00 02 55 03
		];
		zte,mdss-dsi-cabc-command-state = "dsi_lp_mode";
		qcom,mdss-dsi-lp11-init;
		qcom,mdss-dsi-h-sync-pulse = <1>;
		qcom,mdss-dsi-traffic-mode = "burst_mode";
		qcom,mdss-dsi-lane-map = "lane_map_0123";
		qcom,mdss-dsi-bllp-eof-power-mode;
		qcom,mdss-dsi-bllp-power-mode;
		qcom,mdss-dsi-lane-0-state;
		qcom,mdss-dsi-lane-1-state;
		qcom,mdss-dsi-lane-2-state;
		qcom,mdss-dsi-lane-3-state;
		qcom,mdss-dsi-panel-timings = [8B 1E 14 00 44 48 18 22 19 03 04 00];
		qcom,mdss-dsi-t-clk-post = <0x04>;
		qcom,mdss-dsi-t-clk-pre = <0x1C>;
		qcom,mdss-dsi-bl-min-level = <3>;
		qcom,mdss-dsi-bl-max-level = <255>;
		qcom,mdss-dsi-dma-trigger = "trigger_sw";
		qcom,mdss-dsi-mdp-trigger = "none";
		qcom,mdss-dsi-bl-pmic-control-type = "bl_ctrl_dcs";
		qcom,mdss-dsi-reset-sequence = <1 5>, <0 2>, <1 20>;
		qcom,mdss-pan-physical-width-dimension = <62>;
		qcom,mdss-pan-physical-height-dimension = <124>;
		zte,lcm_backlight_curve_mode = "lcd_brightness_max_350_lux";
		qcom,mdss-dsi-tx-eot-append;
	};
};
