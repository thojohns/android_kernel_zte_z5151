/* Copyright (c) 2013, The Linux Foundation. All rights reserved.
 *
 * This program is free software; you can redistribute it and/or modify
 * it under the terms of the GNU General Public License version 2 and
 * only version 2 as published by the Free Software Foundation.
 *
 * This program is distributed in the hope that it will be useful,
 * but WITHOUT ANY WARRANTY; without even the implied warranty of
 * MERCHANTABILITY or FITNESS FOR A PARTICULAR PURPOSE.  See the
 * GNU General Public License for more details.
 */

/*---------------------------------------------------------------------------
 * This file is autogenerated file using gcdb parser. Please do not edit it.
 * Update input XML file to add a new entry or update variable in this file
 * VERSION = "1.0"
 *---------------------------------------------------------------------------*/
&mdss_mdp {
	dsi_lead_hx8394f_720p_video: qcom,mdss_dsi_lead_hx8394f_720p_video {
		qcom,mdss-dsi-panel-name = "lead hx8394f 720p video mode dsi panel";
		zte,lcd-init-code-version = "20180329";
		qcom,cont-splash-enabled;
		zte,lcd_bl_vsp_vsn_voltage = <0xf>;
		qcom,panel-supply-entries = <&dsi_panel_pwr_supply>;
		qcom,mdss-dsi-panel-controller = <&mdss_dsi0>;
		qcom,mdss-dsi-panel-type = "dsi_video_mode";
		qcom,mdss-dsi-panel-destination = "display_1";
		qcom,mdss-dsi-panel-framerate = <60>;
		/*qcom,mdss-dsi-panel-clockrate = <866400000>;*/
		qcom,mdss-dsi-virtual-channel-id = <0>;
		qcom,mdss-dsi-stream = <0>;
		qcom,mdss-dsi-panel-width = <720>;
		qcom,mdss-dsi-panel-height = <1440>;
		qcom,mdss-dsi-h-front-porch = <100>;
		qcom,mdss-dsi-h-back-porch = <96>;
		qcom,mdss-dsi-h-pulse-width = <8>;
		qcom,mdss-dsi-h-sync-skew = <0>;
		qcom,mdss-dsi-v-back-porch = <20>;
		qcom,mdss-dsi-v-front-porch = <20>;
		qcom,mdss-dsi-v-pulse-width = <8>;
		qcom,mdss-dsi-h-left-border = <0>;
		qcom,mdss-dsi-h-right-border = <0>;
		qcom,mdss-dsi-v-top-border = <0>;
		qcom,mdss-dsi-v-bottom-border = <0>;
		qcom,mdss-dsi-bpp = <24>;
		qcom,mdss-dsi-color-order = "rgb_swap_rgb";
		qcom,mdss-dsi-underflow-color = <0xff>;
		qcom,mdss-dsi-border-color = <0>;
		qcom,mdss-dsi-on-command = [39 01 00 00 00 00 04 b9 ff 83 94
39 01 00 00 00 00 07 ba 63 03 68 6b b2 c0
39 01 00 00 00 00 0b b1 48 07 67 09 31 54 71 31 50 34
39 01 00 00 00 00 07 b2 00 80 78 0e 08 22
39 01 00 00 00 00 15 b4 01 72 29 72 29 72 01 0c 7c 33 00 3f 01 72 29 72 29 72 01 0c
39 01 00 00 00 00 3b e0 00 03 0b 10 13 16 1c 18 34 46 59 5c 6b 82 8a 91 9f a3 a0 ad bd 5d 5c 60 64 67 6f 7e 7f 00 03
	0b 10 13 16 1c 18 34 46 59 5c 6b 82 8a 91 9f a3 a0 ad bd 5d 5c 60 64 67 6f 7e 7f
39 01 00 00 00 00 22 d3 00 00 00 00 00 00 17 17 32 10 04 00 04 52 15 b6 05 b6 32
	10 00 00 00 57 45 05 05 5b 0e 0e 27 0e 40
39 01 00 00 00 00 02 bd 02
39 01 00 00 00 00 05 d3 01 04 00 01
39 01 00 00 00 00 02 bd 00
39 01 00 00 00 00 2d d5 24 25 18 18 19 19 00 01 06 07 02 03 08 09 04 05 0a
	0b 18 18 18 18 18 18 18 18 18 18 18 18 20 21 18 18 18 18 18 18 18 18 18 18 18 18
39 01 00 00 00 00 2d d6 21 20 19 19 18 18 0b 0a 05 04 09 08 03 02 07 06 01
	00 18 18 18 18 18 18 18 18 18 18 18 18 25 24 18 18 18 18 18 18 18 18 18 18 18 18
39 01 00 00 00 00 03 b6 4b 4b
39 01 00 00 00 00 06 c9 13 00 0a 8f 8f
39 01 00 00 00 00 02 cc 0b
39 01 00 00 00 00 03 c0 1f 31
39 01 00 00 00 00 02 d4 02
39 01 00 00 00 00 02 bd 01
39 01 00 00 00 00 02 b1 00
39 01 00 00 00 00 02 bd 00
39 01 00 00 00 00 02 c6 ed
39 01 00 00 00 00 02 51 00
39 01 00 00 00 00 02 53 24
39 01 00 00 00 00 02 55 02
39 01 00 00 00 00 02 5e 01
05 01 00 00 78 00 02 11 00
05 01 00 00 14 00 02 29 00 ];
		qcom,mdss-dsi-off-command = [39 01 00 00 00 00 02 53 00
					05 01 00 00 32 00 02 28 00
					05 01 00 00 78 00 02 10 00];
		qcom,mdss-dsi-on-command-state = "dsi_lp_mode";
		qcom,mdss-dsi-off-command-state = "dsi_hs_mode";
		zte,mdss-dsi-cabc-default-value = <0x02>;
		zte,mdss-dsi-cabc-off-command = [39 01 00 00 00 00 02 55 00
		];
		zte,mdss-dsi-cabc-low-command = [39 01 00 00 00 00 02 55 01
		];
		zte,mdss-dsi-cabc-medium-command = [39 01 00 00 00 00 02 55 02
		];
		zte,mdss-dsi-cabc-high-command = [39 01 00 00 00 00 02 55 03
		];
		zte,mdss-dsi-cabc-command-state = "dsi_lp_mode";
		qcom,mdss-dsi-lp11-init;
		qcom,mdss-dsi-h-sync-pulse = <1>;
		qcom,mdss-dsi-traffic-mode = "burst_mode";
		qcom,mdss-dsi-lane-map = "lane_map_0123";
		qcom,mdss-dsi-bllp-eof-power-mode;
		qcom,mdss-dsi-bllp-power-mode;
		qcom,mdss-dsi-lane-0-state;
		qcom,mdss-dsi-lane-1-state;
		qcom,mdss-dsi-lane-2-state;
		qcom,mdss-dsi-lane-3-state;
		qcom,mdss-dsi-panel-timings = [8B 1E 14 00 44 48 18 22 19 03 04 00];
		qcom,mdss-dsi-t-clk-post = <0x04>;
		qcom,mdss-dsi-t-clk-pre = <0x1C>;
		qcom,mdss-dsi-bl-min-level = <1>;
		qcom,mdss-dsi-bl-max-level = <255>;
		qcom,mdss-dsi-dma-trigger = "trigger_sw";
		qcom,mdss-dsi-mdp-trigger = "none";
		qcom,mdss-dsi-bl-pmic-control-type = "bl_ctrl_dcs";
		qcom,mdss-dsi-reset-sequence = <1 5>, <0 2>, <1 20>;
		qcom,mdss-pan-physical-width-dimension = <62>;
		qcom,mdss-pan-physical-height-dimension = <124>;
		zte,lcm_backlight_curve_mode = "lcd_brightness_max_350_lux";
		qcom,mdss-dsi-tx-eot-append;
		qcom,esd-check-enabled;
		qcom,mdss-dsi-panel-status-command=[06 01 00 01 05 00 01 D9
						06 01 00 01 05 00 01 09
						06 01 00 01 05 00 01 45];
		qcom,mdss-dsi-panel-status-command-state="dsi_lp_mode";
		qcom,mdss-dsi-panel-status-check-mode="reg_read";
		qcom,mdss-dsi-panel-status-value=<0x80 0x80 0x73 0x04 0x05 0xbb>;
		qcom,mdss-dsi-panel-status-read-length = <4 4 3>;
		qcom,mdss-dsi-panel-status-valid-params = <1 3 2>;
		qcom,mdss-dsi-panel-max-error-count = <3>;
	};
};
