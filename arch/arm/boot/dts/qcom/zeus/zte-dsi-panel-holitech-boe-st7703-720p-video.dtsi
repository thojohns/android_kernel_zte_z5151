/* Copyright (c) 2013, The Linux Foundation. All rights reserved.
 *
 * This program is free software; you can redistribute it and/or modify
 * it under the terms of the GNU General Public License version 2 and
 * only version 2 as published by the Free Software Foundation.
 *
 * This program is distributed in the hope that it will be useful,
 * but WITHOUT ANY WARRANTY; without even the implied warranty of
 * MERCHANTABILITY or FITNESS FOR A PARTICULAR PURPOSE.  See the
 * GNU General Public License for more details.
 */

/*---------------------------------------------------------------------------
 * This file is autogenerated file using gcdb parser. Please do not edit it.
 * Update input XML file to add a new entry or update variable in this file
 * VERSION = "1.0"
 *---------------------------------------------------------------------------*/
&mdss_mdp {
	dsi_holitech_boe_st7703_720p_video: qcom,mdss_dsi_holitech_boe_st7703_720p_video {
		qcom,mdss-dsi-panel-name = "holitech boe st7703 720p video mode dsi panel";
		zte,lcd-init-code-version = "20180511";
		zte,set-reset-pin-ctrl;
		qcom,cont-splash-enabled;
		zte,lcd_bl_vsp_vsn_voltage = <0xf>;
		qcom,panel-supply-entries = <&dsi_panel_pwr_supply>;
		qcom,mdss-dsi-panel-controller = <&mdss_dsi0>;
		qcom,mdss-dsi-panel-type = "dsi_video_mode";
		qcom,mdss-dsi-panel-destination = "display_1";
		qcom,mdss-dsi-panel-framerate = <60>;
		/*qcom,mdss-dsi-panel-clockrate = <866400000>;*/
		qcom,mdss-dsi-virtual-channel-id = <0>;
		qcom,mdss-dsi-stream = <0>;
		qcom,mdss-dsi-panel-width = <720>;
		qcom,mdss-dsi-panel-height = <1440>;
		qcom,mdss-dsi-h-front-porch = <100>;
		qcom,mdss-dsi-h-back-porch = <96>;
		qcom,mdss-dsi-h-pulse-width = <8>;
		qcom,mdss-dsi-h-sync-skew = <0>;
		qcom,mdss-dsi-v-back-porch = <20>;
		qcom,mdss-dsi-v-front-porch = <20>;
		qcom,mdss-dsi-v-pulse-width = <8>;
		qcom,mdss-dsi-h-left-border = <0>;
		qcom,mdss-dsi-h-right-border = <0>;
		qcom,mdss-dsi-v-top-border = <0>;
		qcom,mdss-dsi-v-bottom-border = <0>;
		qcom,mdss-dsi-bpp = <24>;
		qcom,mdss-dsi-color-order = "rgb_swap_rgb";
		qcom,mdss-dsi-underflow-color = <0xff>;
		qcom,mdss-dsi-border-color = <0>;
		qcom,mdss-dsi-on-command = [39 01 00 00 00 00 04 b9 f1 12 83
39 01 00 00 00 00 1c ba 33 81 05 f9 0e 0e 20 00 00 00 00 00 00 00 44 25 00 91 0a 00 00 02 4f 11 00 00 37
39 01 00 00 00 00 02 b8 76
39 01 00 00 00 00 0b b3 0c 10 05 05 03 ff 00 00 00 00
39 01 00 00 00 00 0a c0 73 73 50 50 c0 00 08 50 00
39 01 00 00 00 00 02 bc 4f
39 01 00 00 00 00 02 cc 0b
39 01 00 00 00 00 02 b4 80
39 01 00 00 00 00 04 b2 f0 12 a0
39 01 00 00 00 00 0f e3 07 07 0b 0b 03 0b 00 00 00 00 6f 00 c0 10
39 01 00 00 00 00 0d c1 53 c0 26 26 77 f1 ff ff ee ee ee ee
39 01 00 00 00 00 06 c6 02 40 cf 7f 00
39 01 00 00 00 00 03 b5 14 14
39 01 00 00 00 00 04 bf 02 11 00
39 01 00 00 00 00 40 e9 82 10 09 00 00 c1 89 12 31
			23 47 87 c1 89 47 2a 00 00 0c
			00 00 00 00 00 0c 00 00 00 88
			20 46 02 88 88 88 88 88 88 ff
			88 31 57 13 88 88 88 88 88 88
			ff 00 00 00 00 00 00 00 00 00
			00 00 00 00
39 01 00 00 00 00 3e ea 00 1a 00 00 00 00 02 00 00 00
			00 00 8f 13 31 75 88 88 88 88
			88 88 f8 8f 02 20 64 88 88 88
			88 88 88 f8 23 00 00 00 00 00
			00 00 00 00 00 00 00 00 00 00
			00 00 00 00 00 00 00 00 00 00
			00
39 01 00 00 00 00 23 e0 00 03 07 28 2f 38 36 36 05 0b
			0d 10 12 10 12 12 18 00 03 07
			28 2f 38 36 36 05 0b 0d 10 12
			10 12 12 18
39 01 00 00 00 00 04 c8 10 01 02
39 01 00 00 00 00 02 51 00
39 01 00 00 00 00 02 53 2c
39 01 00 00 00 00 02 55 01
39 01 00 00 00 00 02 5e 04
05 01 00 00 78 00 02 11 00
05 01 00 00 14 00 02 29 00
39 01 00 00 00 00 02 c7 a0];
		qcom,mdss-dsi-off-command = [39 01 00 00 00 00 02 53 00
					05 01 00 00 32 00 02 28 00
					05 01 00 00 78 00 02 10 00];
		qcom,mdss-dsi-on-command-state = "dsi_lp_mode";
		qcom,mdss-dsi-off-command-state = "dsi_hs_mode";
		zte,mdss-dsi-cabc-default-value = <0x01>;
		zte,mdss-dsi-cabc-off-command = [39 01 00 00 00 00 02 55 00
		];
		zte,mdss-dsi-cabc-low-command = [39 01 00 00 00 00 02 55 01
		];
		zte,mdss-dsi-cabc-medium-command = [39 01 00 00 00 00 02 55 02
		];
		zte,mdss-dsi-cabc-high-command = [39 01 00 00 00 00 02 55 03
		];
		zte,mdss-dsi-cabc-command-state = "dsi_lp_mode";
		qcom,mdss-dsi-lp11-init;
		qcom,mdss-dsi-h-sync-pulse = <1>;
		qcom,mdss-dsi-traffic-mode = "burst_mode";
		qcom,mdss-dsi-lane-map = "lane_map_0123";
		qcom,mdss-dsi-bllp-eof-power-mode;
		qcom,mdss-dsi-bllp-power-mode;
		qcom,mdss-dsi-lane-0-state;
		qcom,mdss-dsi-lane-1-state;
		qcom,mdss-dsi-lane-2-state;
		qcom,mdss-dsi-lane-3-state;
		qcom,mdss-dsi-panel-timings = [8B 1E 14 00 44 48 18 22 19 03 04 00];
		qcom,mdss-dsi-t-clk-post = <0x04>;
		qcom,mdss-dsi-t-clk-pre = <0x1C>;
		qcom,mdss-dsi-bl-min-level = <4>;
		qcom,mdss-dsi-bl-max-level = <255>;
		qcom,mdss-dsi-dma-trigger = "trigger_sw";
		qcom,mdss-dsi-mdp-trigger = "none";
		qcom,mdss-dsi-bl-pmic-control-type = "bl_ctrl_dcs";
		qcom,mdss-dsi-reset-sequence = <1 5>, <0 2>, <1 20>;
		qcom,mdss-pan-physical-width-dimension = <62>;
		qcom,mdss-pan-physical-height-dimension = <124>;
		zte,lcm_backlight_curve_mode = "lcd_brightness_max_350_lux";
		qcom,mdss-dsi-tx-eot-append;
		qcom,esd-check-enabled;
		qcom,mdss-dsi-panel-status-command=[14 01 00 01 05 00 01 09
						14 01 00 01 05 00 01 0a
						14 01 00 01 05 00 01 68];
		qcom,mdss-dsi-panel-status-command-state="dsi_lp_mode";
		qcom,mdss-dsi-panel-status-check-mode="reg_read";
		qcom,mdss-dsi-panel-status-value=<0x80 0x9c 0xc0>;
		qcom,mdss-dsi-panel-status-read-length = <3 3 3>;
		qcom,mdss-dsi-panel-status-valid-params = <1 1 1>;
	};
};
