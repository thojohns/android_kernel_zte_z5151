/* Copyright (c) 2013, The Linux Foundation. All rights reserved.
 *
 * This program is free software; you can redistribute it and/or modify
 * it under the terms of the GNU General Public License version 2 and
 * only version 2 as published by the Free Software Foundation.
 *
 * This program is distributed in the hope that it will be useful,
 * but WITHOUT ANY WARRANTY; without even the implied warranty of
 * MERCHANTABILITY or FITNESS FOR A PARTICULAR PURPOSE.  See the
 * GNU General Public License for more details.
 */

/*---------------------------------------------------------------------------
 * This file is autogenerated file using gcdb parser. Please do not edit it.
 * Update input XML file to add a new entry or update variable in this file
 * VERSION = "1.0"
 *---------------------------------------------------------------------------*/
&mdss_mdp {
	dsi_skyworth_ili9881c_720p_video: qcom,mdss_dsi_skyworth_ili9881c_720p_video {
		qcom,mdss-dsi-panel-name = "skyworth ili9881c 720p video mode dsi panel";
		zte,lcd-init-code-version = "20180329";
		qcom,cont-splash-enabled;
		zte,lcd_bl_vsp_vsn_voltage = <0xf>;
		qcom,panel-supply-entries = <&dsi_panel_pwr_supply>;
		qcom,mdss-dsi-panel-controller = <&mdss_dsi0>;
		qcom,mdss-dsi-panel-type = "dsi_video_mode";
		qcom,mdss-dsi-panel-destination = "display_1";
		qcom,mdss-dsi-panel-framerate = <60>;
		/*qcom,mdss-dsi-panel-clockrate = <866400000>;*/
		qcom,mdss-dsi-virtual-channel-id = <0>;
		qcom,mdss-dsi-stream = <0>;
		qcom,mdss-dsi-panel-width = <720>;
		qcom,mdss-dsi-panel-height = <1440>;
		qcom,mdss-dsi-h-front-porch = <100>;
		qcom,mdss-dsi-h-back-porch = <96>;
		qcom,mdss-dsi-h-pulse-width = <8>;
		qcom,mdss-dsi-h-sync-skew = <0>;
		qcom,mdss-dsi-v-back-porch = <20>;
		qcom,mdss-dsi-v-front-porch = <20>;
		qcom,mdss-dsi-v-pulse-width = <8>;
		qcom,mdss-dsi-h-left-border = <0>;
		qcom,mdss-dsi-h-right-border = <0>;
		qcom,mdss-dsi-v-top-border = <0>;
		qcom,mdss-dsi-v-bottom-border = <0>;
		qcom,mdss-dsi-bpp = <24>;
		qcom,mdss-dsi-color-order = "rgb_swap_rgb";
		qcom,mdss-dsi-underflow-color = <0xff>;
		qcom,mdss-dsi-border-color = <0>;
		qcom,mdss-dsi-on-command = [39 01 00 00 00 00 04 ff 98 81 03
39 01 00 00 00 00 02 01 00
39 01 00 00 00 00 02 02 00
39 01 00 00 00 00 02 03 53
39 01 00 00 00 00 02 04 13
39 01 00 00 00 00 02 05 00
39 01 00 00 00 00 02 06 04
39 01 00 00 00 00 02 07 02
39 01 00 00 00 00 02 08 00
39 01 00 00 00 00 02 09 28
39 01 00 00 00 00 02 0a 28
39 01 00 00 00 00 02 0b 00
39 01 00 00 00 00 02 0c 01
39 01 00 00 00 00 02 0d 00
39 01 00 00 00 00 02 0e 00
39 01 00 00 00 00 02 0f 16
39 01 00 00 00 00 02 10 16
39 01 00 00 00 00 02 11 00
39 01 00 00 00 00 02 12 00
39 01 00 00 00 00 02 13 00
39 01 00 00 00 00 02 14 00
39 01 00 00 00 00 02 15 00
39 01 00 00 00 00 02 16 00
39 01 00 00 00 00 02 17 00
39 01 00 00 00 00 02 18 00
39 01 00 00 00 00 02 19 00
39 01 00 00 00 00 02 1a 00
39 01 00 00 00 00 02 1b 00
39 01 00 00 00 00 02 1c 00
39 01 00 00 00 00 02 1d 00
39 01 00 00 00 00 02 1e 44
39 01 00 00 00 00 02 1f 80
39 01 00 00 00 00 02 20 02
39 01 00 00 00 00 02 21 03
39 01 00 00 00 00 02 22 00
39 01 00 00 00 00 02 23 00
39 01 00 00 00 00 02 24 00
39 01 00 00 00 00 02 25 00
39 01 00 00 00 00 02 26 00
39 01 00 00 00 00 02 27 00
39 01 00 00 00 00 02 28 33
39 01 00 00 00 00 02 29 03
39 01 00 00 00 00 02 2a 00
39 01 00 00 00 00 02 2b 00
39 01 00 00 00 00 02 2c 00
39 01 00 00 00 00 02 2d 00
39 01 00 00 00 00 02 2e 00
39 01 00 00 00 00 02 2f 00
39 01 00 00 00 00 02 30 00
39 01 00 00 00 00 02 31 00
39 01 00 00 00 00 02 32 00
39 01 00 00 00 00 02 33 00
39 01 00 00 00 00 02 34 04
39 01 00 00 00 00 02 35 00
39 01 00 00 00 00 02 36 00
39 01 00 00 00 00 02 37 00
39 01 00 00 00 00 02 38 3c
39 01 00 00 00 00 02 39 00
39 01 00 00 00 00 02 3a 40
39 01 00 00 00 00 02 3b 40
39 01 00 00 00 00 02 3c 00
39 01 00 00 00 00 02 3d 00
39 01 00 00 00 00 02 3e 00
39 01 00 00 00 00 02 3f 00
39 01 00 00 00 00 02 40 00
39 01 00 00 00 00 02 41 00
39 01 00 00 00 00 02 42 00
39 01 00 00 00 00 02 43 00
39 01 00 00 00 00 02 44 00
39 01 00 00 00 00 02 50 01
39 01 00 00 00 00 02 51 23
39 01 00 00 00 00 02 52 45
39 01 00 00 00 00 02 53 67
39 01 00 00 00 00 02 54 89
39 01 00 00 00 00 02 55 ab
39 01 00 00 00 00 02 56 01
39 01 00 00 00 00 02 57 23
39 01 00 00 00 00 02 58 45
39 01 00 00 00 00 02 59 67
39 01 00 00 00 00 02 5a 89
39 01 00 00 00 00 02 5b ab
39 01 00 00 00 00 02 5c cd
39 01 00 00 00 00 02 5d ef
39 01 00 00 00 00 02 5e 11
39 01 00 00 00 00 02 5f 01
39 01 00 00 00 00 02 60 00
39 01 00 00 00 00 02 61 15
39 01 00 00 00 00 02 62 14
39 01 00 00 00 00 02 63 0c
39 01 00 00 00 00 02 64 0d
39 01 00 00 00 00 02 65 0e
39 01 00 00 00 00 02 66 0f
39 01 00 00 00 00 02 67 06
39 01 00 00 00 00 02 68 02
39 01 00 00 00 00 02 69 02
39 01 00 00 00 00 02 6a 02
39 01 00 00 00 00 02 6b 02
39 01 00 00 00 00 02 6c 02
39 01 00 00 00 00 02 6d 02
39 01 00 00 00 00 02 6e 08
39 01 00 00 00 00 02 6f 02
39 01 00 00 00 00 02 70 02
39 01 00 00 00 00 02 71 02
39 01 00 00 00 00 02 72 02
39 01 00 00 00 00 02 73 02
39 01 00 00 00 00 02 74 02
39 01 00 00 00 00 02 75 01
39 01 00 00 00 00 02 76 00
39 01 00 00 00 00 02 77 15
39 01 00 00 00 00 02 78 14
39 01 00 00 00 00 02 79 0c
39 01 00 00 00 00 02 7a 0d
39 01 00 00 00 00 02 7b 0e
39 01 00 00 00 00 02 7c 0f
39 01 00 00 00 00 02 7d 08
39 01 00 00 00 00 02 7e 02
39 01 00 00 00 00 02 7f 02
39 01 00 00 00 00 02 80 02
39 01 00 00 00 00 02 81 02
39 01 00 00 00 00 02 82 02
39 01 00 00 00 00 02 83 02
39 01 00 00 00 00 02 84 06
39 01 00 00 00 00 02 85 02
39 01 00 00 00 00 02 86 02
39 01 00 00 00 00 02 87 02
39 01 00 00 00 00 02 88 02
39 01 00 00 00 00 02 89 02
39 01 00 00 00 00 02 8a 02
39 01 00 00 00 00 04 ff 98 81 04
39 01 00 00 00 00 02 6c 15
39 01 00 00 00 00 02 6e 2b
39 01 00 00 00 00 02 6f 35
39 01 00 00 00 00 02 35 1f
39 01 00 00 00 00 02 3a 24
39 01 00 00 00 00 02 8d 1a
39 01 00 00 00 00 02 87 ba
39 01 00 00 00 00 02 26 76
39 01 00 00 00 00 02 b2 d1
39 01 00 00 00 00 02 b5 06
39 01 00 00 00 00 02 33 14
39 01 00 00 00 00 04 ff 98 81 01
39 01 00 00 00 00 02 22 0a
39 01 00 00 00 00 02 31 00
39 01 00 00 00 00 02 53 8f
39 01 00 00 00 00 02 55 9c
39 01 00 00 00 00 02 50 c7
39 01 00 00 00 00 02 51 c4
39 01 00 00 00 00 02 60 1a
39 01 00 00 00 00 02 62 00
39 01 00 00 00 00 02 63 00
39 01 00 00 00 00 02 2e f0
39 01 00 00 00 00 02 a0 00
39 01 00 00 00 00 02 a1 1f
39 01 00 00 00 00 02 a2 2d
39 01 00 00 00 00 02 a3 1f
39 01 00 00 00 00 02 a4 18
39 01 00 00 00 00 02 a5 2b
39 01 00 00 00 00 02 a6 1f
39 01 00 00 00 00 02 a7 20
39 01 00 00 00 00 02 a8 8b
39 01 00 00 00 00 02 a9 1c
39 01 00 00 00 00 02 aa 28
39 01 00 00 00 00 02 ab 76
39 01 00 00 00 00 02 ac 1b
39 01 00 00 00 00 02 ad 19
39 01 00 00 00 00 02 ae 4e
39 01 00 00 00 00 02 af 22
39 01 00 00 00 00 02 b0 28
39 01 00 00 00 00 02 b1 50
39 01 00 00 00 00 02 b2 60
39 01 00 00 00 00 02 b3 2f
39 01 00 00 00 00 02 c0 00
39 01 00 00 00 00 02 c1 1f
39 01 00 00 00 00 02 c2 2d
39 01 00 00 00 00 02 c3 15
39 01 00 00 00 00 02 c4 18
39 01 00 00 00 00 02 c5 2b
39 01 00 00 00 00 02 c6 1f
39 01 00 00 00 00 02 c7 20
39 01 00 00 00 00 02 c8 8b
39 01 00 00 00 00 02 c9 1c
39 01 00 00 00 00 02 ca 28
39 01 00 00 00 00 02 cb 76
39 01 00 00 00 00 02 cc 1b
39 01 00 00 00 00 02 cd 19
39 01 00 00 00 00 02 ce 4e
39 01 00 00 00 00 02 cf 22
39 01 00 00 00 00 02 d0 28
39 01 00 00 00 00 02 d1 50
39 01 00 00 00 00 02 d2 60
39 01 00 00 00 00 02 d3 2f
39 01 00 00 00 00 04 ff 98 81 02
39 01 00 00 00 00 02 06 20
39 01 00 00 00 00 02 07 00
39 01 00 00 00 00 02 03 ee
39 01 00 00 00 00 02 04 16
39 01 00 00 00 00 02 05 11
39 01 00 00 00 00 02 00 fb
39 01 00 00 00 00 02 01 3f
39 01 00 00 00 00 02 02 f6
39 01 00 00 00 00 02 08 30
39 01 00 00 00 00 02 20 3e
39 01 00 00 00 00 02 21 3e
39 01 00 00 00 00 02 22 3e
39 01 00 00 00 00 02 23 3d
39 01 00 00 00 00 02 24 3c
39 01 00 00 00 00 02 25 3c
39 01 00 00 00 00 02 26 38
39 01 00 00 00 00 02 29 29
39 01 00 00 00 00 02 2c fe
39 01 00 00 00 00 02 2d 3e
39 01 00 00 00 00 02 2e fd
39 01 00 00 00 00 02 2f 3c
39 01 00 00 00 00 02 30 38
39 01 00 00 00 00 02 31 b4
39 01 00 00 00 00 02 32 b0
39 01 00 00 00 00 02 33 ee
39 01 00 00 00 00 02 34 fe
39 01 00 00 00 00 02 35 3e
39 01 00 00 00 00 02 36 fd
39 01 00 00 00 00 04 ff 98 81 00
39 01 00 00 00 00 03 68 04 00
39 01 00 00 00 00 03 51 00 00
39 01 00 00 00 00 02 53 24
39 01 00 00 00 00 02 55 02
39 01 00 00 00 00 03 5e 00 10
39 01 00 00 00 00 02 35 00
05 01 00 00 78 00 02 11 00
05 01 00 00 14 00 02 29 00 ];
		qcom,mdss-dsi-off-command = [39 01 00 00 00 00 02 53 00
					05 01 00 00 32 00 02 28 00
					05 01 00 00 78 00 02 10 00];
		qcom,mdss-dsi-on-command-state = "dsi_lp_mode";
		qcom,mdss-dsi-off-command-state = "dsi_hs_mode";
		zte,mdss-dsi-cabc-default-value = <0x02>;
		zte,mdss-dsi-cabc-off-command = [39 01 00 00 00 00 02 55 00
		];
		zte,mdss-dsi-cabc-low-command = [39 01 00 00 00 00 02 55 01
		];
		zte,mdss-dsi-cabc-medium-command = [39 01 00 00 00 00 02 55 02
		];
		zte,mdss-dsi-cabc-high-command = [39 01 00 00 00 00 02 55 03
		];
		zte,mdss-dsi-cabc-command-state = "dsi_lp_mode";
		qcom,mdss-dsi-lp11-init;
		qcom,mdss-dsi-h-sync-pulse = <1>;
		qcom,mdss-dsi-traffic-mode = "burst_mode";
		qcom,mdss-dsi-lane-map = "lane_map_0123";
		qcom,mdss-dsi-bllp-eof-power-mode;
		qcom,mdss-dsi-bllp-power-mode;
		qcom,mdss-dsi-lane-0-state;
		qcom,mdss-dsi-lane-1-state;
		qcom,mdss-dsi-lane-2-state;
		qcom,mdss-dsi-lane-3-state;
		qcom,mdss-dsi-panel-timings = [8B 1E 14 00 44 48 18 22 19 03 04 00];
		qcom,mdss-dsi-t-clk-post = <0x04>;
		qcom,mdss-dsi-t-clk-pre = <0x1C>;
		qcom,mdss-dsi-bl-min-level = <1>;
		qcom,mdss-dsi-bl-max-level = <4095>;
		qcom,mdss-dsi-dma-trigger = "trigger_sw";
		qcom,mdss-dsi-mdp-trigger = "none";
		qcom,mdss-dsi-bl-pmic-control-type = "bl_ctrl_dcs";
		qcom,mdss-dsi-reset-sequence = <1 5>, <0 2>, <1 20>;
		qcom,mdss-pan-physical-width-dimension = <62>;
		qcom,mdss-pan-physical-height-dimension = <124>;
		zte,lcm_backlight_curve_mode = "lcd_brightness_max_350_lux";
		qcom,mdss-dsi-tx-eot-append;
		qcom,esd-check-enabled;
		qcom,mdss-dsi-panel-status-command=[06 01 00 01 05 00 02 0A 00
						06 01 00 01 05 00 02 0E 00];
		qcom,mdss-dsi-panel-status-command-state="dsi_lp_mode";
		qcom,mdss-dsi-panel-status-check-mode="reg_read";
		qcom,mdss-dsi-panel-status-value=<0x9C 0x80>;
		qcom,mdss-dsi-panel-status-read-length = <1 1>;
	};
};
