/* Copyright (c) 2015, The Linux Foundation. All rights reserved.
 *
 * This program is free software; you can redistribute it and/or modify
 * it under the terms of the GNU General Public License version 2 and
 * only version 2 as published by the Free Software Foundation.
 *
 * This program is distributed in the hope that it will be useful,
 * but WITHOUT ANY WARRANTY; without even the implied warranty of
 * MERCHANTABILITY or FITNESS FOR A PARTICULAR PURPOSE.  See the
 * GNU General Public License for more details.
 */

&mdss_mdp {
	dsi_TM_NT35695_TM_6p0_1080P_video_vid: qcom,mdss_dsi_tm_nt35695_tm_6p0_1080p_video {
		qcom,mdss-dsi-panel-name = "zteTM(NT35695)TM_1080*1920_6P0Inch";
		qcom,mdss-dsi-panel-type = "dsi_video_mode";
		qcom,cont-splash-enabled;
		qcom,mdss-dsi-panel-status-read-length = <1>;
		qcom,mdss-pan-physical-width-dimension = <75>;
		qcom,mdss-pan-physical-height-dimension = <132>;
		qcom,mdss-dsi-panel-framerate = <60>;
		qcom,mdss-dsi-virtual-channel-id = <0>;
		qcom,mdss-dsi-stream = <0>;
		qcom,mdss-dsi-panel-width = <1080>;
		qcom,mdss-dsi-panel-height = <1920>;
		qcom,mdss-dsi-h-front-porch = <49>; //modify porch to solve blur screen problem.
		qcom,mdss-dsi-h-back-porch = <40>;// mipi= 838.24MHz
		qcom,mdss-dsi-h-pulse-width = <30>;
		qcom,mdss-dsi-h-sync-skew = <0>;
		qcom,mdss-dsi-v-back-porch = <6>;
		qcom,mdss-dsi-v-front-porch = <14>;
		qcom,mdss-dsi-v-pulse-width = <2>;
		qcom,mdss-dsi-h-left-border = <0>;
		qcom,mdss-dsi-h-right-border = <0>;
		qcom,mdss-dsi-v-top-border = <0>;
		qcom,mdss-dsi-v-bottom-border = <0>;
		qcom,mdss-dsi-bpp = <24>;
		qcom,mdss-dsi-underflow-color = <0xff>;
		qcom,mdss-dsi-border-color = <0>;
		qcom,mdss-dsi-h-sync-pulse = <0>;
		qcom,mdss-dsi-traffic-mode = "burst_mode";

		qcom,mdss-dsi-te-pin-select = <1>;
		qcom,mdss-dsi-te-dcs-command = <1>;
		qcom,mdss-dsi-te-check-enable;
		qcom,mdss-dsi-te-using-te-pin;
		qcom,mdss-dsi-wr-mem-start = <0x2c>;
		qcom,mdss-dsi-wr-mem-continue = <0x3c>;

		qcom,mdss-dsi-bllp-eof-power-mode;
		qcom,mdss-dsi-bllp-power-mode;
		qcom,mdss-dsi-lane-0-state;
		qcom,mdss-dsi-lane-1-state;
		qcom,mdss-dsi-lane-2-state;
		qcom,mdss-dsi-lane-3-state;
		qcom,mdss-dsi-panel-timings = [DB 34 22 00 64 66 28 38 2B 03 04 00];
		//qcom,mdss-dsi-panel-timings-phy-v2 = [
		//	23 1f 07 09 05 03 04 a0
		//	23 1f 07 09 05 03 04 a0
		//	23 1f 07 09 05 03 04 a0
		//	23 1f 07 09 05 03 04 a0
		//	23 1a 07 08 05 03 04 a0];
		qcom,mdss-dsi-t-clk-post = <0x23>;// 03 ,23-383ns,nt35695 > 350ns
		qcom,mdss-dsi-t-clk-pre = <0x29>;
		qcom,mdss-dsi-bl-min-level = <1>;
		qcom,mdss-dsi-bl-max-level = <255>;
		qcom,mdss-dsi-dma-trigger = "trigger_sw";
		qcom,mdss-dsi-mdp-trigger = "none";

		zte,panel-keep-reset-gpio-high;//pan,keep reset gpio high 0620

		qcom,mdss-dsi-on-command = [

				39 01 00 00 00 00 02 FF 23  /* CMD2 PAGE3 */
				39 01 00 00 00 00 02 FB 01
				39 01 00 00 00 00 02 03 05
				39 01 00 00 00 00 02 07 20
				39 01 00 00 00 00 02 08 03  /* pwm:30 */
				39 01 00 00 00 00 02 46 20

				39 01 00 00 00 00 02 ff 10
				39 01 00 00 00 00 02 53 2c
				39 01 00 00 00 00 02 55 00
				39 01 00 00 00 00 02 35 01
				39 01 00 00 00 00 02 36 00
				39 01 00 00 00 00 02 bb 03  /* 13 -vdieo mode, 10 -cmd mode */
				39 01 00 00 00 00 06 3b 00 08 0e 28 27

				39 01 00 00 00 00 02 53 2c
				05 01 00 00 78 00 02 11 00
				05 01 00 00 0a 00 02 29 00
			];
		qcom,mdss-dsi-off-command = [05 01 00 00 96 00 02 28 00
				 05 01 00 00 96 00 02 10 00
				 39 01 00 00 00 00 02 4f 01 //pan ,send for deep sleep while keep rst high 0620
				 ];
		qcom,mdss-dsi-on-command-state = "dsi_lp_mode";
		qcom,mdss-dsi-off-command-state = "dsi_hs_mode";
		qcom,mdss-dsi-bl-pmic-control-type ="bl_ctrl_dcs";
		qcom,mdss-dsi-reset-sequence = <1 20>, <0 20>, <1 20>;
		//qcom,mdss-dsi-tx-eot-append;
	};
};
