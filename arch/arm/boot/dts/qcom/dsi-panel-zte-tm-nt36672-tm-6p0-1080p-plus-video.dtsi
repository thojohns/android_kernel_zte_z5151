/* Copyright (c) 2015, The Linux Foundation. All rights reserved.
 *
 * This program is free software; you can redistribute it and/or modify
 * it under the terms of the GNU General Public License version 2 and
 * only version 2 as published by the Free Software Foundation.
 *
 * This program is distributed in the hope that it will be useful,
 * but WITHOUT ANY WARRANTY; without even the implied warranty of
 * MERCHANTABILITY or FITNESS FOR A PARTICULAR PURPOSE.  See the
 * GNU General Public License for more details.
 */

&mdss_mdp {
	dsi_tm_nt36672_tm_6p0_1080p_plus_video_vid: qcom,mdss_dsi_tm_nt36672_tm_5p99_1080p_plus_video {
		qcom,mdss-dsi-panel-name = "zteTM(NT36672)TM_1080*2160_6P0Inch";
		qcom,mdss-dsi-panel-type = "dsi_video_mode";
		qcom,cont-splash-enabled;
		qcom,mdss-pan-physical-width-dimension = <68>;
		qcom,mdss-pan-physical-height-dimension = <136>;
		qcom,mdss-dsi-panel-framerate = <60>;
		qcom,mdss-dsi-virtual-channel-id = <0>;
		qcom,mdss-dsi-stream = <0>;
		qcom,mdss-dsi-panel-width = <1080>;
		qcom,mdss-dsi-panel-height = <2160>;
		qcom,mdss-dsi-h-front-porch = <13>;	//mipi clk :927M
		qcom,mdss-dsi-h-back-porch = <62>;
		qcom,mdss-dsi-h-pulse-width = <20>;
		qcom,mdss-dsi-h-sync-skew = <0>;
		qcom,mdss-dsi-v-back-porch = <6>;
		qcom,mdss-dsi-v-front-porch = <4>;
		qcom,mdss-dsi-v-pulse-width = <2>;
		qcom,mdss-dsi-h-left-border = <0>;
		qcom,mdss-dsi-h-right-border = <0>;
		qcom,mdss-dsi-v-top-border = <0>;
		qcom,mdss-dsi-v-bottom-border = <0>;
		qcom,mdss-dsi-bpp = <24>;
		qcom,mdss-dsi-underflow-color = <0xff>;
		qcom,mdss-dsi-border-color = <0>;
		qcom,mdss-dsi-h-sync-pulse = <0>;
		qcom,mdss-dsi-traffic-mode = "burst_mode";
		qcom,mdss-dsi-bllp-eof-power-mode;
		qcom,mdss-dsi-bllp-power-mode;
		qcom,mdss-dsi-lp11-init;
		qcom,mdss-dsi-lane-0-state;
		qcom,mdss-dsi-lane-1-state;
		qcom,mdss-dsi-lane-2-state;
		qcom,mdss-dsi-lane-3-state;
		qcom,mdss-dsi-panel-timings = [f3 3a 26 00 6a 6e 2c 3e 2f 03 04 00];
		qcom,mdss-dsi-t-clk-post = <0x2>;
		qcom,mdss-dsi-t-clk-pre = <0x2d>;
		qcom,mdss-dsi-bl-min-level = <2>;
		qcom,mdss-dsi-bl-max-level = <255>;
		qcom,mdss-dsi-dma-trigger = "trigger_sw";
		qcom,mdss-dsi-mdp-trigger = "none";

		qcom,esd-check-enabled;
		qcom,mdss-dsi-panel-status-command = [14 01 00 01 05 00 01 0A];
		qcom,mdss-dsi-panel-status-command-mode = "dsi_lp_mode";
		qcom,mdss-dsi-panel-status-check-mode = "reg_read";
		qcom,mdss-dsi-panel-status-value = <0x9C>;

		qcom,mdss-dsi-on-command= [
		39 01 00 00 00 00 04 ff 78 07 00
		39 01 00 00 00 00 02 ff 23
		39 01 00 00 00 00 02 fb 01
		//39 01 00 00 00 00 02 08 04

		39 01 00 00 00 00 02 07 20
		39 01 00 00 00 00 02 08 04
		39 01 00 00 00 00 02 09 00
		39 01 00 00 00 00 02 10 20
		39 01 00 00 00 00 02 11 01
		39 01 00 00 00 00 02 12 a4
		39 01 00 00 00 00 02 15 e6
		39 01 00 00 00 00 02 16 0c
		39 01 00 00 00 00 02 30 ff
		39 01 00 00 00 00 02 31 FF
		39 01 00 00 00 00 02 32 FF
		39 01 00 00 00 00 02 33 FF
		39 01 00 00 00 00 02 34 FF
		39 01 00 00 00 00 02 35 FF
		39 01 00 00 00 00 02 36 FF
		39 01 00 00 00 00 02 37 FF
		39 01 00 00 00 00 02 38 FF
		39 01 00 00 00 00 02 39 FF
		39 01 00 00 00 00 02 3A FF
		39 01 00 00 00 00 02 3B FA
		39 01 00 00 00 00 02 3D F5
		39 01 00 00 00 00 02 3F EA
		39 01 00 00 00 00 02 40 DA
		39 01 00 00 00 00 02 41 98

		39 01 00 00 00 00 02 ff 10
		39 01 00 00 00 00 02 51 00
		39 01 00 00 00 00 02 53 2c
		39 01 00 00 00 00 02 55 01
		05 01 00 00 64 00 02 11 00
		05 01 00 00 16 00 02 29 00
		];

		qcom,mdss-dsi-off-command = [
		29 01 00 00 00 00 02 ff 10
		05 01 00 00 96 00 02 28 00
		05 01 00 00 96 00 02 10 00
		29 01 00 00 00 00 02 4f 01
		];
		qcom,mdss-dsi-on-command-state = "dsi_lp_mode";
		qcom,mdss-dsi-off-command-state = "dsi_hs_mode";
		qcom,mdss-dsi-bl-pmic-control-type ="bl_ctrl_dcs";
		qcom,mdss-dsi-reset-sequence = <1 5>, <0 10>, <1 5>;
	};
};
