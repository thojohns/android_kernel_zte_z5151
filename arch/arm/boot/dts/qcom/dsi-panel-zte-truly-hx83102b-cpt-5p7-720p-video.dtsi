 /* Copyright (c) 2015, The Linux Foundation. All rights reserved.
 *
 * This program is free software; you can redistribute it and/or modify
 * it under the terms of the GNU General Public License version 2 and
 * only version 2 as published by the Free Software Foundation.
 *
 * This program is distributed in the hope that it will be useful,
 * but WITHOUT ANY WARRANTY; without even the implied warranty of
 * MERCHANTABILITY or FITNESS FOR A PARTICULAR PURPOSE.  See the
 * GNU General Public License for more details.
 */
&mdss_mdp {
	dsi_truly_hx83102b_cpt_720p_video: qcom,mdss_dsi_truly_hx83102b_cpt_720p_video {
		qcom,mdss-dsi-panel-name = "hx83102b truly 720p video 5p7inch dsi panel";
		qcom,cont-splash-enabled;
		zte,lcd_bl_vsp_vsn_voltage = <0xf>;
		qcom,mdss-dsi-panel-controller = <&mdss_dsi0>;
		qcom,mdss-dsi-panel-type = "dsi_video_mode";
		qcom,mdss-dsi-panel-framerate = <60>;
		qcom,mdss-dsi-virtual-channel-id = <0>;
		qcom,mdss-dsi-stream = <0>;
		qcom,mdss-dsi-panel-width = <720>;
		qcom,mdss-dsi-panel-height = <1440>;
		qcom,mdss-dsi-h-front-porch = <5>;
		qcom,mdss-dsi-h-back-porch = <8>;
		qcom,mdss-dsi-h-pulse-width = <2>;
		qcom,mdss-dsi-h-sync-skew = <0>;
		qcom,mdss-dsi-v-back-porch = <6>;
		qcom,mdss-dsi-v-front-porch = <238>;
		qcom,mdss-dsi-v-pulse-width = <2>;
		qcom,mdss-dsi-h-left-border = <0>;
		qcom,mdss-dsi-h-right-border = <0>;
		qcom,mdss-dsi-v-top-border = <0>;
		qcom,mdss-dsi-v-bottom-border = <0>;
		qcom,mdss-dsi-bpp = <24>;
		qcom,mdss-dsi-color-order = "rgb_swap_rgb";
		qcom,mdss-dsi-underflow-color = <0xff>;
		qcom,mdss-dsi-border-color = <0>;
		qcom,mdss-dsi-on-command = [
			39 01 00 00 00 00 04 B9 83 10 2B
			39 01 00 00 00 00 0e B1 04 2A 27 27 11 7B 03 84 04 CD 57 CC 33
			39 01 00 00 00 00 0f B2 00 00 78 00 06 C8 7E 00 00 00 00 14 60 D7
			39 01 00 00 00 00 0f B4 01 56 01 56 01 56 01 56 03 FF 01 20 00 FF
			39 01 00 00 00 00 02 CC 02
			39 01 00 00 00 00 28 D3 00 00 01 01 01 01 01 01 3C 03
					0C 00 5B 00 55 57 04 04 00 00
					32 10 02 00 02 32 15 A9 05 A9
					32 10 08 00 00 00 00 00 00
			39 01 00 00 00 00 2d D5 24 25 18 18 18 18 19 19 18 18
					00 01 02 03 04 05 18 18 18 18
					06 07 08 09 0A 0B 18 18 18 18
					18 18 20 21 18 18 18 18 18 18
					18 18 18 18
			39 01 00 00 00 00 2d D6 21 20 18 18 19 19 18 18 18 18
					0B 0A 09 08 07 06 18 18 18 18
					05 04 03 02 01 00 18 18 18 18
					18 18 25 24 18 18 18 18 18 18
					18 18 18 18
			39 01 00 00 00 00 1c E7 14 14 12 82 10 82 00 00 00 00
					02 02 FF 0F 14 14 32 B9 23 B9
					00 00 28 00 00 00 07
			39 01 00 00 00 00 02 BD 01
			39 01 00 00 00 00 0a E7 01 07 40 01 40 13 44 14 01
			39 01 00 00 00 00 02 BD 00
			39 01 00 00 00 00 04 B6 8F 8F E0
			39 01 00 00 00 00 02 C1 01
			39 01 00 00 00 00 02 BD 01
			39 01 00 00 00 00 3a C1 00 09 14 1E 26 2D 32 3C 41 44
					48 4C 4F 52 54 57 5A 5C 5F 63
					68 6C 70 74 78 7C 7F 83 88 8C
					91 95 9B A1 A7 AE B7 C1 CD DC
					E7 ED F3 FA FF 2E 4E 38 0E 22
					04 0F 13 46 03 05 00
			39 01 00 00 00 00 02 BD 02
			39 01 00 00 00 00 3a C1 00 09 14 1E 26 2D 32 3C 41 44
					48 4C 4F 52 54 57 5A 5C 5F 63
					68 6C 70 74 78 7C 7F 83 88 8C
					91 95 9B A1 A7 AE B7 C1 CD DC
					E7 ED F3 FA FF 2E 4E 38 0E 22
					04 0F 13 46 03 05 00
			39 01 00 00 00 00 02 BD 03
			39 01 00 00 00 00 3a C1 00 09 14 1E 26 2D 32 3C 41 44
					48 4C 4F 52 54 57 5A 5C 5F 63
					68 6C 70 74 78 7C 7F 83 88 8C
					91 95 9B A1 A7 AE B7 C1 CD DC
					E7 ED F3 FA FF 2E 4E 38 0E 22
					04 0F 13 46 03 05 00
			39 01 00 00 00 00 02 BD 00
			39 01 00 00 00 00 05 C0 33 33 00 B3
			39 01 00 00 00 00 06 BF 00 00 00 04 83
			39 01 00 00 00 00 0b C7 00 C2 30 02 42 00 00 00 00 0C
			39 01 00 00 00 00 05 C9 04 07 C9 00
			39 01 00 00 00 00 02 35 01
			39 01 00 00 00 00 03 51 00 00
			39 01 00 00 00 00 02 53 24
			39 01 00 00 00 00 02 55 02
			39 01 00 00 78 00 02 11 00
			39 01 00 00 0A 00 02 29 00
		];
		qcom,mdss-dsi-off-command = [
			05 01 00 00 32 00 02 28 00
			05 01 00 00 32 00 02 10 00
			39 01 00 00 00 00 04 b9 83 10 29
			39 01 00 00 00 00 02 B1 09
		];
		qcom,mdss-dsi-on-command-state = "dsi_lp_mode";
		qcom,mdss-dsi-off-command-state = "dsi_lp_mode";
		zte,mdss-dsi-cabc-default-value = <0x02>;
		zte,mdss-dsi-cabc-off-command = [39 01 00 00 00 00 02 55 00
		];
		zte,mdss-dsi-cabc-low-command = [39 01 00 00 00 00 02 55 01
		];
		zte,mdss-dsi-cabc-medium-command = [39 01 00 00 00 00 02 55 02
		];
		zte,mdss-dsi-cabc-high-command = [39 01 00 00 00 00 02 55 03
		];
		zte,mdss-dsi-cabc-command-state = "dsi_lp_mode";
		qcom,mdss-dsi-lp11-init;
		qcom,mdss-dsi-h-sync-pulse = <0>;
		qcom,mdss-dsi-traffic-mode = "burst_mode";
		qcom,mdss-dsi-bllp-eof-power-mode;
		qcom,mdss-dsi-bllp-power-mode;
		qcom,mdss-dsi-lane-0-state;
		qcom,mdss-dsi-lane-1-state;
		qcom,mdss-dsi-lane-2-state;
		qcom,mdss-dsi-lane-3-state;
		qcom,mdss-dsi-panel-timings = [7F 1C 12 00 40 44 16 1E 17 03 04 00];
		qcom,mdss-dsi-t-clk-post = <0x04>;
		qcom,mdss-dsi-t-clk-pre = <0x1b>;
		qcom,mdss-dsi-bl-min-level = <48>;
		qcom,mdss-dsi-bl-max-level = <4095>;
		qcom,mdss-dsi-dma-trigger = "trigger_sw";
		qcom,mdss-dsi-mdp-trigger = "none";
		qcom,mdss-dsi-bl-pmic-control-type = "bl_ctrl_dcs";
		qcom,mdss-dsi-reset-sequence = <1 10>, <0 5>, <1 50>;
		qcom,mdss-pan-physical-width-dimension = <64>;
		qcom,mdss-pan-physical-height-dimension = <128>;
		qcom,mdss-dsi-tx-eot-append;
		qcom,mdss-dsi-post-init-delay = <1>;
		zte,lcm_reset_pin_keep_high_sleeping;
		zte,lcm_backlight_curve_mode = "lcd_brightness_max_350_lux";

		qcom,esd-check-enabled;
		qcom,mdss-dsi-panel-status-command=[14 01 00 01 05 00 01 0a
			06 01 00 01 05 00 01 09];
		qcom,mdss-dsi-panel-status-command-state="dsi_lp_mode";
		qcom,mdss-dsi-panel-status-check-mode="reg_read";
		qcom,mdss-dsi-panel-status-value=<0x9d 0x80 0x73 0x06>;
		qcom,mdss-dsi-panel-status-read-length = <1 4>;
		qcom,mdss-dsi-panel-status-valid-params = <1 3>;
	};
};
