/* Copyright (c) 2013, The Linux Foundation. All rights reserved.
 *
 * This program is free software; you can redistribute it and/or modify
 * it under the terms of the GNU General Public License version 2 and
 * only version 2 as published by the Free Software Foundation.
 *
 * This program is distributed in the hope that it will be useful,
 * but WITHOUT ANY WARRANTY; without even the implied warranty of
 * MERCHANTABILITY or FITNESS FOR A PARTICULAR PURPOSE.  See the
 * GNU General Public License for more details.
 */

/*---------------------------------------------------------------------------
 * This file is autogenerated file using gcdb parser. Please do not edit it.
 * Update input XML file to add a new entry or update variable in this file
 * VERSION = "1.0"
 *---------------------------------------------------------------------------*/
&mdss_mdp {
	dsi_truly_st7703_720p_video: qcom,mdss_dsi_truly_st7703_720p_video {
		qcom,mdss-dsi-panel-name = "truly st7703 truly 720p video mode dsi panel";
		qcom,cont-splash-enabled;
		zte,lcd-init-code-version = "20180828";
		zte,set-reset-pin-ctrl;
		zte,lcm_reset_pin_keep_low_high_sleeping;
		qcom,panel-supply-entries = <&dsi_panel_pwr_supply>;
		qcom,mdss-dsi-panel-controller = <&mdss_dsi0>;
		qcom,mdss-dsi-panel-type = "dsi_video_mode";
		qcom,mdss-dsi-panel-destination = "display_1";
		qcom,mdss-dsi-panel-framerate = <60>;
		/*qcom,mdss-dsi-panel-clockrate = <866400000>;*/
		qcom,mdss-dsi-virtual-channel-id = <0>;
		qcom,mdss-dsi-stream = <0>;
		qcom,mdss-dsi-panel-width = <720>;
		qcom,mdss-dsi-panel-height = <1440>;
		qcom,mdss-dsi-h-front-porch = <92>;
		qcom,mdss-dsi-h-back-porch = <80>;
		qcom,mdss-dsi-h-pulse-width = <8>;
		qcom,mdss-dsi-h-sync-skew = <0>;
		qcom,mdss-dsi-v-back-porch = <20>;
		qcom,mdss-dsi-v-front-porch = <20>;
		qcom,mdss-dsi-v-pulse-width = <8>;
		qcom,mdss-dsi-h-left-border = <0>;
		qcom,mdss-dsi-h-right-border = <0>;
		qcom,mdss-dsi-v-top-border = <0>;
		qcom,mdss-dsi-v-bottom-border = <0>;
		qcom,mdss-dsi-bpp = <24>;
		qcom,mdss-dsi-color-order = "rgb_swap_rgb";
		qcom,mdss-dsi-underflow-color = <0xff>;
		qcom,mdss-dsi-border-color = <0>;
		qcom,mdss-dsi-on-command = [
			29 01 00 00 00 00 04 B9 F1 12 83
			29 01 00 00 00 00 1C BA 33 81 05 F9 0E 0E 20 00 00
								00 00 00 00 00 44 25 00 91 0A
								00 00 02 4F 01 00 00 37
			29 01 00 00 00 00 05 B8 75 22 20 03
			29 01 00 00 00 00 0B B3 0C 10 05 05 03 FF 00 00 00 00
			29 01 00 00 00 00 0A C0 73 73 50 50 00 00 08 70 00
			29 01 00 00 00 00 02 BC 4F
			29 01 00 00 00 00 02 CC 0B
			29 01 00 00 00 00 02 B4 80
			29 01 00 00 00 00 04 B2 F0 12 F0
			29 01 00 00 00 00 0F E3 07 07 0B 0B 03 0B 00 00 00
								00 FF 00 C0 10
			29 01 00 00 00 00 0D C1 53 00 1E 1E 77 F1 FF FF CC
								CC 77 77
			29 01 00 00 00 00 03 B5 0D 0D
			29 01 00 00 00 00 03 B6 53 53 //VCOM
			29 01 00 00 00 00 03 C6 02 40
			29 01 00 00 00 00 04 BF 02 11 00
			29 01 00 00 00 00 40 E9 C2 10 04 05 A0 05 A0 12 31
								23 1F 80 05 A0 17 04 0C 00 30
								00 00 00 0C 00 30 00 00 00 02
								46 42 88 88 88 88 88 88 06 88
								13 57 53 88 88 88 88 88 88 17
								88 00 00 00 00 00 00 00 00 00
								00 00 00 00
			29 01 00 00 00 00 3E EA 00 1A 00 00 00 00 02 00 00
								00 00 00 75 31 35 88 88 88 88
								88 88 71 88 64 20 24 88 88 88
								88 88 88 60 88 23 20 00 00 04
								00 00 00 00 00 00 00 00 00 00
								00 00 00 00 00 00 05 A0 00 00
								00 00
			29 01 00 00 00 00 23 E0 00 21 26 32 3F 3F 54 43 09
								0D 0E 12 14 13 14 11 19 00 21
								26 32 3F 3F 54 43 09 0D 0E 12
								14 13 14 11 19
			29 01 00 00 00 00 02 C7 B0 //TE
			29 01 00 00 00 00 03 C8 00 04 //PWM 26KHz
			29 01 00 00 00 00 02 51 00
			29 01 00 00 00 00 02 53 24
			29 01 00 00 00 00 02 55 01

			05 01 00 00 78 00 02 11 00
			05 01 00 00 32 00 02 29 00];
		qcom,mdss-dsi-off-command = [39 01 00 00 00 00 02 53 00
					05 01 00 00 32 00 02 28 00
					05 01 00 00 78 00 02 10 00];
		qcom,mdss-dsi-on-command-state = "dsi_lp_mode";
		qcom,mdss-dsi-off-command-state = "dsi_hs_mode";
		qcom,mdss-dsi-lp11-init;
		qcom,mdss-dsi-h-sync-pulse = <1>;
		qcom,mdss-dsi-traffic-mode = "burst_mode";
		qcom,mdss-dsi-lane-map = "lane_map_0123";
		qcom,mdss-dsi-bllp-eof-power-mode;
		qcom,mdss-dsi-bllp-power-mode;
		qcom,mdss-dsi-lane-0-state;
		qcom,mdss-dsi-lane-1-state;
		qcom,mdss-dsi-lane-2-state;
		qcom,mdss-dsi-lane-3-state;
		qcom,mdss-dsi-panel-timings = [86 1E 14 00 42 46 18 20 16 03 04 00];
		qcom,mdss-dsi-t-clk-post = <0x04>;
		qcom,mdss-dsi-t-clk-pre = <0x1B>;
		qcom,mdss-dsi-bl-min-level = <5>;
		qcom,mdss-dsi-bl-max-level = <255>;
		qcom,mdss-dsi-dma-trigger = "trigger_sw";
		qcom,mdss-dsi-mdp-trigger = "none";
		qcom,mdss-dsi-bl-pmic-control-type = "bl_ctrl_dcs";
		qcom,mdss-dsi-reset-sequence = <1 20>, <0 2>, <1 20>;
		qcom,mdss-pan-physical-width-dimension = <62>;
		qcom,mdss-pan-physical-height-dimension = <124>;
		zte,lcm_backlight_curve_mode = "lcd_brightness_max_350_lux";
		qcom,mdss-dsi-tx-eot-append;

		/*qcom,esd-check-enabled;*/
		qcom,mdss-dsi-panel-status-command=[14 01 00 01 05 00 01 09
											14 01 00 01 05 00 01 0A
											14 01 00 01 05 00 01 68];
		qcom,mdss-dsi-panel-status-command-state="dsi_lp_mode";
		qcom,mdss-dsi-panel-status-check-mode="reg_read";
		qcom,mdss-dsi-panel-status-value=<0x80 0x9C 0xC0>;
		qcom,mdss-dsi-panel-status-read-length = <1 1 1>;
	};
};
