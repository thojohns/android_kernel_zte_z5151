/* Copyright (c) 2015, The Linux Foundation. All rights reserved.
*
* This program is free software; you can redistribute it and/or modify
* it under the terms of the GNU General Public License version 2 and
* only version 2 as published by the Free Software Foundation.
*
* This program is distributed in the hope that it will be useful,
* but WITHOUT ANY WARRANTY; without even the implied warranty of
* MERCHANTABILITY or FITNESS FOR A PARTICULAR PURPOSE.  See the
* GNU General Public License for more details.
*/

&mdss_mdp {
	dsi_tianma_ft8719_1080p_video: qcom,mdss_dsi_tianma_ft8719_1080p_video {
		qcom,mdss-dsi-panel-name = "ft8719 tianma 1080p video 6p2 dsi panel";
		qcom,cont-splash-enabled;
		zte,lcd_bl_vsp_vsn_voltage = <0xf>;
		qcom,mdss-dsi-panel-controller = <&mdss_dsi0>;
		qcom,mdss-dsi-panel-type = "dsi_video_mode";
		qcom,mdss-dsi-panel-framerate = <60>;
		qcom,mdss-dsi-virtual-channel-id = <0>;
		qcom,mdss-dsi-stream = <0>;
		qcom,mdss-dsi-panel-width = <1080>;
		qcom,mdss-dsi-panel-height = <2246>;
		qcom,mdss-dsi-h-front-porch = <16>;
		qcom,mdss-dsi-h-back-porch = <16>;
		qcom,mdss-dsi-h-pulse-width = <4>;
		qcom,mdss-dsi-h-sync-skew = <0>;
		qcom,mdss-dsi-v-back-porch = <12>;
		qcom,mdss-dsi-v-front-porch = <130>;
		qcom,mdss-dsi-v-pulse-width = <4>;
		qcom,mdss-dsi-h-left-border = <0>;
		qcom,mdss-dsi-h-right-border = <0>;
		qcom,mdss-dsi-v-top-border = <0>;
		qcom,mdss-dsi-v-bottom-border = <0>;
		qcom,mdss-dsi-bpp = <24>;
		qcom,mdss-dsi-color-order = "rgb_swap_rgb";
		qcom,mdss-dsi-underflow-color = <0xff>;
		qcom,mdss-dsi-border-color = <0>;
		qcom,mdss-dsi-on-command = [
29 01 00 00 00 00 02 00 00
29 01 00 00 00 00 04 FF 87 19 01
29 01 00 00 00 00 02 00 80
29 01 00 00 00 00 03 FF 87 19
29 01 00 00 00 00 02 00 82
29 01 00 00 00 00 08 C5 5A 5A 28 28 00 60 0C
29 01 00 00 00 00 02 00 80
29 01 00 00 00 00 03 FF 00 00
29 01 00 00 00 00 02 00 00
29 01 00 00 00 00 04 FF 00 00 00

05 01 00 00 78 00 02 11 00
29 01 00 00 00 00 02 51 00
29 01 00 00 00 00 02 53 2C
29 01 00 00 00 00 02 55 00
05 01 00 00 14 00 02 29 00
];
		qcom,mdss-dsi-off-command = [
			05 01 00 00 14 00 02 28 00
			05 01 00 00 78 00 02 10 00
		];
		qcom,mdss-dsi-on-command-state = "dsi_lp_mode";
		qcom,mdss-dsi-off-command-state = "dsi_lp_mode";
		qcom,mdss-dsi-lp11-init;
		qcom,mdss-dsi-h-sync-pulse = <0>;
		qcom,mdss-dsi-traffic-mode = "burst_mode";
		qcom,mdss-dsi-bllp-eof-power-mode;
		qcom,mdss-dsi-bllp-power-mode;
		qcom,mdss-dsi-lane-0-state;
		qcom,mdss-dsi-lane-1-state;
		qcom,mdss-dsi-lane-2-state;
		qcom,mdss-dsi-lane-3-state;
		qcom,mdss-dsi-panel-timings = [D2 32 20 00 5E 62 26 34 26 03 04 00];
		qcom,mdss-dsi-t-clk-post = <0x0E>;
		qcom,mdss-dsi-t-clk-pre = <0x33>;
		qcom,mdss-dsi-bl-min-level = <3>;
		qcom,mdss-dsi-bl-max-level = <255>;
		qcom,mdss-dsi-dma-trigger = "trigger_sw";
		qcom,mdss-dsi-mdp-trigger = "none";
		qcom,mdss-dsi-bl-pmic-control-type = "bl_ctrl_dcs";
		qcom,mdss-dsi-reset-sequence = <1 10>, <0 10>, <1 10>;
		qcom,mdss-pan-physical-width-dimension = <68>;
		qcom,mdss-pan-physical-height-dimension = <141>;
		qcom,mdss-dsi-tx-eot-append;
		qcom,mdss-dsi-post-init-delay = <1>;
	};
};
