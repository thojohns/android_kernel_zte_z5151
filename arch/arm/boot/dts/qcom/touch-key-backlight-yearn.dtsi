//for touchscreen and key and keypad-backlight

&soc {
	i2c@78b7000 {
		focaltech@38{
		compatible = "focaltech,fts_ts";
		reg = <0x38>;
		interrupt-parent = <&tlmm>;
		interrupts = <65 0x2>;
		vdd-supply = <&pm8953_l17>;
		vcc_i2c-supply = <&pm8953_l6>;
		pinctrl-names = "pmx_ts_active", "pmx_ts_suspend";
		pinctrl-0 = <&ts_int_active>;
		pinctrl-1 = <&ts_int_suspend>;
		focaltech,reset-gpio = <&tlmm 64 0x0>;
		focaltech,irq-gpio = <&tlmm 65 0x2002>;
		focaltech,display-coords = <0 0 1080 2246>;
		focaltech,max-touch-number = <5>;
		};
	};

	gen-vkeys {
		compatible = "zte,gen-vkeys";
		label = "synaptics_dsx";
		zte,disp-maxy_px = <1920>;
		zte,disp-maxy_mm = <1335>;//0.1mm
		zte,disp-maxx_mm = <740>;//0.1mm
		zte,x1=<160>;
		zte,x2=<375>;
		zte,x3=<580>;
		zte,lcd_offset=<25>;//距离LCD至少2mm 这里再放宽0.5mm
		zte,y_max_offset=<150>;
		zte,dx=<100>;//标准中X范围为5mm+-1mm取中值*2
		zte,key-codes = <158 102 187>;
	};


	/*gpio-leds {
		compatible = "gpio-leds";
		status = "okay";
		pinctrl-names = "default";
		pinctrl-0 = <&button_backlight_off>;

		keypad-backlight {
			gpios = <&tlmm 97 0>;
			label = "button-backlight";
			linux,default-trigger = "none";
		};
	};*/
};
