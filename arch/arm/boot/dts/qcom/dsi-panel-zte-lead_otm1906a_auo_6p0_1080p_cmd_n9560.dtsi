/* Copyright (c) 2015, The Linux Foundation. All rights reserved.
 *
 * This program is free software; you can redistribute it and/or modify
 * it under the terms of the GNU General Public License version 2 and
 * only version 2 as published by the Free Software Foundation.
 *
 * This program is distributed in the hope that it will be useful,
 * but WITHOUT ANY WARRANTY; without even the implied warranty of
 * MERCHANTABILITY or FITNESS FOR A PARTICULAR PURPOSE.  See the
 * GNU General Public License for more details.
 */

&mdss_mdp {
	dsi_lead_otm1906a_auo_6p0_1080P_video_vid: qcom,mdss_dsi_lead_otm1906a_auo_6p0_1080p_video {
		qcom,mdss-dsi-panel-name = "zteLEAD_OTM1906A_AUO_1080_1920_6P0Inch";
		qcom,mdss-dsi-panel-type = "dsi_video_mode";
		qcom,cont-splash-enabled;
		qcom,mdss-dsi-panel-status-read-length = <1>;
		qcom,mdss-pan-physical-width-dimension = <75>;
		qcom,mdss-pan-physical-height-dimension = <132>;
		qcom,mdss-dsi-panel-framerate = <60>;
		qcom,mdss-dsi-virtual-channel-id = <0>;
		qcom,mdss-dsi-stream = <0>;
		qcom,mdss-dsi-panel-width = <1080>;
		qcom,mdss-dsi-panel-height = <1920>;/*mipi=830.01MHz*/
		qcom,mdss-dsi-h-front-porch = <60>;
		qcom,mdss-dsi-h-back-porch = <42>;
		qcom,mdss-dsi-h-pulse-width = <4>;
		qcom,mdss-dsi-h-sync-skew = <0>;
		qcom,mdss-dsi-v-back-porch = <6>;
		qcom,mdss-dsi-v-front-porch = <16>;
		qcom,mdss-dsi-v-pulse-width = <2>;
		qcom,mdss-dsi-h-left-border = <0>;
		qcom,mdss-dsi-h-right-border = <0>;
		qcom,mdss-dsi-v-top-border = <0>;
		qcom,mdss-dsi-v-bottom-border = <0>;
		qcom,mdss-dsi-bpp = <24>;
		qcom,mdss-dsi-underflow-color = <0xff>;
		qcom,mdss-dsi-border-color = <0>;
		qcom,mdss-dsi-h-sync-pulse = <0>;
		qcom,mdss-dsi-traffic-mode = "burst_mode";

		qcom,mdss-dsi-te-pin-select = <1>;
		qcom,mdss-dsi-te-dcs-command = <1>;
		qcom,mdss-dsi-te-check-enable;
		qcom,mdss-dsi-te-using-te-pin;
		qcom,mdss-dsi-wr-mem-start = <0x2c>;
		qcom,mdss-dsi-wr-mem-continue = <0x3c>;

		qcom,mdss-dsi-lp11-init;
		//qcom,mdss-dsi-init-delay-us = <5000>;

		qcom,esd-check-enabled;
		qcom,mdss-dsi-panel-status-command=[06 01 00 01 05 00 01 0e] ;
		qcom,mdss-dsi-panel-status-command-state="dsi_lp_mode";
		qcom,mdss-dsi-panel-status-check-mode="reg_read";
		qcom,mdss-dsi-panel-status-value=<0x80>;

		qcom,mdss-dsi-bllp-eof-power-mode;
		qcom,mdss-dsi-bllp-power-mode;
		qcom,mdss-dsi-lane-0-state;
		qcom,mdss-dsi-lane-1-state;
		qcom,mdss-dsi-lane-2-state;
		qcom,mdss-dsi-lane-3-state;
		qcom,mdss-dsi-panel-timings = [DB 34 22 00 62 66 28 36 2B 03 04 00];
		//qcom,mdss-dsi-panel-timings-phy-v2 = [
		//23 1e 07 08 05 03 04 a0
		//23 1e 07 08 05 03 04 a0
		//23 1e 07 08 05 03 04 a0
		//23 1e 07 08 05 03 04 a0
		//23 19 07 08 05 03 04 a0];
		qcom,mdss-dsi-t-clk-post = <0x03>;
		qcom,mdss-dsi-t-clk-pre = <0x29>;
		qcom,mdss-dsi-bl-min-level = <1>;
		qcom,mdss-dsi-bl-max-level = <255>;
		qcom,mdss-dsi-dma-trigger = "trigger_sw";
		qcom,mdss-dsi-mdp-trigger = "none";
		qcom,mdss-dsi-on-command = [

	39 01 00 00 00 00 02 00 00 //enable cmd2
	39 01 00 00 00 00 04 FF 19 06 01
	39 01 00 00 00 00 02 00 80
	39 01 00 00 00 00 03 FF 19 06

	39 01 00 00 00 00 02 00 80
	39 01 00 00 00 00 08 a4 00 00 00 02 00 82 00

	39 01 00 00 00 00 02 00 82
	39 01 00 00 00 00 02 a4 01

	39 01 00 00 00 00 02 00 80
	39 01 00 00 00 00 05 a5 0f 00 01 08

	39 01 00 00 00 00 02 00 80
	39 01 00 00 00 00 0f c0 00 80 00 04 06 00 80 04 06 00 80 00 04 06

	39 01 00 00 00 00 02 00 a0 //ckh set
	39 01 00 00 00 00 08 c0 00 05 00 05 02 1b 04

	39 01 00 00 00 00 02 00 d0 //ckh set video mode
	39 01 00 00 00 00 08 c0 00 05 00 05 02 1b 04

	39 01 00 00 00 00 02 00 80
	39 01 00 00 00 00 03 c1 11 11

	39 01 00 00 00 00 02 00 80 //vst set
	39 01 00 00 00 00 0d c2 84 01 40 40 82 01 17 18 00 00 00 00

	39 01 00 00 00 00 02 00 90 //vend set
	39 01 00 00 00 00 0d c2 00 00 00 00 02 01 08 0f 02 01 08 0f

	39 01 00 00 00 00 02 00 b0 //ckv set
	39 01 00 00 00 00 10 c2 84 01 00 08 00 82 03 00 08 00 83 02 00 08 00

	39 01 00 00 00 00 02 00 c0 //ckv set
	39 01 00 00 00 00 10 c2 81 04 00 08 00 00 00 00 00 00 00 00 00 00 00

	39 01 00 00 00 00 02 00 d0
	39 01 00 00 00 00 10 c2 82 00 01 02 81 84 02 03 00 01 33 33 00 37 00

	39 01 00 00 00 00 02 00 a0 //vst set
	39 01 00 00 00 00 0d c3 84 01 40 40 82 01 17 18 00 00 00 00

	39 01 00 00 00 00 02 00 b0 //ckv set
	39 01 00 00 00 00 0f c3 00 00 00 00 84 01 00 08 00 82 03 00 08 00

	39 01 00 00 00 00 02 00 c0 //ckv set
	39 01 00 00 00 00 10 c3 83 02 00 08 00 81 04 00 08 00 00 00 00 00 00

	39 01 00 00 00 00 02 00 e0 //ckv period video
	39 01 00 00 00 00 05 c3 33 33 00 37

	39 01 00 00 00 00 02 00 80
	39 01 00 00 00 00 0c CB 00 00 00 00 30 00 00 00 00 00 00

	39 01 00 00 00 00 02 00 90
	39 01 00 00 00 00 10 CB 00 00 00 C0 00 00 00 00 00 00 00 00 00 00 00

	39 01 00 00 00 00 02 00 A0
	39 01 00 00 00 00 10 CB 00 00 00 BF 00 00 00 00 00 FF 00 00 00 00 00

	39 01 00 00 00 00 02 00 B0
	39 01 00 00 00 00 0d CB 00 00 00 00 00 00 00 00 77 77 00 00

	39 01 00 00 00 00 02 00 C0
	39 01 00 00 00 00 10 CB 15 11 15 15 15 15 15 15 01 01 01 01 01 01 01

	39 01 00 00 00 00 02 00 D0
	39 01 00 00 00 00 10 CB 01 3D 01 FF 01 01 00 00 00 00 00 01 11 01 11

	39 01 00 00 00 00 02 00 E0
	39 01 00 00 00 00 0d CB 01 11 00 01 00 01 00 01 77 77 00 00

	39 01 00 00 00 00 02 00 F0
	39 01 00 00 00 00 0c CB F3 FF 55 55 7F C0 03 33 03 00 02

	39 01 00 00 00 00 02 00 80
	39 01 00 00 00 00 0d CC 08 09 18 19 0c 0d 0e 0f 07 07 07 07

	39 01 00 00 00 00 02 00 90
	39 01 00 00 00 00 0d CC 18 09 08 19 0f 0e 0d 0c 07 07 07 07

	39 01 00 00 00 00 02 00 A0
	39 01 00 00 00 00 10 CC 14 15 16 17 1C 1D 1E 1F 20 07 07 07 07 07 00

	39 01 00 00 00 00 02 00 B0
	39 01 00 00 00 00 09 CC 01 02 03 04 05 06 07 07

	39 01 00 00 00 00 02 00 C0
	39 01 00 00 00 00 10 CC 00 00 00 00 00 00 00 00 00 00 00 00 45 45 00

	39 01 00 00 00 00 02 00 D0
	39 01 00 00 00 00 10 CC 00 00 00 00 00 00 00 00 00 00 00 33 33 33 33

	39 01 00 00 00 00 02 00 E0
	39 01 00 00 00 00 0d CC 33 33 00 00 00 00 00 00 00 00 00 00

	39 01 00 00 00 00 02 00 80
	39 01 00 00 00 00 10 cd 01 11 12 07 08 04 18 1A 03 09 23 23 23 1D 1E

	39 01 00 00 00 00 02 00 90
	39 01 00 00 00 00 04 cd 1F 23 23

	39 01 00 00 00 00 02 00 a0
	39 01 00 00 00 00 10 cd 01 11 12 05 06 04 18 17 03 09 23 23 23 1D 1E

	39 01 00 00 00 00 02 00 b0
	39 01 00 00 00 00 04 cd 1F 23 23

	//HV Setting
	39 01 00 00 00 00 02 00 91
	39 01 00 00 00 00 03 C5 14 1e
	39 01 00 00 00 00 02 00 a1
	39 01 00 00 00 00 03 C5 14 1e
		//VCOM Setting
	39 01 00 00 00 00 02 00 00
	39 01 00 00 00 00 09 D9 00 B8 00 B8 00 B8 00 B8

	//GVDDP/N
	39 01 00 00 00 00 02 00 00
	39 01 00 00 00 00 03 d8 1a 1a

	39 01 00 00 00 00 02 00 00
	39 01 00 00 00 00 19 E1 00 2c 34 3f 47 4f 5a 6a 74 83 8c 94 67 62 5e 52 43 32 26 20 17 0b 03 03
	39 01 00 00 00 00 02 00 00
	39 01 00 00 00 00 19 E2 00 2c 34 3f 47 4f 5a 6a 74 83 8c 94 67 62 5e 52 43 32 26 20 17 0b 03 03
	39 01 00 00 00 00 02 00 00
	39 01 00 00 00 00 19 E3 00 2c 34 3f 47 4f 5a 6a 74 83 8c 94 67 62 5e 52 43 32 26 20 17 0b 03 03
	39 01 00 00 00 00 02 00 00
	39 01 00 00 00 00 19 E4 00 2c 34 3f 47 4f 5a 6a 74 83 8c 94 67 62 5e 52 43 32 26 20 17 0b 03 03
	39 01 00 00 00 00 02 00 00
	39 01 00 00 00 00 19 E5 00 2c 34 3f 47 4f 5a 6a 74 83 8c 94 67 62 5e 52 43 32 26 20 17 0b 03 03
	39 01 00 00 00 00 02 00 00
	39 01 00 00 00 00 19 E6 00 2c 34 3f 47 4f 5a 6a 74 83 8c 94 67 62 5e 52 43 32 26 20 17 0b 03 03

	//inversion
	39 01 00 00 00 00 02 00 b3
	39 01 00 00 00 00 02 c0 88
	39 01 00 00 00 00 02 00 a0 //G Swap
	39 01 00 00 00 00 08 b3 33 04 38 07 80 00 20

	39 01 00 00 00 00 02 00 e1
	39 01 00 00 00 00 02 F5 16

	39 01 00 00 00 00 02 00 81
	39 01 00 00 00 00 02 F5 16

	39 01 00 00 00 00 02 00 83
	39 01 00 00 00 00 02 F5 16

	39 01 00 00 00 00 02 00 80
	39 01 00 00 00 00 02 c4 81

	39 01 00 00 00 00 02 00 81
	39 01 00 00 00 00 02 A5 01

	39 01 00 00 00 00 02 00 A0
	39 01 00 00 00 00 04 C1 00 c0 11

	39 01 00 00 00 00 02 00 B0
	39 01 00 00 00 00 02 CA 04   //27KHZ

	39 01 00 00 00 00 02 00 B3
	39 01 00 00 00 00 02 CA 50   //PWM_FREQ_SEL=01

	39 01 00 00 00 00 02 00 00
	39 01 00 00 00 00 02 1C 33

	39 01 00 00 00 00 02 00 00 //disable cmd2
	39 01 00 00 00 00 04 FF 00 00 00

	39 01 00 00 00 00 02 35 00 //add for esd check, according to wangjingyi.

	//39 01 00 00 00 00 02 51 ff
	39 01 00 00 00 00 02 53 2C
	05 01 00 00 78 00 02 11 00
	05 01 00 00 0a 00 02 29 00
			];
		qcom,mdss-dsi-off-command = [05 01 00 00 96 00 02 28 00
				05 01 00 00 96 00 02 10 00
				39 01 00 00 00 00 02 4f 01];
		qcom,mdss-dsi-on-command-state = "dsi_lp_mode";
		qcom,mdss-dsi-off-command-state = "dsi_hs_mode";
		qcom,mdss-dsi-bl-pmic-control-type ="bl_ctrl_dcs";
		qcom,mdss-dsi-reset-sequence = <1 10>, <0 10>, <1 10>;
		//qcom,mdss-dsi-tx-eot-append;
	};
};
