 /* Copyright (c) 2015, The Linux Foundation. All rights reserved.
 *
 * This program is free software; you can redistribute it and/or modify
 * it under the terms of the GNU General Public License version 2 and
 * only version 2 as published by the Free Software Foundation.
 *
 * This program is distributed in the hope that it will be useful,
 * but WITHOUT ANY WARRANTY; without even the implied warranty of
 * MERCHANTABILITY or FITNESS FOR A PARTICULAR PURPOSE.  See the
 * GNU General Public License for more details.
 */
&mdss_mdp {
	dsi_tianma_nt36525_tm_720p_video: qcom,mdss_dsi_tianma_nt36525_tm_720p_video {
		qcom,mdss-dsi-panel-name = "nt36525 Tianma 720p video 5p7inch dsi panel";
		qcom,cont-splash-enabled;
		zte,lcd_bl_vsp_vsn_voltage = <0xf>;
		qcom,mdss-dsi-panel-controller = <&mdss_dsi0>;
		qcom,mdss-dsi-panel-type = "dsi_video_mode";
		qcom,mdss-dsi-panel-framerate = <60>;
		qcom,mdss-dsi-virtual-channel-id = <0>;
		qcom,mdss-dsi-stream = <0>;
		qcom,mdss-dsi-panel-width = <720>;
		qcom,mdss-dsi-panel-height = <1440>;
		qcom,mdss-dsi-h-front-porch = <110>;
		qcom,mdss-dsi-h-back-porch = <174>;
		qcom,mdss-dsi-h-pulse-width = <2>;
		qcom,mdss-dsi-h-sync-skew = <0>;
		qcom,mdss-dsi-v-back-porch = <8>;
		qcom,mdss-dsi-v-front-porch = <10>;
		qcom,mdss-dsi-v-pulse-width = <2>;
		qcom,mdss-dsi-h-left-border = <0>;
		qcom,mdss-dsi-h-right-border = <0>;
		qcom,mdss-dsi-v-top-border = <0>;
		qcom,mdss-dsi-v-bottom-border = <0>;
		qcom,mdss-dsi-bpp = <24>;
		qcom,mdss-dsi-color-order = "rgb_swap_rgb";
		qcom,mdss-dsi-underflow-color = <0xff>;
		qcom,mdss-dsi-border-color = <0>;
		qcom,mdss-dsi-on-command = [
			39 01 00 00 00 00 02 FF 26
			39 01 00 00 00 00 02 FB 01
			39 01 00 00 00 00 02 19 15

			39 01 00 00 00 00 02 FF E0
			39 01 00 00 00 00 02 FB 01
			39 01 00 00 00 00 02 9E 00

			39 01 00 00 00 00 02 FF 10
			39 01 00 00 00 00 02 FB 01
			39 01 00 00 00 00 02 BA 03

			39 01 00 00 00 00 02 35 00
			39 01 00 00 00 00 02 51 00
			39 01 00 00 00 00 02 53 24
			39 01 00 00 00 00 02 55 02

			39 01 00 00 78 00 02 11 00
			39 01 00 00 14 00 02 29 00
		];
		qcom,mdss-dsi-off-command = [
			05 01 00 00 32 00 02 28 00
			05 01 00 00 A0 00 02 10 00
			39 01 00 00 00 00 02 4F 01
		];
		qcom,mdss-dsi-on-command-state = "dsi_lp_mode";
		qcom,mdss-dsi-off-command-state = "dsi_lp_mode";
		zte,mdss-dsi-cabc-default-value = <0x02>;
		zte,mdss-dsi-cabc-off-command = [39 01 00 00 00 00 02 55 00
		];
		zte,mdss-dsi-cabc-low-command = [39 01 00 00 00 00 02 55 01
		];
		zte,mdss-dsi-cabc-medium-command = [39 01 00 00 00 00 02 55 02
		];
		zte,mdss-dsi-cabc-high-command = [39 01 00 00 00 00 02 55 03
		];
		zte,mdss-dsi-cabc-command-state = "dsi_lp_mode";
		qcom,mdss-dsi-lp11-init;
		qcom,mdss-dsi-init-delay-us=<10000>;
		qcom,mdss-dsi-h-sync-pulse = <0>;
		qcom,mdss-dsi-traffic-mode = "burst_mode";
		qcom,mdss-dsi-bllp-eof-power-mode;
		qcom,mdss-dsi-bllp-power-mode;
		qcom,mdss-dsi-lane-0-state;
		qcom,mdss-dsi-lane-1-state;
		qcom,mdss-dsi-lane-2-state;
		qcom,mdss-dsi-lane-3-state;
		qcom,mdss-dsi-panel-timings = [97 20 16 00 48 4A 1C 26 1B 03 04 00];
		qcom,mdss-dsi-t-clk-post = <0x04>;
		qcom,mdss-dsi-t-clk-pre = <0x1E>;
		qcom,mdss-dsi-bl-min-level = <3>;
		qcom,mdss-dsi-bl-max-level = <255>;
		qcom,mdss-dsi-dma-trigger = "trigger_sw";
		qcom,mdss-dsi-mdp-trigger = "none";
		qcom,mdss-dsi-bl-pmic-control-type = "bl_ctrl_dcs";
		qcom,mdss-dsi-reset-sequence = <1 10>, <0 20>, <1 60>;
		qcom,mdss-pan-physical-width-dimension = <64>;
		qcom,mdss-pan-physical-height-dimension = <128>;
		qcom,mdss-dsi-tx-eot-append;
		qcom,mdss-dsi-post-init-delay = <1>;
		zte,lcm_reset_pin_keep_high_sleeping;
		zte,lcm_backlight_curve_mode = "lcd_brightness_max_350_lux";

		qcom,esd-check-enabled;
		qcom,mdss-dsi-panel-status-command=[06 01 00 01 05 00 01 0A] ;
		qcom,mdss-dsi-panel-status-command-state="dsi_lp_mode";
		qcom,mdss-dsi-panel-status-check-mode="reg_read";
		qcom,mdss-dsi-panel-status-value=<0x9C>;
		qcom,mdss-dsi-panel-status-read-length = <1>;
	};
};
