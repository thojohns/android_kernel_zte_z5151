 /* Copyright (c) 2015, The Linux Foundation. All rights reserved.
 *
 * This program is free software; you can redistribute it and/or modify
 * it under the terms of the GNU General Public License version 2 and
 * only version 2 as published by the Free Software Foundation.
 *
 * This program is distributed in the hope that it will be useful,
 * but WITHOUT ANY WARRANTY; without even the implied warranty of
 * MERCHANTABILITY or FITNESS FOR A PARTICULAR PURPOSE.  See the
 * GNU General Public License for more details.
 */
&mdss_mdp {
	dsi_tianma_nt36525_tm_720p_video: qcom,mdss_dsi_tianma_nt36525_tm_720p_video{
		qcom,mdss-dsi-panel-name = "tianma nt36525 tm 5p7inch 720p video dsi panel";
		qcom,cont-splash-enabled;
		zte,lcd_bl_vsp_vsn_voltage = <0xf>;
		qcom,mdss-dsi-panel-controller = <&mdss_dsi0>;
		qcom,mdss-dsi-panel-type = "dsi_video_mode";
		qcom,mdss-dsi-panel-framerate = <60>;
		qcom,mdss-dsi-virtual-channel-id = <0>;
		qcom,mdss-dsi-stream = <0>;
		qcom,mdss-dsi-panel-width = <720>;
		qcom,mdss-dsi-panel-height = <1440>;
		qcom,mdss-dsi-h-front-porch = <328>;
		qcom,mdss-dsi-h-back-porch = <28>;
		qcom,mdss-dsi-h-pulse-width = <4>;
		qcom,mdss-dsi-h-sync-skew = <0>;
		qcom,mdss-dsi-v-back-porch = <8>;
		qcom,mdss-dsi-v-front-porch = <10>;
		qcom,mdss-dsi-v-pulse-width = <2>;
		qcom,mdss-dsi-h-left-border = <0>;
		qcom,mdss-dsi-h-right-border = <0>;
		qcom,mdss-dsi-v-top-border = <0>;
		qcom,mdss-dsi-v-bottom-border = <0>;
		qcom,mdss-dsi-bpp = <24>;
		qcom,mdss-dsi-color-order = "rgb_swap_rgb";
		qcom,mdss-dsi-underflow-color = <0xff>;
		qcom,mdss-dsi-border-color = <0>;
		qcom,mdss-dsi-on-command = [
			39 01 00 00 00 00 02 51 00
			39 01 00 00 00 00 02 53 24
			39 01 00 00 00 00 02 55 00

			39 01 00 00 00 00 02 29 00
			39 01 00 00 64 00 02 11 00
		];
		qcom,mdss-dsi-off-command = [
			05 01 00 00 32 00 02 28 00
			05 01 00 00 A0 00 02 10 00
		];
		qcom,mdss-dsi-on-command-state = "dsi_lp_mode";
		qcom,mdss-dsi-off-command-state = "dsi_lp_mode";
		te,mdss-dsi-cabc-off-command = [39 01 00 00 00 00 02 55 00];
		zte,mdss-dsi-cabc-low-command = [39 01 00 00 00 00 02 55 01];
		zte,mdss-dsi-cabc-medium-command = [39 01 00 00 00 00 02 55 02];
		zte,mdss-dsi-cabc-high-command = [39 01 00 00 00 00 02 55 03];
		zte,mdss-dsi-cabc-command-state = "dsi_lp_mode";
		qcom,mdss-dsi-lp11-init;
		qcom,mdss-dsi-h-sync-pulse = <0>;
		qcom,mdss-dsi-traffic-mode = "burst_mode";
		qcom,mdss-dsi-bllp-eof-power-mode;
		qcom,mdss-dsi-bllp-power-mode;
		qcom,mdss-dsi-hfp-power-mode;	//
		//qcom,dsi-pll-ssc-en;	//
		qcom,mdss-dsi-lane-0-state;
		qcom,mdss-dsi-lane-1-state;
		qcom,mdss-dsi-lane-2-state;
		qcom,mdss-dsi-lane-3-state;
		qcom,mdss-dsi-panel-timings =[9B 24 18 00 4A 4E 1C 28 1D 03 04 00];
		qcom,mdss-dsi-t-clk-post = <0x0C>;
		qcom,mdss-dsi-t-clk-pre = <0x27>;
		qcom,mdss-dsi-bl-min-level = <3>;
		qcom,mdss-dsi-bl-max-level = <255>;
		qcom,mdss-dsi-dma-trigger = "trigger_sw";
		qcom,mdss-dsi-mdp-trigger = "none";
		qcom,mdss-dsi-bl-pmic-control-type = "bl_ctrl_dcs";
		qcom,mdss-dsi-reset-sequence = <1 15>, <0 5>, <1 20>;
		qcom,mdss-pan-physical-width-dimension = <64>;
		qcom,mdss-pan-physical-height-dimension = <128>;
		qcom,mdss-dsi-tx-eot-append;
		qcom,mdss-dsi-post-init-delay = <1>;
		zte,lcm_backlight_curve_mode = "lcd_brightness_max_350_lux";
	};
};
