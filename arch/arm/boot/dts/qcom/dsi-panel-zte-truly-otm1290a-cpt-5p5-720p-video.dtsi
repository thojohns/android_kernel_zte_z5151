 /* Copyright (c) 2015, The Linux Foundation. All rights reserved.
 *
 * This program is free software; you can redistribute it and/or modify
 * it under the terms of the GNU General Public License version 2 and
 * only version 2 as published by the Free Software Foundation.
 *
 * This program is distributed in the hope that it will be useful,
 * but WITHOUT ANY WARRANTY; without even the implied warranty of
 * MERCHANTABILITY or FITNESS FOR A PARTICULAR PURPOSE.  See the
 * GNU General Public License for more details.
 */
&mdss_mdp {
	dsi_truly_otm1290a_cpt_720p_video: qcom,mdss_dsi_truly_otm1290a_cpt_720p_video {
		qcom,mdss-dsi-panel-name = "otm1290a truly 720p video 5p5inch dsi panel";
		qcom,cont-splash-enabled;
		qcom,panel-supply-entries = <&dsi_panel_pwr_supply>;
		qcom,mdss-dsi-panel-controller = <&mdss_dsi0>;
		qcom,mdss-dsi-panel-type = "dsi_video_mode";
		qcom,mdss-dsi-panel-framerate = <60>;
		qcom,mdss-dsi-virtual-channel-id = <0>;
		qcom,mdss-dsi-stream = <0>;
		qcom,mdss-dsi-panel-width = <720>;
		qcom,mdss-dsi-panel-height = <1440>;
		qcom,mdss-dsi-h-front-porch = <92>;
		qcom,mdss-dsi-h-back-porch = <80>;
		qcom,mdss-dsi-h-pulse-width = <8>;
		qcom,mdss-dsi-h-sync-skew = <0>;
		qcom,mdss-dsi-v-back-porch = <20>;
		qcom,mdss-dsi-v-front-porch = <20>;
		qcom,mdss-dsi-v-pulse-width = <8>;
		qcom,mdss-dsi-h-left-border = <0>;
		qcom,mdss-dsi-h-right-border = <0>;
		qcom,mdss-dsi-v-top-border = <0>;
		qcom,mdss-dsi-v-bottom-border = <0>;
		qcom,mdss-dsi-bpp = <24>;
		qcom,mdss-dsi-color-order = "rgb_swap_rgb";
		qcom,mdss-dsi-underflow-color = <0xff>;
		qcom,mdss-dsi-border-color = <0>;
		qcom,mdss-dsi-on-command = [
			29 01 00 00 00 00 02 00 00
			29 01 00 00 00 00 04 ff 12 90 01   //EXTC = 1

			29 01 00 00 00 00 02 00 80
			29 01 00 00 00 00 03 ff 12 90  //CMD2 enable

			29 01 00 00 00 00 02 00 90
			29 01 00 00 00 00 02 ff b0 //b0 => MIPI 4lane  a0 => MIPI 3lane

			//-------------------- panel setting --------------------//
			29 01 00 00 00 00 02 00 80
			29 01 00 00 00 00 0A c0 00 84 00 10 00 10 01 04 03  //RTN = 84(18:9)

			29 01 00 00 00 00 02 00 90
			29 01 00 00 00 00 02 C1 03 //20170711 MCLK埃繵

			29 01 00 00 00 00 02 00 ac
			29 01 00 00 00 00 02 c1 0c  //20170711 for 18:9

			29 01 00 00 00 00 02 00 c0
			29 01 00 00 00 00 02 c0 88  //for 18:9

			29 01 00 00 00 00 02 00 a6
			29 01 00 00 00 00 07 c0 00 60 00 00 00 02  //20170711 Panel timing setting

			29 01 00 00 00 00 02 00 a1
			29 01 00 00 00 00 02 b3 10  //resolution enable

			29 01 00 00 00 00 02 00 b0
			29 01 00 00 00 00 05 b3 02 d0 05 a0  // 721440(18:9)

			29 01 00 00 00 00 02 00 81
			29 01 00 00 00 00 02 b2 21  //BGR

			29 01 00 00 00 00 02 00 b1
			29 01 00 00 00 00 02 c0 40  //mirror X2

			29 01 00 00 00 00 02 00 85
			29 01 00 00 00 00 02 b0 01  //BTA TLPX 4X

			29 01 00 00 00 00 02 00 95
			29 01 00 00 00 00 02 b0 1b  //speedup

			29 01 00 00 00 00 02 00 97
			29 01 00 00 00 00 02 b0 00  //MIPI weak pull high/low

			29 01 00 00 00 00 02 00 80
			29 01 00 00 00 00 02 a4 af  //source floating bias short + PCH GVDD  +source bias=1uA

			29 01 00 00 00 00 02 00 81  //chop 2line 2frame
			29 01 00 00 00 00 02 a4 02

			29 01 00 00 00 00 02 00 80
			29 01 00 00 00 00 02 a5 b3  //PCH level 1/2 GVDD

			29 01 00 00 00 00 02 00 a2
			29 01 00 00 00 00 02 c0 00  //PWROFF Blank frame

			29 01 00 00 00 00 02 00 84
			29 01 00 00 00 00 06 f5 72 82 79 0b 92  //pump EN VGH/VGL

			29 01 00 00 00 00 02 00 86
			29 01 00 00 00 00 02 a5 f0  //LVD enable

			29 01 00 00 00 00 02 00 87
			29 01 00 00 00 00 02 a5 0D

			29 01 00 00 00 00 02 00 86
			29 01 00 00 00 00 04 C0 15 04 15

			29 01 00 00 00 00 02 00 D0   //TCON auto DIS   20170623
			29 01 00 00 00 00 05 C0 00 00 00 00

			29 01 00 00 00 00 02 00 87
			29 01 00 00 00 00 03 c5 01 44  //gate slew rate

			//-------------------- power setting --------------------//
			29 01 00 00 00 00 02 00 80        //VGH=15V  VGL=-10V  pump ratio:VGH=3x  VGL=-2x
			29 01 00 00 00 00 03 c5 99 53   //D[1]:VGH/VGL pump CLK stop @ sample hold

			29 01 00 00 00 00 02 00 83
			29 01 00 00 00 00 02 C5 55       //pump & EXTPfrequence

			29 01 00 00 00 00 02 00 85
			29 01 00 00 00 00 02 C5 12       //20170711 Power IC

			29 01 00 00 00 00 02 00 00
			29 01 00 00 00 00 03 d8 1f 1f  // GVDD/NGVDD = 4.1v/-4.1v

			29 01 00 00 00 00 02 00 01  //VCOM
			29 01 00 00 00 00 02 d9 33

			//-------------------- panel timing state control --------------------//
			29 01 00 00 00 00 02 00 80       //panel timing state control
			29 01 00 00 00 00 09 cb 14 14 14 14 14 14 14 14

			29 01 00 00 00 00 02 00 a0      //panel timing state control
			29 01 00 00 00 00 02 cb 00

			//-------------------- panel pad mapping control --------------------//
			29 01 00 00 00 00 02 00 80       //panel timing state control
			29 01 00 00 00 00 10 cc 11 01 02 09 0c 0a 0d 0b 0f 01 01 00 00 00 05

			29 01 00 00 00 00 02 00 90       //panel timing state control
			29 01 00 00 00 00 10 cc 00 00 00 00 00 00 12 01 02 19 1c 1a 0e 1b 10

			29 01 00 00 00 00 02 00 a0       //panel timing state control
			29 01 00 00 00 00 0D cc 01 01 00 00 00 06 00 00 00 00 00 00

			29 01 00 00 00 00 02 00 b0       //panel timing state control
			29 01 00 00 00 00 10 cc 06 02 01 10 1b 0e 1a 1c 19 01 01 00 00 00 12

			29 01 00 00 00 00 02 00 c0       //panel timing state control
			29 01 00 00 00 00 10 cc 00 00 00 00 00 00 05 02 01 0f 0b 0d 0a 0c 09

			29 01 00 00 00 00 02 00 d0       //panel timing state control
			29 01 00 00 00 00 0D cc 01 01 00 00 00 11 00 00 00 00 00 00

			//-------------------- panel timing setting --------------------//
			29 01 00 00 00 00 02 00 e0   //GOA EQ setting
			29 01 00 00 00 00 06 cc 00 00 00 00 00

			29 01 00 00 00 00 02 00 80  //panel VST setting
			29 01 00 00 00 00 07 ce 8e 00 8d 00 00 55

			29 01 00 00 00 00 02 00 90   //panel VEND setting
			29 01 00 00 00 00 06 ce 05 00 06 00 00

			29 01 00 00 00 00 02 00 a0   //CLKA setting
			29 01 00 00 00 00 0C ce 8c 08 00 8a 0a 5b 88 0c 00 86 0d

			29 01 00 00 00 00 02 00 b0   //CLKB setting
			29 01 00 00 00 00 0D ce 84 0f 00 83 0f 82 0f 00 81 0f 35 00  //20170711 chop

			29 01 00 00 00 00 02 00 a0
			29 01 00 00 00 00 05 f3 02 5b 35 00 // 8phase F3A1/F3A2/F3A3 setting same as CEA5/CEBA/CEBB

			29 01 00 00 00 00 02 00 e0    //GCH setting
			29 01 00 00 00 00 0B ce 00 00 00 00 00 00 00 00 00 00

			29 01 00 00 00 00 02 00 f0     //toggle mode setting
			29 01 00 00 00 00 0A ce 02 90 90 90 90 90 90 90 90

			29 01 00 00 00 00 02 00 80    //ECLK setting
			29 01 00 00 00 00 0C cf 00 00 00 00 00 00 00 00 00 00 00  //20170711 ECLK shift/chop 2.5us

			//-------------------- gamma setting --------------------//
			29 01 00 00 00 00 02 00 00
			29 01 00 00 00 00 11 E1 00 31 43 57 67 84 81 97 61 4f 5b 47 35 26 17 00


			29 01 00 00 00 00 02 00 00
			29 01 00 00 00 00 11 E2 00 31 43 57 66 85 81 96 62 4f 5b 47 35 26 17 00

			29 01 00 00 00 00 02 35 01
			29 01 00 00 00 00 02 00 B0
			29 01 00 00 00 00 05 CA 03 03 50 05
			29 01 00 00 00 00 02 00 B2
			29 01 00 00 00 00 02 CA 50
			29 01 00 00 00 00 02 51 00
			29 01 00 00 00 00 02 53 2C
			29 01 00 00 00 00 02 55 01

			29 01 00 00 00 00 02 00 80     //Disable Command 2
			29 01 00 00 00 00 03 ff ff ff

			29 01 00 00 00 00 02 00 00     //EXTC=0
			29 01 00 00 00 00 04 ff ff ff ff

			29 01 00 00 78 00 02 11 00
			29 01 00 00 96 00 02 29 00
		];
		qcom,mdss-dsi-off-command = [
			29 01 00 00 00 00 02 53 00
			05 01 00 00 32 00 02 28 00
			05 01 00 00 A0 00 02 10 00
		];
		qcom,mdss-dsi-on-command-state = "dsi_lp_mode";
		qcom,mdss-dsi-off-command-state = "dsi_lp_mode";
		qcom,mdss-dsi-lp11-init;
		qcom,mdss-dsi-h-sync-pulse = <0>;
		qcom,mdss-dsi-traffic-mode = "burst_mode";
		qcom,mdss-dsi-bllp-eof-power-mode;
		qcom,mdss-dsi-bllp-power-mode;
		qcom,mdss-dsi-lane-0-state;
		qcom,mdss-dsi-lane-1-state;
		qcom,mdss-dsi-lane-2-state;
		qcom,mdss-dsi-lane-3-state;
		qcom,mdss-dsi-panel-timings = [86 1E 14 00 42 46 18 20 16 03 04 00];
		qcom,mdss-dsi-t-clk-post = <0x04>;
		qcom,mdss-dsi-t-clk-pre = <0x1B>;
		qcom,mdss-dsi-bl-min-level = <3>;
		qcom,mdss-dsi-bl-max-level = <255>;
		qcom,mdss-dsi-dma-trigger = "trigger_sw";
		qcom,mdss-dsi-mdp-trigger = "none";
		qcom,mdss-dsi-bl-pmic-control-type = "bl_ctrl_dcs";
		qcom,mdss-dsi-reset-sequence = <1 20>, <0 2>, <1 20>;
		qcom,mdss-pan-physical-width-dimension = <62>;
		qcom,mdss-pan-physical-height-dimension = <124>;
		qcom,mdss-dsi-tx-eot-append;
		qcom,mdss-dsi-post-init-delay = <1>;
		zte,lcm_backlight_curve_mode = "lcd_brightness_max_350_lux";
	};
};
