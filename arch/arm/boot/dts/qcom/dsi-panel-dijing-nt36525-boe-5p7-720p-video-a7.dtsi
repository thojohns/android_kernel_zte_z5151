 /* Copyright (c) 2015, The Linux Foundation. All rights reserved.
 *
 * This program is free software; you can redistribute it and/or modify
 * it under the terms of the GNU General Public License version 2 and
 * only version 2 as published by the Free Software Foundation.
 *
 * This program is distributed in the hope that it will be useful,
 * but WITHOUT ANY WARRANTY; without even the implied warranty of
 * MERCHANTABILITY or FITNESS FOR A PARTICULAR PURPOSE.  See the
 * GNU General Public License for more details.
 */
&mdss_mdp {
	dsi_dijing_nt36525_boe_720p_video: qcom,mdss_dsi_dijing_nt36525_boe_720p_video{
		qcom,mdss-dsi-panel-name = "dijing nt36525 boe 5p7inch 720p video dsi panel";
		qcom,cont-splash-enabled;
		zte,lcd_bl_vsp_vsn_voltage = <0xf>;
		qcom,mdss-dsi-panel-controller = <&mdss_dsi0>;
		qcom,mdss-dsi-panel-type = "dsi_video_mode";
		qcom,mdss-dsi-panel-framerate = <60>;
		qcom,mdss-dsi-virtual-channel-id = <0>;
		qcom,mdss-dsi-stream = <0>;
		qcom,mdss-dsi-panel-width = <720>;
		qcom,mdss-dsi-panel-height = <1440>;
		qcom,mdss-dsi-h-front-porch = <328>;
		qcom,mdss-dsi-h-back-porch = <28>;
		qcom,mdss-dsi-h-pulse-width = <4>;
		qcom,mdss-dsi-h-sync-skew = <0>;
		qcom,mdss-dsi-v-back-porch = <8>;
		qcom,mdss-dsi-v-front-porch = <10>;
		qcom,mdss-dsi-v-pulse-width = <2>;
		qcom,mdss-dsi-h-left-border = <0>;
		qcom,mdss-dsi-h-right-border = <0>;
		qcom,mdss-dsi-v-top-border = <0>;
		qcom,mdss-dsi-v-bottom-border = <0>;
		qcom,mdss-dsi-bpp = <24>;
		qcom,mdss-dsi-color-order = "rgb_swap_rgb";
		qcom,mdss-dsi-underflow-color = <0xff>;
		qcom,mdss-dsi-border-color = <0>;
		qcom,mdss-dsi-on-command = [
/*
			39 01 00 00 00 00 02 FF 20
			39 01 00 00 00 00 02 FB 01
			39 01 00 00 00 00 02 05 91
			39 01 00 00 00 00 02 07 4B
			39 01 00 00 00 00 02 08 DF
			39 01 00 00 00 00 02 0E 69
			39 01 00 00 00 00 02 0F 7D
			39 01 00 00 00 00 02 94 40
			39 01 00 00 00 00 02 95 F5
			39 01 00 00 00 00 02 96 1D
			39 01 00 00 00 00 02 69 91
			39 01 00 00 00 00 02 01 55
			39 01 00 00 00 00 02 03 55

			39 01 00 00 00 00 02 FF 23

			39 01 00 00 00 00 02 FB 01
			39 01 00 00 00 00 02 12 A2
			39 01 00 00 00 00 02 15 81
			39 01 00 00 00 00 02 16 0A

			39 01 00 00 00 00 02 FF 24

			39 01 00 00 00 00 02 FB 01

			// for TE
			39 01 00 00 00 00 02 FF 24
			39 01 00 00 00 00 02 D1 FF
			39 01 00 00 00 00 02 D2 FF
			39 01 00 00 00 00 02 C4 55
			39 01 00 00 00 00 02 C3 12

			39 01 00 00 00 00 02 93 0A
			39 01 00 00 00 00 02 94 0A
			39 01 00 00 00 00 02 00 00
			39 01 00 00 00 00 02 01 1D
			39 01 00 00 00 00 02 02 1E
			39 01 00 00 00 00 02 03 14
			39 01 00 00 00 00 02 04 15
			39 01 00 00 00 00 02 05 16
			39 01 00 00 00 00 02 06 17
			39 01 00 00 00 00 02 07 00
			39 01 00 00 00 00 02 08 1C
			39 01 00 00 00 00 02 09 1F
			39 01 00 00 00 00 02 0A 04
			39 01 00 00 00 00 02 0B 05
			39 01 00 00 00 00 02 0C 00
			39 01 00 00 00 00 02 0D 00
			39 01 00 00 00 00 02 0E 00
			39 01 00 00 00 00 02 0F 00
			39 01 00 00 00 00 02 10 00
			39 01 00 00 00 00 02 11 00
			39 01 00 00 00 00 02 12 00
			39 01 00 00 00 00 02 13 00
			39 01 00 00 00 00 02 14 00
			39 01 00 00 00 00 02 15 00
			39 01 00 00 00 00 02 16 00
			39 01 00 00 00 00 02 17 1D
			39 01 00 00 00 00 02 18 1E
			39 01 00 00 00 00 02 19 0C
			39 01 00 00 00 00 02 1A 0D
			39 01 00 00 00 00 02 1B 0E
			39 01 00 00 00 00 02 1C 0F
			39 01 00 00 00 00 02 1D 00
			39 01 00 00 00 00 02 1E 1C
			39 01 00 00 00 00 02 1F 1F
			39 01 00 00 00 00 02 20 04
			39 01 00 00 00 00 02 21 05
			39 01 00 00 00 00 02 22 00
			39 01 00 00 00 00 02 23 00
			39 01 00 00 00 00 02 24 00
			39 01 00 00 00 00 02 25 00
			39 01 00 00 00 00 02 26 00
			39 01 00 00 00 00 02 27 00
			39 01 00 00 00 00 02 28 00
			39 01 00 00 00 00 02 29 00
			39 01 00 00 00 00 02 2A 00
			39 01 00 00 00 00 02 2B 00
			39 01 00 00 00 00 02 2F 07
			39 01 00 00 00 00 02 30 05
			39 01 00 00 00 00 02 31 00
			39 01 00 00 00 00 02 32 00
			39 01 00 00 00 00 02 33 05
			39 01 00 00 00 00 02 34 07
			39 01 00 00 00 00 02 35 00
			39 01 00 00 00 00 02 36 00
			39 01 00 00 00 00 02 37 33
			39 01 00 00 00 00 02 38 33
			39 01 00 00 00 00 02 39 00
			39 01 00 00 00 00 02 3A 01
			39 01 00 00 00 00 02 3B A4
			39 01 00 00 00 00 02 3D 52
			39 01 00 00 00 00 02 4D 34
			39 01 00 00 00 00 02 4E 12
			39 01 00 00 00 00 02 4F 00
			39 01 00 00 00 00 02 50 00
			39 01 00 00 00 00 02 51 21
			39 01 00 00 00 00 02 52 43
			39 01 00 00 00 00 02 53 00
			39 01 00 00 00 00 02 54 00
			39 01 00 00 00 00 02 55 46
			39 01 00 00 00 00 02 56 34
			39 01 00 00 00 00 02 58 21
			39 01 00 00 00 00 02 59 00
			39 01 00 00 00 00 02 5A 01
			39 01 00 00 00 00 02 5B 9B
			39 01 00 00 00 00 02 5C 85
			39 01 00 00 00 00 02 5D 07
			39 01 00 00 00 00 02 5E 04
			39 01 00 00 00 00 02 5F 00
			39 01 00 00 00 00 02 68 34
			39 01 00 00 00 00 02 69 12
			39 01 00 00 00 00 02 6A 21
			39 01 00 00 00 00 02 6B 43
			39 01 00 00 00 00 02 6C 46
			39 01 00 00 00 00 02 6D 34
			39 01 00 00 00 00 02 6E 21
			39 01 00 00 00 00 02 6F 00
			39 01 00 00 00 00 02 70 01
			39 01 00 00 00 00 02 71 9B
			39 01 00 00 00 00 02 72 85
			39 01 00 00 00 00 02 73 07
			39 01 00 00 00 00 02 74 04
			39 01 00 00 00 00 02 75 00
			39 01 00 00 00 00 02 60 80
			39 01 00 00 00 00 02 61 68
			39 01 00 00 00 00 02 64 11
			39 01 00 00 00 00 02 80 08
			39 01 00 00 00 00 02 81 04
			39 01 00 00 00 00 02 82 08
			39 01 00 00 00 00 02 83 04
			39 01 00 00 00 00 02 84 80
			39 01 00 00 00 00 02 85 01
			39 01 00 00 00 00 02 91 40
			39 01 00 00 00 00 02 92 BC
			39 01 00 00 00 00 02 AB 00
			39 01 00 00 00 00 02 AD 00
			39 01 00 00 00 00 02 AF 04
			39 01 00 00 00 00 02 B0 05
			39 01 00 00 00 00 02 B1 B7

			39 01 00 00 00 00 02 FF 25

			39 01 00 00 00 00 02 FB 01
			39 01 00 00 00 00 02 17 82
			39 01 00 00 00 00 02 18 06
			39 01 00 00 00 00 02 19 0F
			39 01 00 00 00 00 02 1E 00
			39 01 00 00 00 00 02 1F 01
			39 01 00 00 00 00 02 20 9B
			39 01 00 00 00 00 02 23 05
			39 01 00 00 00 00 02 24 B7
			39 01 00 00 00 00 02 25 00
			39 01 00 00 00 00 02 26 01
			39 01 00 00 00 00 02 27 9B
			39 01 00 00 00 00 02 2A 05
			39 01 00 00 00 00 02 2B B7
			39 01 00 00 00 00 02 21 01
			39 01 00 00 00 00 02 22 9B
			39 01 00 00 00 00 02 28 01
			39 01 00 00 00 00 02 29 9B
			39 01 00 00 00 00 02 35 01
			39 01 00 00 00 00 02 36 9B
			39 01 00 00 00 00 02 44 01
			39 01 00 00 00 00 02 45 9B
			39 01 00 00 00 00 02 51 01
			39 01 00 00 00 00 02 52 9B
			39 01 00 00 00 00 02 63 01
			39 01 00 00 00 00 02 64 9B
			39 01 00 00 00 00 02 2F 55
			39 01 00 00 00 00 02 30 11
			39 01 00 00 00 00 02 31 00
			39 01 00 00 00 00 02 32 00
			39 01 00 00 00 00 02 33 01
			39 01 00 00 00 00 02 34 9B
			39 01 00 00 00 00 02 37 05
			39 01 00 00 00 00 02 38 B7
			39 01 00 00 00 00 02 40 11
			39 01 00 00 00 00 02 41 00
			39 01 00 00 00 00 02 42 01
			39 01 00 00 00 00 02 43 9B
			39 01 00 00 00 00 02 46 05
			39 01 00 00 00 00 02 47 B7
			39 01 00 00 00 00 02 49 00
			39 01 00 00 00 00 02 4A 00
			39 01 00 00 00 00 02 4B 01
			39 01 00 00 00 00 02 4C A4
			39 01 00 00 00 00 02 4F 01
			39 01 00 00 00 00 02 50 9B
			39 01 00 00 00 00 02 53 05
			39 01 00 00 00 00 02 54 B7
			39 01 00 00 00 00 02 55 05
			39 01 00 00 00 00 02 56 B7
			39 01 00 00 00 00 02 5A 22
			39 01 00 00 00 00 02 5B C0
			39 01 00 00 00 00 02 5C 00
			39 01 00 00 00 00 02 5D 05
			39 01 00 00 00 00 02 5E B0
			39 01 00 00 00 00 02 61 01
			39 01 00 00 00 00 02 62 9B
			39 01 00 00 00 00 02 65 05
			39 01 00 00 00 00 02 66 B2
			39 01 00 00 00 00 02 8A 02
			39 01 00 00 00 00 02 CA 1C
			39 01 00 00 00 00 02 CC 1C
			39 01 00 00 00 00 02 CD 00
			39 01 00 00 00 00 02 CE 00
			39 01 00 00 00 00 02 D3 11
			39 01 00 00 00 00 02 D4 CC
			39 01 00 00 00 00 02 D5 11
			39 01 00 00 00 00 02 0A 82
			39 01 00 00 00 00 02 0B BE
			39 01 00 00 00 00 02 0C 01

			39 01 00 00 00 00 02 FF 26

			39 01 00 00 00 00 02 FB 01
			39 01 00 00 00 00 02 00 A1
			39 01 00 00 00 00 02 04 4A
			39 01 00 00 00 00 02 0C 0B
			39 01 00 00 00 00 02 0D 01
			39 01 00 00 00 00 02 0E 02
			39 01 00 00 00 00 02 0F 06
			39 01 00 00 00 00 02 10 07
			39 01 00 00 00 00 02 11 00
			39 01 00 00 00 00 02 13 28
			39 01 00 00 00 00 02 14 80
			39 01 00 00 00 00 02 16 81
			39 01 00 00 00 00 02 19 12
			39 01 00 00 00 00 02 1A DA
			39 01 00 00 00 00 02 1B 12
			39 01 00 00 00 00 02 1C 3F
			39 01 00 00 00 00 02 1D 00
			39 01 00 00 00 00 02 1E BC
			39 01 00 00 00 00 02 1F BC
			39 01 00 00 00 00 02 24 00
			39 01 00 00 00 00 02 25 BC
			39 01 00 00 00 00 02 26 66
			39 01 00 00 00 00 02 27 66
			39 01 00 00 00 00 02 28 66
			39 01 00 00 00 00 02 29 06
			39 01 00 00 00 00 02 2F 00
			39 01 00 00 00 00 02 30 BC
			39 01 00 00 00 00 02 31 11
			39 01 00 00 00 00 02 32 61
			39 01 00 00 00 00 02 34 03
			39 01 00 00 00 00 02 35 BC
			39 01 00 00 00 00 02 36 71
			39 01 00 00 00 00 02 37 66
			39 01 00 00 00 00 02 38 66
			39 01 00 00 00 00 02 39 06
			39 01 00 00 00 00 02 3F 04
			39 01 00 00 00 00 02 40 B7
			39 01 00 00 00 00 02 41 00
			39 01 00 00 00 00 02 42 00
			39 01 00 00 00 00 02 43 00

			39 01 00 00 00 00 02 FF 26

			39 01 00 00 00 00 02 FB 01
			39 01 00 00 00 00 02 58 E0
			39 01 00 00 00 00 02 59 E0
			39 01 00 00 00 00 02 5A E0
			39 01 00 00 00 00 02 5B E0
			39 01 00 00 00 00 02 5C 00
			39 01 00 00 00 00 02 5D 00
			39 01 00 00 00 00 02 5E 04
			39 01 00 00 00 00 02 5F 00
			39 01 00 00 00 00 02 60 00
			39 01 00 00 00 00 02 61 00
			39 01 00 00 00 00 02 63 01
			39 01 00 00 00 00 02 64 A4
			39 01 00 00 00 00 02 67 01
			39 01 00 00 00 00 02 68 9B
			39 01 00 00 00 00 02 69 01
			39 01 00 00 00 00 02 6A 9B
			39 01 00 00 00 00 02 6B 00
			39 01 00 00 00 00 02 6C 05
			39 01 00 00 00 00 02 6D 00
			39 01 00 00 00 00 02 70 05
			39 01 00 00 00 00 02 71 B7
			39 01 00 00 00 00 02 73 01
			39 01 00 00 00 00 02 74 9B
			39 01 00 00 00 00 02 75 01
			39 01 00 00 00 00 02 76 9B
			39 01 00 00 00 00 02 77 05
			39 01 00 00 00 00 02 78 B7
			39 01 00 00 00 00 02 79 00
			39 01 00 00 00 00 02 7A 01
			39 01 00 00 00 00 02 7B 9B
			39 01 00 00 00 00 02 7C 01
			39 01 00 00 00 00 02 7D 9B
			39 01 00 00 00 00 02 7E 05
			39 01 00 00 00 00 02 7F B7
			39 01 00 00 00 00 02 80 00
			39 01 00 00 00 00 02 81 00
			39 01 00 00 00 00 02 82 05
			39 01 00 00 00 00 02 83 B0
			39 01 00 00 00 00 02 86 01
			39 01 00 00 00 00 02 87 9B
			39 01 00 00 00 00 02 88 01
			39 01 00 00 00 00 02 89 9B
			39 01 00 00 00 00 02 8A 05
			39 01 00 00 00 00 02 8B B7
			39 01 00 00 00 00 02 8C 00
			39 01 00 00 00 00 02 8D 00
			39 01 00 00 00 00 02 8E 01
			39 01 00 00 00 00 02 8F 00
			39 01 00 00 00 00 02 90 00
			39 01 00 00 00 00 02 91 00
			39 01 00 00 00 00 02 92 05
			39 01 00 00 00 00 02 93 A0
			39 01 00 00 00 00 02 94 80
			39 01 00 00 00 00 02 95 00
			39 01 00 00 00 00 02 96 00
			39 01 00 00 00 00 02 99 18
			39 01 00 00 00 00 02 9A B1
			39 01 00 00 00 00 02 9B 18
			39 01 00 00 00 00 02 9C A9

			39 01 00 00 00 00 02 FF 27

			39 01 00 00 00 00 02 FB 01
			39 01 00 00 00 00 02 13 00
			39 01 00 00 00 00 02 14 55
			39 01 00 00 00 00 02 24 A0
			39 01 00 00 00 00 02 25 A0
			39 01 00 00 00 00 02 26 70

			39 01 00 00 00 00 02 FF 23

			39 01 00 00 00 00 02 FB 01
			39 01 00 00 00 00 02 07 20
			39 01 00 00 00 00 02 08 03
			39 01 00 00 00 00 02 09 55

			39 01 00 00 00 00 02 FF E0

			39 01 00 00 00 00 02 FB 01
			39 01 00 00 00 00 02 9E 00

			39 01 00 00 00 00 02 FF 10

			39 01 00 00 00 00 02 FB 01
			39 01 00 00 00 00 02 B0 01
*/
			39 01 00 00 00 00 02 51 00
			39 01 00 00 00 00 02 53 24
			39 01 00 00 00 00 02 55 00

			39 01 00 00 00 00 02 29 00
			39 01 00 00 64 00 02 11 00
		];
		qcom,mdss-dsi-off-command = [
			05 01 00 00 32 00 02 28 00
			05 01 00 00 A0 00 02 10 00
		];
		qcom,mdss-dsi-on-command-state = "dsi_lp_mode";
		qcom,mdss-dsi-off-command-state = "dsi_lp_mode";
		te,mdss-dsi-cabc-off-command = [39 01 00 00 00 00 02 55 00];
		zte,mdss-dsi-cabc-low-command = [39 01 00 00 00 00 02 55 01];
		zte,mdss-dsi-cabc-medium-command = [39 01 00 00 00 00 02 55 02];
		zte,mdss-dsi-cabc-high-command = [39 01 00 00 00 00 02 55 03];
		zte,mdss-dsi-cabc-command-state = "dsi_lp_mode";
		qcom,mdss-dsi-lp11-init;
		qcom,mdss-dsi-h-sync-pulse = <0>;
		qcom,mdss-dsi-traffic-mode = "burst_mode";
		qcom,mdss-dsi-bllp-eof-power-mode;
		qcom,mdss-dsi-bllp-power-mode;
		qcom,mdss-dsi-hfp-power-mode;	//
		//qcom,dsi-pll-ssc-en;	//
		qcom,mdss-dsi-lane-0-state;
		qcom,mdss-dsi-lane-1-state;
		qcom,mdss-dsi-lane-2-state;
		qcom,mdss-dsi-lane-3-state;
		qcom,mdss-dsi-panel-timings =[9B 24 18 00 4A 4E 1C 28 1D 03 04 00];
		qcom,mdss-dsi-t-clk-post = <0x04>;
		qcom,mdss-dsi-t-clk-pre = <0x1E>;
		qcom,mdss-dsi-bl-min-level = <3>;
		qcom,mdss-dsi-bl-max-level = <255>;
		qcom,mdss-dsi-dma-trigger = "trigger_sw";
		qcom,mdss-dsi-mdp-trigger = "none";
		qcom,mdss-dsi-bl-pmic-control-type = "bl_ctrl_dcs";
		qcom,mdss-dsi-reset-sequence = <1 15>, <0 5>, <1 20>;
		qcom,mdss-pan-physical-width-dimension = <64>;
		qcom,mdss-pan-physical-height-dimension = <128>;
		qcom,mdss-dsi-tx-eot-append;
		qcom,mdss-dsi-post-init-delay = <1>;
		zte,lcm_backlight_curve_mode = "lcd_brightness_max_350_lux";

		zte,lcm_reset_pin_keep_high_sleeping;

		qcom,esd-check-enabled;
		qcom,mdss-dsi-panel-status-command=[06 01 00 01 05 00 01 0A] ;
		qcom,mdss-dsi-panel-status-command-state="dsi_lp_mode";
		qcom,mdss-dsi-panel-status-check-mode="reg_read";
		qcom,mdss-dsi-panel-status-value=<0x9C>;
		qcom,mdss-dsi-panel-status-read-length = <1>;
	};
};
