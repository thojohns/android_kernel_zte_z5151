
qcom,batterydata-coslight-20k-2800mAh {
	/* #2712635_ZTE_P840F01cos_2820mAh_averaged_MasterSlave_Dec13th2016*/
	qcom,max-voltage-uv = <4400000>;
	qcom,nom-batt-capacity-mah = <2820>;
	qcom,batt-id-kohm = <20>;
	qcom,battery-beta = <4050>;
	qcom,battery-type = "batterydata-coslight-20k-2800mAh";
	qcom,chg-rslow-comp-c1 = <4433535>;
	qcom,chg-rslow-comp-c2 = <8182395>;
	qcom,chg-rs-to-rslow = <1152147>;
	qcom,chg-rslow-comp-thr = <0xBA>;
	qcom,fastchg-current-ma = <1500>;
	qcom,fg-cc-cv-threshold-mv = <4390>;
	qcom,checksum = <0x638A>;
	qcom,gui-version = "PMI8950GUI - 2.0.0.16";
	qcom,fg-profile-data = [
		 D7 83 58 7C
		 89 80 E7 75
		 57 83 44 64
		 1B 83 6D 8E
		 8B 82 78 92
		 4B B4 AC BB
		 52 15 EF 83
		 A7 7C A4 80
		 EA 75 61 83
		 1E 5F 0A 88
		 EB 8F 56 82
		 AC 99 01 BD
		 F5 C9 52 0D
		 5E 0B 1C 60
		 14 70 D9 FD
		 7C 31 23 46
		 1E 32 00 00
		 17 46 BC 31
		 5F 28 00 00
		 00 00 00 00
		 00 00 00 00
		 F9 70 18 6B
		 2C 7E AC 83
		 18 7D 5B 72
		 00 67 8C 7B
		 97 76 B2 6A
		 4D 67 BA A8
		 26 CF 5B DA
		 5C A0 71 0C
		 28 00 FF 36
		 F0 11 30 03
		 00 00 00 0C
	];
};
