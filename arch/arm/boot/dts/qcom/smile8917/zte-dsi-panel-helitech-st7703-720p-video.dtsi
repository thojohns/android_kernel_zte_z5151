/* Copyright (c) 2013, The Linux Foundation. All rights reserved.
 *
 * This program is free software; you can redistribute it and/or modify
 * it under the terms of the GNU General Public License version 2 and
 * only version 2 as published by the Free Software Foundation.
 *
 * This program is distributed in the hope that it will be useful,
 * but WITHOUT ANY WARRANTY; without even the implied warranty of
 * MERCHANTABILITY or FITNESS FOR A PARTICULAR PURPOSE.  See the
 * GNU General Public License for more details.
 */

/*---------------------------------------------------------------------------
 * This file is autogenerated file using gcdb parser. Please do not edit it.
 * Update input XML file to add a new entry or update variable in this file
 * VERSION = "1.0"
 *---------------------------------------------------------------------------*/
&mdss_mdp {
	dsi_helitech_st7703_720p_video: qcom,mdss_dsi_helitech_st7703_720p_video {
		qcom,mdss-dsi-panel-name = "helitech st7703 720p video mode dsi panel";
		zte,lcd-init-code-version = "20180511";
		zte,set-reset-pin-ctrl;
		qcom,cont-splash-enabled;
		zte,lcd_bl_vsp_vsn_voltage = <0xf>;
		qcom,panel-supply-entries = <&dsi_panel_pwr_supply>;
		qcom,mdss-dsi-panel-controller = <&mdss_dsi0>;
		qcom,mdss-dsi-panel-type = "dsi_video_mode";
		qcom,mdss-dsi-panel-destination = "display_1";
		qcom,mdss-dsi-panel-framerate = <60>;
		/*qcom,mdss-dsi-panel-clockrate = <866400000>;*/
		qcom,mdss-dsi-virtual-channel-id = <0>;
		qcom,mdss-dsi-stream = <0>;
		qcom,mdss-dsi-panel-width = <720>;
		qcom,mdss-dsi-panel-height = <1440>;
		qcom,mdss-dsi-h-front-porch = <100>;
		qcom,mdss-dsi-h-back-porch = <96>;
		qcom,mdss-dsi-h-pulse-width = <8>;
		qcom,mdss-dsi-h-sync-skew = <0>;
		qcom,mdss-dsi-v-back-porch = <20>;
		qcom,mdss-dsi-v-front-porch = <20>;
		qcom,mdss-dsi-v-pulse-width = <8>;
		qcom,mdss-dsi-h-left-border = <0>;
		qcom,mdss-dsi-h-right-border = <0>;
		qcom,mdss-dsi-v-top-border = <0>;
		qcom,mdss-dsi-v-bottom-border = <0>;
		qcom,mdss-dsi-bpp = <24>;
		qcom,mdss-dsi-color-order = "rgb_swap_rgb";
		qcom,mdss-dsi-underflow-color = <0xff>;
		qcom,mdss-dsi-border-color = <0>;
		qcom,mdss-dsi-on-command = [39 01 00 00 00 00 04 b9 f1 12 83
39 01 00 00 00 00 1c ba 33 81 05 f9 0e 0e 20 00 00 00 00 00 00 00 44 25 00 91 0a 00 00 02 4f 01 03 02 37
39 01 00 00 00 00 02 b8 75
39 01 00 00 00 00 04 bf 02 10 00
39 01 00 00 00 00 0b b3 07 0b 1e 1e 03 ff 00 00 00 00
39 01 00 00 00 00 0a c0 73 73 50 50 00 00 08 A0 00
39 01 00 00 00 00 02 bc 46
39 01 00 00 00 00 02 cc 0b
39 01 00 00 00 00 02 b4 80
39 01 00 00 00 00 03 b2 f0 02
39 01 00 00 00 00 0f e3 03 03 03 03 03 03 00 00 00 00 ff 00 c0 10
39 01 00 00 00 00 0d c1 54 00 1e 1e 77 f1 cc dd 67 77 33 33
39 01 00 00 00 00 03 c6 02 42
39 01 00 00 00 00 03 b5 1f 1f
39 01 00 00 00 00 03 b6 bb bb
39 01 00 00 00 00 40 e9 82 10 05 05 a1 08 f0 12 31 23 37 82 08 f0 37 00 00 81 00 00 00 00 00 81 00 00 00
	00 f8 ab 02 46 08 88 88 84 88 88 88 f8 ab 13 57 18 88 88 85 88 88 88 00 00 00 00 00 00 00 00 00 00 00 00 00
39 01 00 00 00 00 3e ea 0b 12 01 01 00 3d 00 00 00 00 00 00 8f ab 75 31 58 88 88 81 88 88 88 8f ab 64 20
	48 88 88 80 88 88 88 23 30 00 01 20 00 00 00 00 00 00 00 00 00 00 00 00 00 00 00 30 08 e0 00 00 00 00
39 01 00 00 00 00 23 e0 00 03 08 29 3B 3F 37 31 07 0C 0D 10 12 10 12 10 17
			00 03 08 29 3B 3F 37 31 07 0C 0D 10 12 10 12 10 17
39 01 00 00 00 00 04 c8 10 01 02
39 01 00 00 00 00 02 51 00
39 01 00 00 00 00 02 53 2c
39 01 00 00 00 00 02 55 01
39 01 00 00 00 00 02 5e 04
05 01 00 00 78 00 02 11 00
05 01 00 00 14 00 02 29 00
39 01 00 00 00 00 02 c7 a0];
		qcom,mdss-dsi-off-command = [39 01 00 00 00 00 02 53 00
					05 01 00 00 32 00 02 28 00
					05 01 00 00 78 00 02 10 00];
		qcom,mdss-dsi-on-command-state = "dsi_lp_mode";
		qcom,mdss-dsi-off-command-state = "dsi_hs_mode";
		zte,mdss-dsi-cabc-default-value = <0x01>;
		zte,mdss-dsi-cabc-off-command = [39 01 00 00 00 00 02 55 00
		];
		zte,mdss-dsi-cabc-low-command = [39 01 00 00 00 00 02 55 01
		];
		zte,mdss-dsi-cabc-medium-command = [39 01 00 00 00 00 02 55 02
		];
		zte,mdss-dsi-cabc-high-command = [39 01 00 00 00 00 02 55 03
		];
		zte,mdss-dsi-cabc-command-state = "dsi_lp_mode";
		qcom,mdss-dsi-lp11-init;
		qcom,mdss-dsi-h-sync-pulse = <1>;
		qcom,mdss-dsi-traffic-mode = "burst_mode";
		qcom,mdss-dsi-lane-map = "lane_map_0123";
		qcom,mdss-dsi-bllp-eof-power-mode;
		qcom,mdss-dsi-bllp-power-mode;
		qcom,mdss-dsi-lane-0-state;
		qcom,mdss-dsi-lane-1-state;
		qcom,mdss-dsi-lane-2-state;
		qcom,mdss-dsi-lane-3-state;
		qcom,mdss-dsi-panel-timings = [8B 1E 14 00 44 48 18 22 19 03 04 00];
		qcom,mdss-dsi-t-clk-post = <0x04>;
		qcom,mdss-dsi-t-clk-pre = <0x1C>;
		qcom,mdss-dsi-bl-min-level = <4>;
		qcom,mdss-dsi-bl-max-level = <255>;
		qcom,mdss-dsi-dma-trigger = "trigger_sw";
		qcom,mdss-dsi-mdp-trigger = "none";
		qcom,mdss-dsi-bl-pmic-control-type = "bl_ctrl_dcs";
		qcom,mdss-dsi-reset-sequence = <1 5>, <0 2>, <1 20>;
		qcom,mdss-pan-physical-width-dimension = <62>;
		qcom,mdss-pan-physical-height-dimension = <124>;
		zte,lcm_backlight_curve_mode = "lcd_brightness_max_350_lux";
		qcom,mdss-dsi-tx-eot-append;
		qcom,esd-check-enabled;
		qcom,mdss-dsi-panel-status-command=[14 01 00 01 05 00 01 09
						14 01 00 01 05 00 01 0a
						14 01 00 01 05 00 01 68];
		qcom,mdss-dsi-panel-status-command-state="dsi_lp_mode";
		qcom,mdss-dsi-panel-status-check-mode="reg_read";
		qcom,mdss-dsi-panel-status-value=<0x80 0x9c 0xc0>;
		qcom,mdss-dsi-panel-status-read-length = <1 1 1>;
		qcom,mdss-dsi-panel-status-valid-params = <1 1 1>;
	};
};
