/* Copyright (c) 2013, The Linux Foundation. All rights reserved.
 *
 * This program is free software; you can redistribute it and/or modify
 * it under the terms of the GNU General Public License version 2 and
 * only version 2 as published by the Free Software Foundation.
 *
 * This program is distributed in the hope that it will be useful,
 * but WITHOUT ANY WARRANTY; without even the implied warranty of
 * MERCHANTABILITY or FITNESS FOR A PARTICULAR PURPOSE.  See the
 * GNU General Public License for more details.
 */

/*---------------------------------------------------------------------------
 * This file is autogenerated file using gcdb parser. Please do not edit it.
 * Update input XML file to add a new entry or update variable in this file
 * VERSION = "1.0"
 *---------------------------------------------------------------------------*/
&mdss_mdp {
	dsi_lianchuang_jd9365d_720p_video: qcom,mdss_dsi_lianchuang_jd9365d_720p_video {
		qcom,mdss-dsi-panel-name = "lianchuang jd9365d 720p video mode dsi panel";
		zte,lcd-init-code-version = "20180417";
		qcom,cont-splash-enabled;
		zte,lcd_bl_vsp_vsn_voltage = <0xf>;
		qcom,panel-supply-entries = <&dsi_panel_pwr_supply>;
		qcom,mdss-dsi-panel-controller = <&mdss_dsi0>;
		qcom,mdss-dsi-panel-type = "dsi_video_mode";
		qcom,mdss-dsi-panel-destination = "display_1";
		qcom,mdss-dsi-panel-framerate = <60>;
		/*qcom,mdss-dsi-panel-clockrate = <866400000>;*/
		qcom,mdss-dsi-virtual-channel-id = <0>;
		qcom,mdss-dsi-stream = <0>;
		qcom,mdss-dsi-panel-width = <720>;
		qcom,mdss-dsi-panel-height = <1440>;
		qcom,mdss-dsi-h-front-porch = <100>;
		qcom,mdss-dsi-h-back-porch = <96>;
		qcom,mdss-dsi-h-pulse-width = <8>;
		qcom,mdss-dsi-h-sync-skew = <0>;
		qcom,mdss-dsi-v-back-porch = <20>;
		qcom,mdss-dsi-v-front-porch = <20>;
		qcom,mdss-dsi-v-pulse-width = <8>;
		qcom,mdss-dsi-h-left-border = <0>;
		qcom,mdss-dsi-h-right-border = <0>;
		qcom,mdss-dsi-v-top-border = <0>;
		qcom,mdss-dsi-v-bottom-border = <0>;
		qcom,mdss-dsi-bpp = <24>;
		qcom,mdss-dsi-color-order = "rgb_swap_rgb";
		qcom,mdss-dsi-underflow-color = <0xff>;
		qcom,mdss-dsi-border-color = <0>;
		qcom,mdss-dsi-on-command = [39 01 00 00 00 00 02 e0 00
39 01 00 00 00 00 02 e1 93
39 01 00 00 00 00 02 e2 65
39 01 00 00 00 00 02 e3 f8
39 01 00 00 00 00 02 e0 01
39 01 00 00 00 00 02 00 00
39 01 00 00 00 00 02 01 a0
39 01 00 00 00 00 02 03 00
39 01 00 00 00 00 02 04 ad
39 01 00 00 00 00 02 17 00
39 01 00 00 00 00 02 18 d7
39 01 00 00 00 00 02 19 00
39 01 00 00 00 00 02 1a 00
39 01 00 00 00 00 02 1b d7
39 01 00 00 00 00 02 1c 00
39 01 00 00 00 00 02 1f 6b
39 01 00 00 00 00 02 20 24
39 01 00 00 00 00 02 21 24
39 01 00 00 00 00 02 22 4e
39 01 00 00 00 00 02 25 20
39 01 00 00 00 00 02 37 09
39 01 00 00 00 00 02 38 04
39 01 00 00 00 00 02 39 08
39 01 00 00 00 00 02 3a 12
39 01 00 00 00 00 02 3c 6a
39 01 00 00 00 00 02 3d ff
39 01 00 00 00 00 02 3e ff
39 01 00 00 00 00 02 3f 6a
39 01 00 00 00 00 02 40 04
39 01 00 00 00 00 02 41 b4
39 01 00 00 00 00 02 42 70
39 01 00 00 00 00 02 43 12
39 01 00 00 00 00 02 44 0f
39 01 00 00 00 00 02 45 46
39 01 00 00 00 00 02 55 01
39 01 00 00 00 00 02 56 01
39 01 00 00 00 00 02 57 69
39 01 00 00 00 00 02 58 0a
39 01 00 00 00 00 02 59 0a
39 01 00 00 00 00 02 5a 29
39 01 00 00 00 00 02 5b 10
39 01 00 00 00 00 02 5d 6f
39 01 00 00 00 00 02 5e 58
39 01 00 00 00 00 02 5f 4a
39 01 00 00 00 00 02 60 3f
39 01 00 00 00 00 02 61 3d
39 01 00 00 00 00 02 62 30
39 01 00 00 00 00 02 63 37
39 01 00 00 00 00 02 64 23
39 01 00 00 00 00 02 65 3e
39 01 00 00 00 00 02 66 3e
39 01 00 00 00 00 02 67 3f
39 01 00 00 00 00 02 68 5d
39 01 00 00 00 00 02 69 4b
39 01 00 00 00 00 02 6a 52
39 01 00 00 00 00 02 6b 44
39 01 00 00 00 00 02 6c 3f
39 01 00 00 00 00 02 6d 32
39 01 00 00 00 00 02 6e 20
39 01 00 00 00 00 02 6f 10
39 01 00 00 00 00 02 70 6f
39 01 00 00 00 00 02 71 58
39 01 00 00 00 00 02 72 4a
39 01 00 00 00 00 02 73 3f
39 01 00 00 00 00 02 74 3d
39 01 00 00 00 00 02 75 30
39 01 00 00 00 00 02 76 37
39 01 00 00 00 00 02 77 23
39 01 00 00 00 00 02 78 3e
39 01 00 00 00 00 02 79 3e
39 01 00 00 00 00 02 7a 3f
39 01 00 00 00 00 02 7b 5d
39 01 00 00 00 00 02 7c 4b
39 01 00 00 00 00 02 7d 52
39 01 00 00 00 00 02 7e 44
39 01 00 00 00 00 02 7f 3f
39 01 00 00 00 00 02 80 32
39 01 00 00 00 00 02 81 20
39 01 00 00 00 00 02 82 10
39 01 00 00 00 00 02 e0 02
39 01 00 00 00 00 02 00 1e
39 01 00 00 00 00 02 01 1f
39 01 00 00 00 00 02 02 57
39 01 00 00 00 00 02 03 58
39 01 00 00 00 00 02 04 44
39 01 00 00 00 00 02 05 46
39 01 00 00 00 00 02 06 48
39 01 00 00 00 00 02 07 4a
39 01 00 00 00 00 02 08 40
39 01 00 00 00 00 02 09 1d
39 01 00 00 00 00 02 0a 1d
39 01 00 00 00 00 02 0b 1d
39 01 00 00 00 00 02 0c 1d
39 01 00 00 00 00 02 0d 1d
39 01 00 00 00 00 02 0e 1d
39 01 00 00 00 00 02 0f 50
39 01 00 00 00 00 02 10 1f
39 01 00 00 00 00 02 11 1f
39 01 00 00 00 00 02 12 1f
39 01 00 00 00 00 02 13 1f
39 01 00 00 00 00 02 14 1f
39 01 00 00 00 00 02 15 1f
39 01 00 00 00 00 02 16 1e
39 01 00 00 00 00 02 17 1f
39 01 00 00 00 00 02 18 57
39 01 00 00 00 00 02 19 58
39 01 00 00 00 00 02 1a 45
39 01 00 00 00 00 02 1b 47
39 01 00 00 00 00 02 1c 49
39 01 00 00 00 00 02 1d 4b
39 01 00 00 00 00 02 1e 41
39 01 00 00 00 00 02 1f 1d
39 01 00 00 00 00 02 20 1d
39 01 00 00 00 00 02 21 1d
39 01 00 00 00 00 02 22 1d
39 01 00 00 00 00 02 23 1d
39 01 00 00 00 00 02 24 1d
39 01 00 00 00 00 02 25 51
39 01 00 00 00 00 02 26 1f
39 01 00 00 00 00 02 27 1f
39 01 00 00 00 00 02 28 1f
39 01 00 00 00 00 02 29 1f
39 01 00 00 00 00 02 2a 1f
39 01 00 00 00 00 02 2b 1f
39 01 00 00 00 00 02 2c 1f
39 01 00 00 00 00 02 2d 1e
39 01 00 00 00 00 02 2e 17
39 01 00 00 00 00 02 2f 18
39 01 00 00 00 00 02 30 0b
39 01 00 00 00 00 02 31 09
39 01 00 00 00 00 02 32 07
39 01 00 00 00 00 02 33 05
39 01 00 00 00 00 02 34 11
39 01 00 00 00 00 02 35 1f
39 01 00 00 00 00 02 36 1f
39 01 00 00 00 00 02 37 1f
39 01 00 00 00 00 02 38 1f
39 01 00 00 00 00 02 39 1f
39 01 00 00 00 00 02 3a 1f
39 01 00 00 00 00 02 3b 01
39 01 00 00 00 00 02 3c 1f
39 01 00 00 00 00 02 3d 1f
39 01 00 00 00 00 02 3e 1f
39 01 00 00 00 00 02 3f 1f
39 01 00 00 00 00 02 40 1f
39 01 00 00 00 00 02 41 1f
39 01 00 00 00 00 02 42 1f
39 01 00 00 00 00 02 43 1e
39 01 00 00 00 00 02 44 17
39 01 00 00 00 00 02 45 18
39 01 00 00 00 00 02 46 0a
39 01 00 00 00 00 02 47 08
39 01 00 00 00 00 02 48 06
39 01 00 00 00 00 02 49 04
39 01 00 00 00 00 02 4a 10
39 01 00 00 00 00 02 4b 1f
39 01 00 00 00 00 02 4c 1f
39 01 00 00 00 00 02 4d 1f
39 01 00 00 00 00 02 4e 1f
39 01 00 00 00 00 02 4f 1f
39 01 00 00 00 00 02 50 1f
39 01 00 00 00 00 02 51 00
39 01 00 00 00 00 02 52 1f
39 01 00 00 00 00 02 53 1f
39 01 00 00 00 00 02 54 1f
39 01 00 00 00 00 02 55 1f
39 01 00 00 00 00 02 56 1f
39 01 00 00 00 00 02 57 1f
39 01 00 00 00 00 02 58 40
39 01 00 00 00 00 02 59 00
39 01 00 00 00 00 02 5a 00
39 01 00 00 00 00 02 5b 10
39 01 00 00 00 00 02 5c 0b
39 01 00 00 00 00 02 5d 30
39 01 00 00 00 00 02 5e 01
39 01 00 00 00 00 02 5f 02
39 01 00 00 00 00 02 60 30
39 01 00 00 00 00 02 61 03
39 01 00 00 00 00 02 62 04
39 01 00 00 00 00 02 63 1c
39 01 00 00 00 00 02 64 58
39 01 00 00 00 00 02 65 55
39 01 00 00 00 00 02 66 b0
39 01 00 00 00 00 02 67 73
39 01 00 00 00 00 02 68 0d
39 01 00 00 00 00 02 69 1c
39 01 00 00 00 00 02 6a 58
39 01 00 00 00 00 02 6b 00
39 01 00 00 00 00 02 6c 00
39 01 00 00 00 00 02 6d 00
39 01 00 00 00 00 02 6e 00
39 01 00 00 00 00 02 6f 08
39 01 00 00 00 00 02 70 00
39 01 00 00 00 00 02 71 00
39 01 00 00 00 00 02 72 06
39 01 00 00 00 00 02 73 7b
39 01 00 00 00 00 02 74 00
39 01 00 00 00 00 02 75 bc
39 01 00 00 00 00 02 76 00
39 01 00 00 00 00 02 77 0d
39 01 00 00 00 00 02 78 c1
39 01 00 00 00 00 02 79 00
39 01 00 00 00 00 02 7a 00
39 01 00 00 00 00 02 7b 00
39 01 00 00 00 00 02 7c 00
39 01 00 00 00 00 02 7d 03
39 01 00 00 00 00 02 7e 7b
39 01 00 00 00 00 02 e0 04
39 01 00 00 00 00 02 09 10
39 01 00 00 00 00 02 0e 4a
39 01 00 00 00 00 02 e0 03
39 01 00 00 00 00 02 9a 01
39 01 00 00 00 00 02 9b 04
39 01 00 00 00 00 02 e0 00
39 01 00 00 00 00 02 35 00
39 01 00 00 00 00 02 51 00
39 01 00 00 00 00 02 53 24
39 01 00 00 00 00 02 55 01
39 01 00 00 00 00 02 5e 02
05 01 00 00 78 00 02 11 00
05 01 00 00 14 00 02 29 00 ];
		qcom,mdss-dsi-off-command = [39 01 00 00 00 00 02 53 00
					05 01 00 00 32 00 02 28 00
					05 01 00 00 78 00 02 10 00];
		qcom,mdss-dsi-on-command-state = "dsi_lp_mode";
		qcom,mdss-dsi-off-command-state = "dsi_hs_mode";
		zte,mdss-dsi-cabc-default-value = <0x01>;
		zte,mdss-dsi-cabc-off-command = [39 01 00 00 00 00 02 55 00
		];
		zte,mdss-dsi-cabc-low-command = [39 01 00 00 00 00 02 55 01
		];
		zte,mdss-dsi-cabc-medium-command = [39 01 00 00 00 00 02 55 02
		];
		zte,mdss-dsi-cabc-high-command = [39 01 00 00 00 00 02 55 03
		];
		zte,mdss-dsi-cabc-command-state = "dsi_lp_mode";
		qcom,mdss-dsi-lp11-init;
		qcom,mdss-dsi-h-sync-pulse = <1>;
		qcom,mdss-dsi-traffic-mode = "burst_mode";
		qcom,mdss-dsi-lane-map = "lane_map_0123";
		qcom,mdss-dsi-bllp-eof-power-mode;
		qcom,mdss-dsi-bllp-power-mode;
		qcom,mdss-dsi-lane-0-state;
		qcom,mdss-dsi-lane-1-state;
		qcom,mdss-dsi-lane-2-state;
		qcom,mdss-dsi-lane-3-state;
		qcom,mdss-dsi-panel-timings = [8B 1E 14 00 44 48 18 22 19 03 04 00];
		qcom,mdss-dsi-t-clk-post = <0x04>;
		qcom,mdss-dsi-t-clk-pre = <0x1C>;
		qcom,mdss-dsi-bl-min-level = <2>;
		qcom,mdss-dsi-bl-max-level = <255>;
		qcom,mdss-dsi-dma-trigger = "trigger_sw";
		qcom,mdss-dsi-mdp-trigger = "none";
		qcom,mdss-dsi-bl-pmic-control-type = "bl_ctrl_dcs";
		qcom,mdss-dsi-reset-sequence = <1 5>, <0 2>, <1 20>;
		qcom,mdss-pan-physical-width-dimension = <62>;
		qcom,mdss-pan-physical-height-dimension = <124>;
		zte,lcm_backlight_curve_mode = "lcd_brightness_max_350_lux";
		qcom,mdss-dsi-tx-eot-append;
		qcom,esd-check-enabled;
		qcom,mdss-dsi-panel-status-command=[06 01 00 01 05 00 01 0a
						06 01 00 01 05 00 01 0e
						06 01 00 01 05 00 01 0c];
		qcom,mdss-dsi-panel-status-command-state="dsi_lp_mode";
		qcom,mdss-dsi-panel-status-check-mode="reg_read";
		qcom,mdss-dsi-panel-status-value=<0x1C 0x80 0x70>;
		qcom,mdss-dsi-panel-status-read-length = <1 1 1>;
		qcom,mdss-dsi-panel-status-valid-params = <1 1 1>;
		qcom,mdss-dsi-panel-max-error-count = <3>;
	};
};
