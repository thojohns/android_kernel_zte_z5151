/* Copyright (c) 2013, The Linux Foundation. All rights reserved.
 *
 * This program is free software; you can redistribute it and/or modify
 * it under the terms of the GNU General Public License version 2 and
 * only version 2 as published by the Free Software Foundation.
 *
 * This program is distributed in the hope that it will be useful,
 * but WITHOUT ANY WARRANTY; without even the implied warranty of
 * MERCHANTABILITY or FITNESS FOR A PARTICULAR PURPOSE.  See the
 * GNU General Public License for more details.
 */

/*---------------------------------------------------------------------------
 * This file is autogenerated file using gcdb parser. Please do not edit it.
 * Update input XML file to add a new entry or update variable in this file
 * VERSION = "1.0"
 *---------------------------------------------------------------------------*/
&mdss_mdp {
	dsi_dijing_panda_ili9881p_720p_video: qcom,mdss_dsi_dijing_panda_ili9881p_720p_video {
		qcom,mdss-dsi-panel-name = "dijing panda ili9881p 720p video mode dsi panel";
		zte,lcd-init-code-version = "20180329";
		qcom,cont-splash-enabled;
		zte,lcd_bl_vsp_vsn_voltage = <0xf>;
		qcom,panel-supply-entries = <&dsi_panel_pwr_supply>;
		qcom,mdss-dsi-panel-controller = <&mdss_dsi0>;
		qcom,mdss-dsi-panel-type = "dsi_video_mode";
		qcom,mdss-dsi-panel-destination = "display_1";
		qcom,mdss-dsi-panel-framerate = <60>;
		/*qcom,mdss-dsi-panel-clockrate = <866400000>;*/
		qcom,mdss-dsi-virtual-channel-id = <0>;
		qcom,mdss-dsi-stream = <0>;
		qcom,mdss-dsi-panel-width = <720>;
		qcom,mdss-dsi-panel-height = <1440>;
		qcom,mdss-dsi-h-front-porch = <100>;
		qcom,mdss-dsi-h-back-porch = <96>;
		qcom,mdss-dsi-h-pulse-width = <8>;
		qcom,mdss-dsi-h-sync-skew = <0>;
		qcom,mdss-dsi-v-back-porch = <20>;
		qcom,mdss-dsi-v-front-porch = <20>;
		qcom,mdss-dsi-v-pulse-width = <8>;
		qcom,mdss-dsi-h-left-border = <0>;
		qcom,mdss-dsi-h-right-border = <0>;
		qcom,mdss-dsi-v-top-border = <0>;
		qcom,mdss-dsi-v-bottom-border = <0>;
		qcom,mdss-dsi-bpp = <24>;
		qcom,mdss-dsi-color-order = "rgb_swap_rgb";
		qcom,mdss-dsi-underflow-color = <0xff>;
		qcom,mdss-dsi-border-color = <0>;
		qcom,mdss-dsi-on-command = [39 01 00 00 00 00 04 ff 98 81 05
39 01 00 00 00 00 02 b2 70
39 01 00 00 00 00 02 03 00
39 01 00 00 00 00 02 04 24
39 01 00 00 00 00 02 30 f7
39 01 00 00 00 00 02 38 a8
39 01 00 00 00 00 02 1a 50
39 01 00 00 00 00 02 52 5f
39 01 00 00 00 00 02 54 28
39 01 00 00 00 00 02 55 25
39 01 00 00 00 00 02 26 02
39 01 00 00 00 00 02 3d a1
39 01 00 00 00 00 02 1b 01
39 01 00 00 00 00 04 ff 98 81 02
39 01 00 00 00 00 02 06 20
39 01 00 00 00 00 02 07 00
39 01 00 00 00 00 02 42 2f
39 01 00 00 00 00 02 01 50
39 01 00 00 00 00 02 15 10
39 01 00 00 00 00 02 57 00
39 01 00 00 00 00 02 58 1d
39 01 00 00 00 00 02 59 2b
39 01 00 00 00 00 02 5a 15
39 01 00 00 00 00 02 5b 19
39 01 00 00 00 00 02 5c 2b
39 01 00 00 00 00 02 5d 1e
39 01 00 00 00 00 02 5e 1f
39 01 00 00 00 00 02 5f 92
39 01 00 00 00 00 02 60 1d
39 01 00 00 00 00 02 61 2a
39 01 00 00 00 00 02 62 7b
39 01 00 00 00 00 02 63 19
39 01 00 00 00 00 02 64 16
39 01 00 00 00 00 02 65 4a
39 01 00 00 00 00 02 66 20
39 01 00 00 00 00 02 67 27
39 01 00 00 00 00 02 68 49
39 01 00 00 00 00 02 69 57
39 01 00 00 00 00 02 6a 25
39 01 00 00 00 00 02 6b 00
39 01 00 00 00 00 02 6c 1d
39 01 00 00 00 00 02 6d 2b
39 01 00 00 00 00 02 6e 15
39 01 00 00 00 00 02 6f 19
39 01 00 00 00 00 02 70 2b
39 01 00 00 00 00 02 71 1e
39 01 00 00 00 00 02 72 1f
39 01 00 00 00 00 02 73 92
39 01 00 00 00 00 02 74 1d
39 01 00 00 00 00 02 75 2a
39 01 00 00 00 00 02 76 7b
39 01 00 00 00 00 02 77 19
39 01 00 00 00 00 02 78 16
39 01 00 00 00 00 02 79 4a
39 01 00 00 00 00 02 7a 20
39 01 00 00 00 00 02 7b 27
39 01 00 00 00 00 02 7c 49
39 01 00 00 00 00 02 7d 57
39 01 00 00 00 00 02 7e 25
39 01 00 00 00 00 04 ff 98 81 01
39 01 00 00 00 00 02 01 00
39 01 00 00 00 00 02 02 00
39 01 00 00 00 00 02 03 56
39 01 00 00 00 00 02 04 13
39 01 00 00 00 00 02 05 13
39 01 00 00 00 00 02 06 0a
39 01 00 00 00 00 02 07 05
39 01 00 00 00 00 02 08 05
39 01 00 00 00 00 02 09 1d
39 01 00 00 00 00 02 0a 01
39 01 00 00 00 00 02 0b 00
39 01 00 00 00 00 02 0c 3f
39 01 00 00 00 00 02 0d 29
39 01 00 00 00 00 02 0e 29
39 01 00 00 00 00 02 0f 1d
39 01 00 00 00 00 02 10 1d
39 01 00 00 00 00 02 11 00
39 01 00 00 00 00 02 12 00
39 01 00 00 00 00 02 13 08
39 01 00 00 00 00 02 14 08
39 01 00 00 00 00 02 15 00
39 01 00 00 00 00 02 16 00
39 01 00 00 00 00 02 17 00
39 01 00 00 00 00 02 18 00
39 01 00 00 00 00 02 19 00
39 01 00 00 00 00 02 1a 00
39 01 00 00 00 00 02 1b 00
39 01 00 00 00 00 02 1c 00
39 01 00 00 00 00 02 1d 00
39 01 00 00 00 00 02 1e 40
39 01 00 00 00 00 02 1f 88
39 01 00 00 00 00 02 20 08
39 01 00 00 00 00 02 21 01
39 01 00 00 00 00 02 22 00
39 01 00 00 00 00 02 23 00
39 01 00 00 00 00 02 24 00
39 01 00 00 00 00 02 25 00
39 01 00 00 00 00 02 26 00
39 01 00 00 00 00 02 27 00
39 01 00 00 00 00 02 28 33
39 01 00 00 00 00 02 29 03
39 01 00 00 00 00 02 2a 00
39 01 00 00 00 00 02 2b 00
39 01 00 00 00 00 02 2c 00
39 01 00 00 00 00 02 2d 00
39 01 00 00 00 00 02 2e 00
39 01 00 00 00 00 02 2f 00
39 01 00 00 00 00 02 30 00
39 01 00 00 00 00 02 31 00
39 01 00 00 00 00 02 32 00
39 01 00 00 00 00 02 33 00
39 01 00 00 00 00 02 34 00
39 01 00 00 00 00 02 35 00
39 01 00 00 00 00 02 36 00
39 01 00 00 00 00 02 37 00
39 01 00 00 00 00 02 38 00
39 01 00 00 00 00 02 39 0f
39 01 00 00 00 00 02 3a 2a
39 01 00 00 00 00 02 3b c0
39 01 00 00 00 00 02 3c 00
39 01 00 00 00 00 02 3d 00
39 01 00 00 00 00 02 3e 00
39 01 00 00 00 00 02 3f 00
39 01 00 00 00 00 02 40 00
39 01 00 00 00 00 02 41 e0
39 01 00 00 00 00 02 42 40
39 01 00 00 00 00 02 43 0f
39 01 00 00 00 00 02 44 31
39 01 00 00 00 00 02 45 a8
39 01 00 00 00 00 02 46 00
39 01 00 00 00 00 02 47 08
39 01 00 00 00 00 02 48 00
39 01 00 00 00 00 02 49 00
39 01 00 00 00 00 02 4a 00
39 01 00 00 00 00 02 4b 00
39 01 00 00 00 00 02 4c b2
39 01 00 00 00 00 02 4d 22
39 01 00 00 00 00 02 4e 01
39 01 00 00 00 00 02 4f f7
39 01 00 00 00 00 02 50 29
39 01 00 00 00 00 02 51 72
39 01 00 00 00 00 02 52 25
39 01 00 00 00 00 02 53 b2
39 01 00 00 00 00 02 54 22
39 01 00 00 00 00 02 55 22
39 01 00 00 00 00 02 56 22
39 01 00 00 00 00 02 57 a2
39 01 00 00 00 00 02 58 22
39 01 00 00 00 00 02 59 01
39 01 00 00 00 00 02 5a e6
39 01 00 00 00 00 02 5b 28
39 01 00 00 00 00 02 5c 62
39 01 00 00 00 00 02 5d 24
39 01 00 00 00 00 02 5e a2
39 01 00 00 00 00 02 5f 22
39 01 00 00 00 00 02 60 22
39 01 00 00 00 00 02 61 22
39 01 00 00 00 00 02 62 ee
39 01 00 00 00 00 02 63 02
39 01 00 00 00 00 02 64 0b
39 01 00 00 00 00 02 65 02
39 01 00 00 00 00 02 66 02
39 01 00 00 00 00 02 67 01
39 01 00 00 00 00 02 68 00
39 01 00 00 00 00 02 69 0f
39 01 00 00 00 00 02 6a 07
39 01 00 00 00 00 02 6b 55
39 01 00 00 00 00 02 6c 02
39 01 00 00 00 00 02 6d 02
39 01 00 00 00 00 02 6e 5b
39 01 00 00 00 00 02 6f 59
39 01 00 00 00 00 02 70 02
39 01 00 00 00 00 02 71 02
39 01 00 00 00 00 02 72 57
39 01 00 00 00 00 02 73 02
39 01 00 00 00 00 02 74 02
39 01 00 00 00 00 02 75 02
39 01 00 00 00 00 02 76 02
39 01 00 00 00 00 02 77 02
39 01 00 00 00 00 02 78 02
39 01 00 00 00 00 02 79 02
39 01 00 00 00 00 02 7a 0a
39 01 00 00 00 00 02 7b 02
39 01 00 00 00 00 02 7c 02
39 01 00 00 00 00 02 7d 01
39 01 00 00 00 00 02 7e 00
39 01 00 00 00 00 02 7f 0e
39 01 00 00 00 00 02 80 06
39 01 00 00 00 00 02 81 54
39 01 00 00 00 00 02 82 02
39 01 00 00 00 00 02 83 02
39 01 00 00 00 00 02 84 5a
39 01 00 00 00 00 02 85 58
39 01 00 00 00 00 02 86 02
39 01 00 00 00 00 02 87 02
39 01 00 00 00 00 02 88 56
39 01 00 00 00 00 02 89 02
39 01 00 00 00 00 02 8a 02
39 01 00 00 00 00 02 8b 02
39 01 00 00 00 00 02 8c 02
39 01 00 00 00 00 02 8d 02
39 01 00 00 00 00 02 8e 02
39 01 00 00 00 00 02 8f 44
39 01 00 00 00 00 02 90 44
39 01 00 00 00 00 04 ff 98 81 06
39 01 00 00 00 00 02 01 03
39 01 00 00 00 00 02 2b 0a
39 01 00 00 00 00 02 c0 cf
39 01 00 00 00 00 02 c1 2a
39 01 00 00 00 00 04 ff 98 81 03
39 01 00 00 00 00 02 83 40
39 01 00 00 00 00 02 84 00
39 01 00 00 00 00 04 ff 98 81 00
39 01 00 00 00 00 02 35 00
39 01 00 00 00 00 03 68 04 00
39 01 00 00 00 00 03 51 00 00
39 01 00 00 00 00 02 53 24
39 01 00 00 00 00 02 55 01
39 01 00 00 00 00 03 5e 00 10
05 01 00 00 78 00 02 11 00
05 01 00 00 14 00 02 29 00];
		qcom,mdss-dsi-off-command = [39 01 00 00 00 00 02 53 00
05 01 00 00 32 00 02 28 00
					05 01 00 00 78 00 02 10 00];
		qcom,mdss-dsi-on-command-state = "dsi_lp_mode";
		qcom,mdss-dsi-off-command-state = "dsi_hs_mode";
		zte,mdss-dsi-cabc-default-value = <0x01>;
		zte,mdss-dsi-cabc-off-command = [39 01 00 00 00 00 02 55 00
		];
		zte,mdss-dsi-cabc-low-command = [39 01 00 00 00 00 02 55 01
		];
		zte,mdss-dsi-cabc-medium-command = [39 01 00 00 00 00 02 55 02
		];
		zte,mdss-dsi-cabc-high-command = [39 01 00 00 00 00 02 55 03
		];
		zte,mdss-dsi-cabc-command-state = "dsi_lp_mode";
		qcom,mdss-dsi-lp11-init;
		qcom,mdss-dsi-h-sync-pulse = <1>;
		qcom,mdss-dsi-traffic-mode = "burst_mode";
		qcom,mdss-dsi-lane-map = "lane_map_0123";
		qcom,mdss-dsi-bllp-eof-power-mode;
		qcom,mdss-dsi-bllp-power-mode;
		qcom,mdss-dsi-lane-0-state;
		qcom,mdss-dsi-lane-1-state;
		qcom,mdss-dsi-lane-2-state;
		qcom,mdss-dsi-lane-3-state;
		qcom,mdss-dsi-panel-timings = [8B 1E 14 00 44 48 18 22 19 03 04 00];
		qcom,mdss-dsi-t-clk-post = <0x04>;
		qcom,mdss-dsi-t-clk-pre = <0x1C>;
		qcom,mdss-dsi-bl-min-level = <1>;
		qcom,mdss-dsi-bl-max-level = <4095>;
		qcom,mdss-dsi-dma-trigger = "trigger_sw";
		qcom,mdss-dsi-mdp-trigger = "none";
		qcom,mdss-dsi-bl-pmic-control-type = "bl_ctrl_dcs";
		qcom,mdss-dsi-reset-sequence = <1 5>, <0 2>, <1 20>;
		qcom,mdss-pan-physical-width-dimension = <62>;
		qcom,mdss-pan-physical-height-dimension = <124>;
		zte,lcm_backlight_curve_mode = "lcd_brightness_max_350_lux";
		qcom,mdss-dsi-tx-eot-append;
		//qcom,esd-check-enabled;
		qcom,mdss-dsi-panel-status-command=[06 01 00 01 05 00 02 0A 00
						06 01 00 01 05 00 02 0E 00];
		qcom,mdss-dsi-panel-status-command-state="dsi_lp_mode";
		qcom,mdss-dsi-panel-status-check-mode="reg_read";
		qcom,mdss-dsi-panel-status-value=<0x9C 0x80>;
		qcom,mdss-dsi-panel-status-read-length = <1 1>;
	};
};
