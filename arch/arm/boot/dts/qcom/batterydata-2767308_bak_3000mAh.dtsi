
qcom,2767308_bak_3000mAh {
	/* #2767308_bak_3000mAh*/
	qcom,max-voltage-uv = <4400000>;
	qcom,nom-batt-capacity-mah = <3000>;
	qcom,batt-id-kohm = <82>;
	qcom,battery-beta = <4050>;
	qcom,battery-type = "2767308_bak_3000mAh";
	qcom,chg-rslow-comp-c1 = <4403409>;
	qcom,chg-rslow-comp-c2 = <7963136>;
	qcom,chg-rs-to-rslow = <873184>;
	qcom,chg-rslow-comp-thr = <0xB8>;
	qcom,fastchg-current-ma = <1600>;
	qcom,checksum = <0x36D8>;
	qcom,gui-version = "PMI8950GUI - 2.0.0.16";
	qcom,fg-profile-data = [
		 DE 83 B4 7C
		 F6 80 F7 76
		 56 83 41 5F
		 E3 82 23 8E
		 A2 82 44 92
		 84 B4 61 C0
		 58 17 ED 83
		 B9 7C DC 80
		 9A 76 5A 83
		 73 60 88 81
		 FD 8D 59 82
		 8D 99 EE BC
		 E9 C9 54 0E
		 1B 0C 6E 5B
		 14 70 B2 FD
		 E5 34 63 45
		 93 41 00 00
		 36 4C 74 32
		 5F 40 00 00
		 00 00 00 00
		 00 00 00 00
		 73 6B 3D 69
		 6E 5E DB 8A
		 14 7D 4E 72
		 0F 5D 68 81
		 96 76 AF 6A
		 62 74 D1 A8
		 26 8A 69 04
		 67 A0 71 0C
		 28 00 FF 36
		 F0 11 30 03
		 00 00 00 0C
	];
};
