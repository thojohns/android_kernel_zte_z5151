/*****************************************************************************
* Copyright 2010 Texas Instruments Corporation, All Rights Reserved.
* TI makes NO WARRANTY as to software products, which are supplied "AS-IS"
*****************************************************************************/

/*****************************************************************************
*     This code is automatically generated from bqfs/dffs file.              *
*          DO NOT MODIFY THIS FILE DIRECTLY                                  *
*****************************************************************************/

/*this file is generated from Learned.gm.fs at Wed Feb 28 10:58:03 2018*/

batterydata-ti-450-18-390k-4000mah-tianmao {
	bq27x00,battery-id-kohm = <390>;    /* kohm Rbatt_id = 10, Rpullup = 100(100k) */
	bq27x00,battery-full-design = <4000000>;    /* uAh */
	bq27x00,fg-profile-data = [
		06 02 AA 00 01 00
		06 03 AA 00 26 04
		06 02 AA 00 02 00
		06 03 AA 00 02 02
		06 02 AA 00 13 00
		04 04 4C 04
		06 02 AA 3E 02 00
		24 02 AA 40 02 26 00 00 32 00 00 00 00 00 00 00 00 00 00 00
		00 00 00 00 00 00 00 00 00 00 00 00 00 00 00 00
		05 02 AA 60 A5
		04 04 0A 00
		06 02 AA 3E 02 00
		05 03 AA 60 A5
		06 02 AA 3E 24 00
		24 02 AA 40 00 19 28 63 5F FF 62 00 32 00 00 00 00 00 00 00
		00 00 00 00 00 00 00 00 00 00 00 00 00 00 00 00
		05 02 AA 60 69
		04 04 0A 00
		06 02 AA 3E 24 00
		05 03 AA 60 69
		06 02 AA 3E 31 00
		24 02 AA 40 0A 0F 02 05 00 00 00 00 00 00 00 00 00 00 00 00
		00 00 00 00 00 00 00 00 00 00 00 00 00 00 00 00
		05 02 AA 60 DF
		04 04 0A 00
		06 02 AA 3E 31 00
		05 03 AA 60 DF
		06 02 AA 3E 40 00
		24 02 AA 40 64 79 0F 86 23 00 00 14 04 00 09 04 26 00 00 00
		00 00 00 00 00 00 00 00 00 00 00 00 00 00 00 00
		05 02 AA 60 1F
		04 04 0A 00
		06 02 AA 3E 40 00
		05 03 AA 60 1F
		06 02 AA 3E 44 00
		24 02 AA 40 00 32 01 C2 30 00 03 08 98 01 00 3C 01 00 00 00
		00 00 00 00 00 00 00 00 00 00 00 00 00 00 00 00
		05 02 AA 60 F9
		04 04 0A 00
		06 02 AA 3E 44 00
		05 03 AA 60 F9
		06 02 AA 3E 50 00
		24 02 AA 40 01 F4 00 1E C8 14 08 00 3C 0E 10 00 0A 46 05 14
		05 0F 03 20 7F FF 00 F0 46 50 18 01 90 00 64 19
		05 02 AA 60 E4
		04 04 0A 00
		06 02 AA 3E 50 00
		05 03 AA 60 E4
		06 02 AA 3E 50 01
		24 02 AA 40 DC 5C 60 00 7D 00 04 03 19 25 0F 14 0A 78 60 28
		01 F4 00 00 00 00 43 80 04 01 14 00 08 0B B8 01
		05 02 AA 60 DB
		04 04 0A 00
		06 02 AA 3E 50 01
		05 03 AA 60 DB
		06 02 AA 3E 50 02
		24 02 AA 40 2C 0A 01 0A 00 00 00 C8 00 64 02 00 00 00 00 07
		D0 01 03 5A 14 00 00 00 00 00 00 00 00 00 00 00
		05 02 AA 60 47
		04 04 0A 00
		06 02 AA 3E 50 02
		05 03 AA 60 47
		06 02 AA 3E 51 00
		24 02 AA 40 01 90 01 F4 07 D0 00 3C 3C 01 B3 B3 01 90 00 00
		00 00 00 00 00 00 00 00 00 00 00 00 00 00 00 00
		05 02 AA 60 32
		04 04 0A 00
		06 02 AA 3E 51 00
		05 03 AA 60 32
		06 02 AA 3E 52 00
		24 02 AA 40 42 B8 00 00 00 81 0F A0 3B B0 0D 48 00 C8 00 32
		00 14 03 E8 01 00 E4 00 0A FF CE FF CD 00 02 00
		05 02 AA 60 12
		04 04 0A 00
		06 02 AA 3E 52 00
		05 03 AA 60 12
		06 02 AA 3E 53 00
		24 02 AA 40 18 79 11 23 D8 D9 DE DE E1 E1 E3 E3 E6 E4 E2 E6
		E7 EC E9 E7 EA E3 F1 F1 F5 F5 F8 F9 FB FB FC FB
		05 02 AA 60 99
		04 04 0A 00
		06 02 AA 3E 53 00
		05 03 AA 60 99
		06 02 AA 3E 53 01
		24 02 AA 40 F7 F8 F8 F2 F3 EB F7 FC F9 DF 80 00 00 00 00 00
		00 00 00 00 00 00 00 00 00 00 00 00 00 00 00 00
		05 02 AA 60 FD
		04 04 0A 00
		06 02 AA 3E 53 01
		05 03 AA 60 FD
		06 02 AA 3E 54 00
		24 02 AA 40 FF 0A 04 2D 2D 16 16 04 09 FA 04 EB 0D 20 00 FD
		FF 0B FE F9 DC EE F8 F3 F9 F1 EC ED EA EE E9 D9
		05 02 AA 60 39
		04 04 0A 00
		06 02 AA 3E 54 00
		05 03 AA 60 39
		06 02 AA 3E 54 01
		24 02 AA 40 F2 FE 03 FF FA 1E 0B 0E A2 80 00 00 00 00 00 00
		00 00 00 00 00 00 00 00 00 00 00 00 00 00 00 00
		05 02 AA 60 BA
		04 04 0A 00
		06 02 AA 3E 54 01
		05 03 AA 60 BA
		06 02 AA 3E 55 00
		24 02 AA 40 FF 1D 00 10 08 19 08 0A 05 F8 FF FA 05 07 FB EE
		61 00 00 00 00 00 00 00 00 00 00 00 00 00 00 00
		05 02 AA 60 54
		04 04 0A 00
		06 02 AA 3E 55 00
		05 03 AA 60 54
		06 02 AA 3E 6C 00
		24 02 AA 40 FE 5D 00 17 0F 22 FE D0 0D C0 F9 1D B4 E6 D8 DF
		B0 00 00 00 00 00 00 00 00 00 00 00 00 00 00 00
		05 02 AA 60 AA
		04 04 0A 00
		06 02 AA 3E 6C 00
		05 03 AA 60 AA
		06 02 AA 3E 59 00
		24 02 AA 40 00 53 00 38 00 37 00 3B 00 37 00 2D 00 34 00 2F
		00 34 00 36 00 37 00 3D 00 51 00 58 00 77 00 00
		05 02 AA 60 3D
		04 04 0A 00
		06 02 AA 3E 59 00
		05 03 AA 60 3D
		06 02 AA 3E 6D 00
		24 02 AA 40 10 2A 0E E2 0E B0 11 22 10 9A 00 00 00 00 00 00
		00 00 00 00 00 00 00 00 00 00 00 00 00 00 00 00
		05 02 AA 60 3A
		04 04 0A 00
		06 02 AA 3E 6D 00
		05 03 AA 60 3A
		06 02 AA 3E 68 00
		24 02 AA 40 06 00 00 00 B7 15 F8 80 CB 4F 7E 8D 02 1B C8 CE
		7E 48 99 B3 28 8C 2D B7 00 00 00 00 CB D4 1A 05
		05 02 AA 60 75
		04 04 0A 00
		06 02 AA 3E 68 00
		05 03 AA 60 75
		06 02 AA 3E 68 01
		24 02 AA 40 1C 98 02 D3 FF B9 30 EF 05 11 05 01 00 00 10 01
		00 3C 00 50 3C 00 64 3C 00 20 00 00 00 00 00 00
		05 02 AA 60 EA
		04 04 0A 00
		06 02 AA 3E 68 01
		05 03 AA 60 EA
		06 02 AA 3E 69 00
		24 02 AA 40 00 00 0B D6 7E 73 B6 45 93 0A A5 22 00 00 00 00
		00 00 00 00 00 00 00 00 00 00 00 00 00 00 00 00
		05 02 AA 60 CE
		04 04 0A 00
		06 02 AA 3E 69 00
		05 03 AA 60 CE
		06 02 AA 3E 6B 00
		24 02 AA 40 EF 05 11 05 01 00 00 10 01 00 3C 00 50 3C 00 64
		3C 00 20 00 00 00 00 00 00 00 00 00 00 00 00 00
		05 02 AA 60 5B
		04 04 0A 00
		06 02 AA 3E 6B 00
		05 03 AA 60 5B
		06 02 AA 3E 70 00
		24 02 AA 40 80 00 80 00 00 00 00 00 00 00 00 00 00 00 00 00
		00 00 00 00 00 00 00 00 00 00 00 00 00 00 00 00
		05 02 AA 60 FF
		04 04 0A 00
		06 02 AA 3E 70 00
		05 03 AA 60 FF
		06 02 AA 00 00 00
		06 02 AA 00 42 00
		04 04 D0 07
	];
};
