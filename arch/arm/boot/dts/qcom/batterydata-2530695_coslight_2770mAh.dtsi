
qcom,2530695_coslight_2770mAh {
	/* #2530695_coslight_2770mAh*/
	qcom,max-voltage-uv = <4440000>;
	qcom,nom-batt-capacity-mah = <2730>;
	qcom,batt-id-kohm = <20>;
	qcom,battery-beta = <4050>;
	qcom,battery-type = "2530695_coslight_2770mAh";
	qcom,chg-rslow-comp-c1 = <4428773>;
	qcom,chg-rslow-comp-c2 = <7854666>;
	qcom,chg-rs-to-rslow = <1183723>;
	qcom,chg-rslow-comp-thr = <0xB7>;
	qcom,fastchg-current-ma = <1600>;
	qcom,fg-cc-cv-threshold-mv = <4430>;
	qcom,checksum = <0x93EF>;
	qcom,gui-version = "PMI8950GUI - 2.0.0.16";
	qcom,fg-profile-data = [
		 03 88 5A 7E
		 76 82 F6 7C
		 5A 83 64 66
		 F6 82 87 8D
		 11 82 6D 9A
		 6E BD 43 CA
		 5C 0E 09 88
		 5F 7E 5F 82
		 D0 7C 4C 83
		 F7 70 A5 63
		 68 7F 49 82
		 BE 99 FE BC
		 DF C9 58 0C
		 20 0B E7 5B
		 18 71 D9 FD
		 BC 40 4D 45
		 06 45 00 00
		 DB 47 53 45
		 3A 4A 00 00
		 00 00 00 00
		 00 00 00 00
		 18 70 77 6A
		 27 51 27 89
		 17 77 03 70
		 BB 61 DA 82
		 C7 74 0E 68
		 AE 66 66 B0
		 1E 93 63 63
		 65 A0 71 0C
		 28 00 FF 36
		 F0 11 30 03
		 00 00 00 0C
	];
};
