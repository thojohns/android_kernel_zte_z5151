
qcom,zte_p840t21_4080mah {
	/* #2828318_ZTE_P840T21_4080mAh_averaged_MasterSlave_Mar6th2017*/
	qcom,max-voltage-uv = <4400000>;
	qcom,nom-batt-capacity-mah = <4080>;
	qcom,batt-id-kohm = <20>;
	qcom,battery-beta = <3435>;
	qcom,battery-type = "ZTE_BATTERY_DATA_ID_1";
	qcom,chg-rslow-comp-c1 = <3554026>;
	qcom,chg-rslow-comp-c2 = <5775348>;
	qcom,chg-rs-to-rslow = <702145>;
	qcom,chg-rslow-comp-thr = <0xB1>;
	qcom,checksum = <0x9103>;
	qcom,gui-version = "PMI8950GUI - 2.0.0.16";
	qcom,fg-profile-data = [
		 F2 83 7F 7D
		 93 81 0C 7C
		 61 83 CD 6E
		 7C 88 06 8F
		 F9 81 8F 9A
		 36 BD 9A C9
		 5A 0F EE 83
		 FE 7C 26 81
		 38 77 58 83
		 D9 60 28 81
		 A1 8D 4F 82
		 9B 99 E1 BC
		 BE C9 54 0E
		 5E 10 45 59
		 14 70 E0 FC
		 02 45 F5 37
		 C6 3A 00 00
		 17 44 27 29
		 76 3D 00 00
		 00 00 00 00
		 00 00 00 00
		 A6 69 D4 68
		 BB 5B 10 81
		 4A 6E AC 61
		 B0 6A ED 80
		 C7 6D FF 61
		 3D 6E 48 A0
		 18 9B 60 F6
		 5D A0 71 0C
		 28 00 FF 36
		 F0 11 30 03
		 00 00 00 0C
	];
};
