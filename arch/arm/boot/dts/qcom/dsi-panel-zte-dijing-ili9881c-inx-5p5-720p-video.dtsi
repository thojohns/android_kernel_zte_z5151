/* Copyright (c) 2013, The Linux Foundation. All rights reserved.
 *
 * This program is free software; you can redistribute it and/or modify
 * it under the terms of the GNU General Public License version 2 and
 * only version 2 as published by the Free Software Foundation.
 *
 * This program is distributed in the hope that it will be useful,
 * but WITHOUT ANY WARRANTY; without even the implied warranty of
 * MERCHANTABILITY or FITNESS FOR A PARTICULAR PURPOSE.  See the
 * GNU General Public License for more details.
 */

/*---------------------------------------------------------------------------
 * This file is autogenerated file using gcdb parser. Please do not edit it.
 * Update input XML file to add a new entry or update variable in this file
 * VERSION = "1.0"
 *---------------------------------------------------------------------------*/
&mdss_mdp {
	dsi_ili9881c_dijing_720p_video: qcom,mdss_dsi_ili9881c_dijing_720p_video {
		qcom,mdss-dsi-panel-name = "zteDIJING_ILI9881C_INX_720_1280_5P5Inch";
		zte,lcd-proc-panel-name = "IC:ILI9881C; Vendor:DIJING; Resolution:720*1280";
		zte,lcm_reset_pin_keep_high_sleeping;
		qcom,cont-splash-enabled;
		qcom,panel-supply-entries = <&dsi_panel_pwr_supply>;
		qcom,mdss-dsi-panel-controller = <&mdss_dsi0>;
		qcom,mdss-dsi-panel-type = "dsi_video_mode";
		qcom,mdss-dsi-panel-destination = "display_1";
		qcom,mdss-dsi-panel-framerate = <60>;
		qcom,mdss-dsi-virtual-channel-id = <0>;
		qcom,mdss-dsi-stream = <0>;
		qcom,mdss-dsi-panel-width = <720>;
		qcom,mdss-dsi-panel-height = <1280>;
		qcom,mdss-dsi-h-front-porch = <48>;
		qcom,mdss-dsi-h-back-porch = <90>;
		qcom,mdss-dsi-h-pulse-width = <18>;
		qcom,mdss-dsi-h-sync-skew = <0>;
		qcom,mdss-dsi-v-back-porch = <20>;
		qcom,mdss-dsi-v-front-porch = <16>;
		qcom,mdss-dsi-v-pulse-width = <8>;
		qcom,mdss-dsi-h-left-border = <0>;
		qcom,mdss-dsi-h-right-border = <0>;
		qcom,mdss-dsi-v-top-border = <0>;
		qcom,mdss-dsi-v-bottom-border = <0>;
		qcom,mdss-dsi-bpp = <24>;
		qcom,mdss-dsi-color-order = "rgb_swap_rgb";
		qcom,mdss-dsi-underflow-color = <0xff>;
		qcom,mdss-dsi-border-color = <0>;
		qcom,mdss-dsi-on-command = [39 01 00 00 00 00 04 FF 98 81 03
			39 01 00 00 00 00 02 01 00
			39 01 00 00 00 00 02 02 00
			39 01 00 00 00 00 02 03 53
			39 01 00 00 00 00 02 04 53
			39 01 00 00 00 00 02 05 13
			39 01 00 00 00 00 02 06 04
			39 01 00 00 00 00 02 07 02
			39 01 00 00 00 00 02 08 02
			39 01 00 00 00 00 02 09 04
			39 01 00 00 00 00 02 0a 03
			39 01 00 00 00 00 02 0b 03
			39 01 00 00 00 00 02 0c 00
			39 01 00 00 00 00 02 0d 00
			39 01 00 00 00 00 02 0e 00
			39 01 00 00 00 00 02 0f 04
			39 01 00 00 00 00 02 10 04
			39 01 00 00 00 00 02 11 00
			39 01 00 00 00 00 02 12 00
			39 01 00 00 00 00 02 13 00
			39 01 00 00 00 00 02 14 00
			39 01 00 00 00 00 02 15 10
			39 01 00 00 00 00 02 16 00
			39 01 00 00 00 00 02 17 01
			39 01 00 00 00 00 02 18 00
			39 01 00 00 00 00 02 19 00
			39 01 00 00 00 00 02 1a 00
			39 01 00 00 00 00 02 1b 00
			39 01 00 00 00 00 02 1c 00
			39 01 00 00 00 00 02 1d 00
			39 01 00 00 00 00 02 1e C0
			39 01 00 00 00 00 02 1f 80
			39 01 00 00 00 00 02 20 02
			39 01 00 00 00 00 02 21 09
			39 01 00 00 00 00 02 22 00
			39 01 00 00 00 00 02 23 00
			39 01 00 00 00 00 02 24 00
			39 01 00 00 00 00 02 25 00
			39 01 00 00 00 00 02 26 00
			39 01 00 00 00 00 02 27 00
			39 01 00 00 00 00 02 28 55
			39 01 00 00 00 00 02 29 03
			39 01 00 00 00 00 02 2a 00
			39 01 00 00 00 00 02 2b 00
			39 01 00 00 00 00 02 2c 00
			39 01 00 00 00 00 02 2d 00
			39 01 00 00 00 00 02 2e 00
			39 01 00 00 00 00 02 2f 00
			39 01 00 00 00 00 02 30 00
			39 01 00 00 00 00 02 31 00
			39 01 00 00 00 00 02 32 00
			39 01 00 00 00 00 02 33 00
			39 01 00 00 00 00 02 34 03
			39 01 00 00 00 00 02 35 00
			39 01 00 00 00 00 02 36 05
			39 01 00 00 00 00 02 37 00
			39 01 00 00 00 00 02 38 01
			39 01 00 00 00 00 02 39 00
			39 01 00 00 00 00 02 3a 00
			39 01 00 00 00 00 02 3b 00
			39 01 00 00 00 00 02 3c 00
			39 01 00 00 00 00 02 3d 00
			39 01 00 00 00 00 02 3e 00
			39 01 00 00 00 00 02 3f 00
			39 01 00 00 00 00 02 40 00
			39 01 00 00 00 00 02 41 00
			39 01 00 00 00 00 02 42 00
			39 01 00 00 00 00 02 43 00
			39 01 00 00 00 00 02 44 00
			39 01 00 00 00 00 02 50 01
			39 01 00 00 00 00 02 51 23
			39 01 00 00 00 00 02 52 45
			39 01 00 00 00 00 02 53 67
			39 01 00 00 00 00 02 54 89
			39 01 00 00 00 00 02 55 ab
			39 01 00 00 00 00 02 56 01
			39 01 00 00 00 00 02 57 23
			39 01 00 00 00 00 02 58 45
			39 01 00 00 00 00 02 59 67
			39 01 00 00 00 00 02 5a 89
			39 01 00 00 00 00 02 5b ab
			39 01 00 00 00 00 02 5c cd
			39 01 00 00 00 00 02 5d ef
			39 01 00 00 00 00 02 5e 01
			39 01 00 00 00 00 02 5f 14
			39 01 00 00 00 00 02 60 15
			39 01 00 00 00 00 02 61 0C
			39 01 00 00 00 00 02 62 0D
			39 01 00 00 00 00 02 63 0E
			39 01 00 00 00 00 02 64 0F
			39 01 00 00 00 00 02 65 10
			39 01 00 00 00 00 02 66 11
			39 01 00 00 00 00 02 67 08
			39 01 00 00 00 00 02 68 02
			39 01 00 00 00 00 02 69 0A
			39 01 00 00 00 00 02 6a 02
			39 01 00 00 00 00 02 6b 02
			39 01 00 00 00 00 02 6c 02
			39 01 00 00 00 00 02 6d 02
			39 01 00 00 00 00 02 6e 02
			39 01 00 00 00 00 02 6f 02
			39 01 00 00 00 00 02 70 02
			39 01 00 00 00 00 02 71 02
			39 01 00 00 00 00 02 72 06
			39 01 00 00 00 00 02 73 02
			39 01 00 00 00 00 02 74 02
			39 01 00 00 00 00 02 75 14
			39 01 00 00 00 00 02 76 15
			39 01 00 00 00 00 02 77 11
			39 01 00 00 00 00 02 78 10
			39 01 00 00 00 00 02 79 0F
			39 01 00 00 00 00 02 7a 0E
			39 01 00 00 00 00 02 7b 0D
			39 01 00 00 00 00 02 7c 0C
			39 01 00 00 00 00 02 7d 06
			39 01 00 00 00 00 02 7e 02
			39 01 00 00 00 00 02 7f 0A
			39 01 00 00 00 00 02 80 02
			39 01 00 00 00 00 02 81 02
			39 01 00 00 00 00 02 82 02
			39 01 00 00 00 00 02 83 02
			39 01 00 00 00 00 02 84 02
			39 01 00 00 00 00 02 85 02
			39 01 00 00 00 00 02 86 02
			39 01 00 00 00 00 02 87 02
			39 01 00 00 00 00 02 88 08
			39 01 00 00 00 00 02 89 02
			39 01 00 00 00 00 02 8A 02
			39 01 00 00 00 00 04 FF 98 81 04
			39 01 00 00 00 00 02 00 80
			39 01 00 00 00 00 02 6C 15
			39 01 00 00 00 00 02 6E 30
			39 01 00 00 00 00 02 6F 55
			39 01 00 00 00 00 02 3A 24
			39 01 00 00 00 00 02 35 1F
			39 01 00 00 00 00 02 33 00
			39 01 00 00 00 00 02 8D 1F
			39 01 00 00 00 00 02 87 BA
			39 01 00 00 00 00 02 26 76
			39 01 00 00 00 00 02 B2 D1
			39 01 00 00 00 00 02 88 0B
			39 01 00 00 00 00 04 FF 98 81 01
			39 01 00 00 00 00 02 22 0A
			39 01 00 00 00 00 02 31 00
			39 01 00 00 00 00 02 53 8A
			39 01 00 00 00 00 02 55 88
			39 01 00 00 00 00 02 50 96
			39 01 00 00 00 00 02 51 96
			39 01 00 00 00 00 02 60 30
			39 01 00 00 00 00 02 63 00
			39 01 00 00 00 00 02 A0 1C
			39 01 00 00 00 00 02 A1 23
			39 01 00 00 00 00 02 A2 30
			39 01 00 00 00 00 02 A3 14
			39 01 00 00 00 00 02 A4 16
			39 01 00 00 00 00 02 A5 2A
			39 01 00 00 00 00 02 A6 1B
			39 01 00 00 00 00 02 A7 1E
			39 01 00 00 00 00 02 A8 87
			39 01 00 00 00 00 02 A9 1C
			39 01 00 00 00 00 02 AA 29
			39 01 00 00 00 00 02 AB 75
			39 01 00 00 00 00 02 AC 16
			39 01 00 00 00 00 02 AD 14
			39 01 00 00 00 00 02 AE 47
			39 01 00 00 00 00 02 AF 1D
			39 01 00 00 00 00 02 B0 24
			39 01 00 00 00 00 02 B1 57
			39 01 00 00 00 00 02 B2 65
			39 01 00 00 00 00 02 B3 2C
			39 01 00 00 00 00 02 C0 04
			39 01 00 00 00 00 02 C1 20
			39 01 00 00 00 00 02 C2 2B
			39 01 00 00 00 00 02 C3 10
			39 01 00 00 00 00 02 C4 12
			39 01 00 00 00 00 02 C5 25
			39 01 00 00 00 00 02 C6 17
			39 01 00 00 00 00 02 C7 1C
			39 01 00 00 00 00 02 C8 7D
			39 01 00 00 00 00 02 C9 1A
			39 01 00 00 00 00 02 CA 27
			39 01 00 00 00 00 02 CB 6E
			39 01 00 00 00 00 02 CC 1B
			39 01 00 00 00 00 02 CD 18
			39 01 00 00 00 00 02 CE 4C
			39 01 00 00 00 00 02 CF 22
			39 01 00 00 00 00 02 D0 2B
			39 01 00 00 00 00 02 D1 54
			39 01 00 00 00 00 02 D2 63
			39 01 00 00 00 00 02 D3 2C
			39 01 00 00 00 00 04 ff 98 81 02
			39 01 00 00 00 00 02 06 20
			39 01 00 00 00 00 02 07 00
			39 01 00 00 00 00 04 ff 98 81 00
			39 01 00 00 00 00 03 51 00 00
			39 01 00 00 00 00 02 53 2c
			39 01 00 00 00 00 02 55 02
			05 01 00 00 78 00 02 11 00
			05 01 00 00 32 00 02 29 00
			39 01 00 00 00 00 02 35 00
			];
		qcom,mdss-dsi-off-command = [05 01 00 00 32 00 02 28 00
					05 01 00 00 78 00 02 10 00];
		qcom,mdss-dsi-on-command-state = "dsi_lp_mode";
		qcom,mdss-dsi-off-command-state = "dsi_lp_mode";
		qcom,mdss-dsi-h-sync-pulse = <1>;
		qcom,mdss-dsi-traffic-mode = "burst_mode";
		qcom,mdss-dsi-lane-map = "lane_map_0123";
		qcom,mdss-dsi-bllp-eof-power-mode;
		qcom,mdss-dsi-bllp-power-mode;
		qcom,mdss-dsi-lane-0-state;
		qcom,mdss-dsi-lane-1-state;
		qcom,mdss-dsi-lane-2-state;
		qcom,mdss-dsi-lane-3-state;
		qcom,mdss-dsi-panel-timings = [7B 1A 10 00 3E 40 16 1E 15 03 04 00];
		qcom,mdss-dsi-t-clk-post = <0x04>;
		qcom,mdss-dsi-t-clk-pre = <0x1A>;
		qcom,mdss-dsi-bl-min-level = <64>;
		qcom,mdss-dsi-bl-max-level = <4095>;
		qcom,mdss-dsi-dma-trigger = "trigger_sw";
		qcom,mdss-dsi-mdp-trigger = "none";
		qcom,mdss-dsi-bl-pmic-control-type = "bl_ctrl_dcs";
		qcom,mdss-dsi-reset-sequence = <1 20>, <0 2>, <1 20>;
		qcom,mdss-dsi-lp11-init;
		//qcom,mdss-dsi-init-delay-us = <7000>;
		qcom,mdss-pan-physical-width-dimension = <62>;
		qcom,mdss-pan-physical-height-dimension = <110>;
		qcom,mdss-dsi-tx-eot-append;
	};
};
